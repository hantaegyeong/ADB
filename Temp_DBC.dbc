VERSION ""

NS_ :

BS_:

BU_: MLM IBU_HS ILCU_RH MFSW DPSU ILCU_LH PSB APSU DPSS SWRC CGW PTGM DLBCU SCM DAU WPC IAU eCall PFSU RDC PSM

BO_ 3221225472 VECTOR__INDEPENDENT_SIG_MSG: 0 Vector__XXX
 SG_ IFS_HllAngle_RH : 0|16@1+ (1,0) [0|65535] "" Vector__XXX
 SG_ IFS_10Ch_Stat_RH : 0|2@1+ (1,0) [0|3] "" Vector__XXX
 SG_ IFS_9Ch_Stat_RH : 0|2@1+ (1,0) [0|3] "" Vector__XXX
 SG_ IFS_8Ch_Stat_RH : 0|2@1+ (1,0) [0|3] "" Vector__XXX
 SG_ IFS_7Ch_Stat_RH : 0|2@1+ (1,0) [0|3] "" Vector__XXX
 SG_ IFS_6Ch_Stat_RH : 0|2@1+ (1,0) [0|3] "" Vector__XXX
 SG_ IFS_5Ch_Stat_RH : 0|2@1+ (1,0) [0|3] "" Vector__XXX
 SG_ IFS_4Ch_Stat_RH : 0|2@1+ (1,0) [0|3] "" Vector__XXX
 SG_ IFS_3Ch_Stat_RH : 0|2@1+ (1,0) [0|3] "" Vector__XXX
 SG_ IFS_2Ch_Stat_RH : 0|2@1+ (1,0) [0|3] "" Vector__XXX
 SG_ IFS_1Ch_Stat_RH : 0|2@1+ (1,0) [0|3] "" Vector__XXX
 SG_ IFS_HllAngle_LH : 0|16@1+ (1,0) [0|65535] "" Vector__XXX
 SG_ IFS_10Ch_Stat_LH : 0|2@1+ (1,0) [0|3] "" Vector__XXX
 SG_ IFS_9Ch_Stat_LH : 0|2@1+ (1,0) [0|3] "" Vector__XXX
 SG_ IFS_8Ch_Stat_LH : 0|2@1+ (1,0) [0|3] "" Vector__XXX
 SG_ IFS_7Ch_Stat_LH : 0|2@1+ (1,0) [0|3] "" Vector__XXX
 SG_ IFS_6Ch_Stat_LH : 0|2@1+ (1,0) [0|3] "" Vector__XXX
 SG_ IFS_5Ch_Stat_LH : 0|2@1+ (1,0) [0|3] "" Vector__XXX
 SG_ IFS_4Ch_Stat_LH : 0|2@1+ (1,0) [0|3] "" Vector__XXX
 SG_ IFS_3Ch_Stat_LH : 0|2@1+ (1,0) [0|3] "" Vector__XXX
 SG_ IFS_2Ch_Stat_LH : 0|2@1+ (1,0) [0|3] "" Vector__XXX
 SG_ IFS_1Ch_Stat_LH : 0|2@1+ (1,0) [0|3] "" Vector__XXX
 SG_ IFSref_VehRtAngl10Val : 0|9@1+ (1,0) [0|0] "" Vector__XXX
 SG_ IFSref_VehLftAngl10Val : 0|9@1+ (1,0) [0|0] "" Vector__XXX
 SG_ IFSref_VehRtAngl9Val : 0|9@1+ (1,0) [0|0] "" Vector__XXX
 SG_ IFSref_VehDst10Val : 0|4@1+ (1,0) [0|0] "" Vector__XXX
 SG_ IFSref_VehDst9Val : 0|4@1+ (1,0) [0|0] "" Vector__XXX
 SG_ IFSref_VehDst8Val : 0|4@1+ (1,0) [0|0] "" Vector__XXX
 SG_ IFSref_VehDst7Val : 0|4@1+ (1,0) [0|0] "" Vector__XXX
 SG_ IFSref_VehDst6Val : 0|4@1+ (1,0) [0|0] "" Vector__XXX
 SG_ IFSref_VehDst5Val : 0|4@1+ (1,0) [0|0] "" Vector__XXX
 SG_ IFSref_VehDst4Val : 0|4@1+ (1,0) [0|0] "" Vector__XXX
 SG_ IFSref_VehDst3Val : 0|4@1+ (1,0) [0|0] "" Vector__XXX
 SG_ IFSref_VehDst2Val : 0|4@1+ (1,0) [0|0] "" Vector__XXX
 SG_ GST_ILCU_RH_Byte7 : 0|8@1+ (1,0) [0|0] "" Vector__XXX
 SG_ GST_ILCU_RH_Byte6 : 0|8@1+ (1,0) [0|0] "" Vector__XXX
 SG_ GST_ILCU_RH_Byte5 : 0|8@1+ (1,0) [0|0] "" Vector__XXX
 SG_ GST_ILCU_RH_Byte4 : 0|8@1+ (1,0) [0|0] "" Vector__XXX
 SG_ GST_ILCU_RH_Byte3 : 0|8@1+ (1,0) [0|0] "" Vector__XXX
 SG_ GST_ILCU_RH_Byte2 : 0|8@1+ (1,0) [0|0] "" Vector__XXX
 SG_ GST_ILCU_RH_Byte1 : 0|8@1+ (1,0) [0|0] "" Vector__XXX
 SG_ GST_ILCU_RH_Byte0 : 0|8@1+ (1,0) [0|0] "" Vector__XXX
 SG_ GST_ILCU_LH_Byte7 : 0|8@1+ (1,0) [0|0] "" Vector__XXX
 SG_ GST_ILCU_LH_Byte6 : 0|8@1+ (1,0) [0|0] "" Vector__XXX
 SG_ GST_ILCU_LH_Byte5 : 0|8@1+ (1,0) [0|0] "" Vector__XXX
 SG_ GST_ILCU_LH_Byte4 : 0|8@1+ (1,0) [0|0] "" Vector__XXX
 SG_ GST_ILCU_LH_Byte3 : 0|8@1+ (1,0) [0|0] "" Vector__XXX
 SG_ GST_ILCU_LH_Byte2 : 0|8@1+ (1,0) [0|0] "" Vector__XXX
 SG_ GST_ILCU_LH_Byte1 : 0|8@1+ (1,0) [0|0] "" Vector__XXX
 SG_ GST_ILCU_LH_Byte0 : 0|8@1+ (1,0) [0|0] "" Vector__XXX
 SG_ CLU_Crc2Val : 0|16@1+ (1,0) [0|0] "" Vector__XXX
 SG_ CLU_AlvCnt2Val : 0|8@1+ (1,0) [0|0] "" Vector__XXX
 SG_ CLU_OutTempCSta : 0|8@1+ (1,-40) [0|0] "" Vector__XXX
 SG_ CLU_DTEVal : 0|10@1+ (1,0) [0|0] "" Vector__XXX
 SG_ CLU_SndTyp : 0|2@1- (1,0) [0|0] "" Vector__XXX
 SG_ CLU_TripUnitSta : 0|2@1+ (1,0) [0|0] "" Vector__XXX
 SG_ CLU_AvgFuelCnsmptnVal : 0|10@1+ (0.1,0) [0|0] "" Vector__XXX
 SG_ CLU_AvgFuelCnsmptnUnitSta : 0|2@1+ (1,0) [0|0] "" Vector__XXX
 SG_ CLU_LoFuelWrngSta : 0|2@1+ (1,0) [0|0] "" Vector__XXX
 SG_ CLU_RefuelDetSta : 0|2@1+ (1,0) [0|0] "" Vector__XXX
 SG_ CLU_TerrainMainSwSta : 0|2@1+ (1,0) [0|0] "" Vector__XXX
 SG_ CLU_LngSta : 0|5@1+ (1,0) [0|0] "" Vector__XXX
 SG_ CLU_SRSWrngLmpSta : 0|3@1+ (1,0) [0|0] "" Vector__XXX
 SG_ CLU_OdoVal : 0|24@1+ (0.1,0) [0|0] "km" Vector__XXX
 SG_ CLU_DawLastBrkTimeVal : 0|4@1+ (1,0) [0|0] "" Vector__XXX
 SG_ CLU_RefuelWrnSta : 0|2@1+ (1,0) [0|0] "" Vector__XXX
 SG_ CLU_IceWrnIndSta : 0|2@1+ (1,0) [0|0] "" Vector__XXX
 SG_ CLU_DrvngModSwSta : 0|4@1+ (1,0) [0|0] "" Vector__XXX
 SG_ CLU_FuelLvlSta : 0|7@1+ (1,0) [0|0] "%" Vector__XXX
 SG_ CLU_OutTempFSta : 0|8@1+ (1,-40) [0|0] "" Vector__XXX
 SG_ CLU_TerrainModSwSta : 0|3@1+ (1,0) [0|0] "" Vector__XXX
 SG_ SWRC_Crc1Val : 0|8@1+ (1,0) [0|0] "" Vector__XXX
 SG_ SWRC_AlvCnt1Val : 0|4@1+ (1,0) [0|0] "" Vector__XXX
 SG_ Audio_VcRecSwSta : 0|2@1+ (1,0) [0|0] "" Vector__XXX
 SG_ Audio_BluetoothPhnClSwSta : 0|2@1+ (1,0) [0|0] "" Vector__XXX
 SG_ Audio_ModSwSta : 0|2@1+ (1,0) [0|0] "" Vector__XXX
 SG_ Audio_MutSwSta : 0|2@1+ (1,0) [0|0] "" Vector__XXX
 SG_ Audio_SeekDnSwSta : 0|2@1+ (1,0) [0|0] "" Vector__XXX
 SG_ Audio_SeekUpSwSta : 0|2@1+ (1,0) [0|0] "" Vector__XXX
 SG_ Cluster_ModeSwSta : 0|2@1+ (1,0) [0|0] "" Vector__XXX
 SG_ Cluster_ScrlOkSwSta : 0|2@1+ (1,0) [0|0] "" Vector__XXX
 SG_ Audio_CustomSwSta : 0|2@1+ (1,0) [0|0] "" Vector__XXX
 SG_ USM_CmdWPCSta : 0|2@1+ (1,0) [0|0] "" Vector__XXX
 SG_ WPC_PhnLftWrngSta : 0|3@1+ (1,0) [0|0] "" Vector__XXX
 SG_ WPC_NFCDeviceDetSta : 0|4@1+ (1,0) [0|0] "" Vector__XXX
 SG_ SMK_Crc2Val : 0|8@1+ (1,0) [0|0] "" Vector__XXX
 SG_ SMK_AlvCnt2Val : 0|4@1+ (1,0) [0|0] "" Vector__XXX
 SG_ SSB_StrtStpBtnSw1Sta : 0|2@1+ (1,0) [0|0] "" Vector__XXX
 SG_ SSB_StrtStpBtnSw2Sta : 0|2@1+ (1,0) [0|0] "" Vector__XXX
 SG_ SMK_TrmnlCtrlSta : 0|4@1+ (1,0) [0|0] "" Vector__XXX
 SG_ SMK_TrmnlMngrSta : 0|5@1+ (1,0) [0|0] "" Vector__XXX
 SG_ SMK_AuthSta : 0|3@1+ (1,0) [0|0] "" Vector__XXX
 SG_ SMK_Ign1InSta : 0|2@1+ (1,0) [0|0] "" Vector__XXX
 SG_ SMK_Ign1RlySta : 0|2@1+ (1,0) [0|0] "" Vector__XXX
 SG_ SMK_Ign2InSta : 0|2@1+ (1,0) [0|0] "" Vector__XXX
 SG_ SMK_Ign2RlySta : 0|2@1+ (1,0) [0|0] "" Vector__XXX
 SG_ SMK_StrtFdbckSta : 0|2@1+ (1,0) [0|0] "" Vector__XXX
 SG_ SMK_StrtrRlyOutSta : 0|2@1+ (1,0) [0|0] "" Vector__XXX
 SG_ SMK_AccInSta : 0|2@1+ (1,0) [0|0] "" Vector__XXX
 SG_ SMK_AccRlySta : 0|2@1+ (1,0) [0|0] "" Vector__XXX
 SG_ SMK_CLUAccIndOnReq : 0|2@1+ (1,0) [0|0] "" Vector__XXX
 SG_ SMK_TlEngRunSta : 0|2@1+ (1,0) [0|0] "" Vector__XXX
 SG_ SMK_TlCrnkModSta : 0|2@1+ (1,0) [0|0] "" Vector__XXX
 SG_ ILCU_LH_Crc2Val : 0|8@1+ (1,0) [0|0] "" Vector__XXX
 SG_ ILCU_LH_AlvCnt2Val : 0|4@1+ (1,0) [0|0] "" Vector__XXX
 SG_ ILCULH_HeightSnsrFront_Val : 0|16@1- (1,0) [0|0] "" Vector__XXX
 SG_ ILCULH_HeightSnsrFront_Stat : 0|2@1+ (1,0) [0|0] "" Vector__XXX
 SG_ ILCULH_LevelActuator_Sta : 0|2@1+ (1,0) [0|0] "" Vector__XXX
 SG_ SMK_Crc6Val : 0|8@1+ (1,0) [0|0] "" Vector__XXX
 SG_ SMK_AlvCnt6Val : 0|4@1+ (1,0) [0|0] "" Vector__XXX
 SG_ Lamp_HzrdBlnkngSta : 0|3@1+ (1,0) [0|0] "" Vector__XXX
 SG_ Lamp_SmrtWlcmLtOnReq : 0|2@1+ (1,0) [0|0] "" Vector__XXX
 SG_ Fob_BattStaInfo : 0|2@1+ (1,0) [0|0] "" Vector__XXX
 SG_ Fob_FoundDrvWlcmArea : 0|2@1+ (1,0) [0|0] "" Vector__XXX
 SG_ Fob_FoundAsstWlcmArea : 0|2@1+ (1,0) [0|0] "" Vector__XXX
 SG_ Fob_FoundExtrnlArea : 0|2@1+ (1,0) [0|0] "" Vector__XXX
 SG_ Fob_FoundIntArea : 0|2@1+ (1,0) [0|0] "" Vector__XXX
 SG_ Fob_LearntSta : 0|2@1+ (1,0) [0|0] "" Vector__XXX
 SG_ LFAnt_FltSta : 0|2@1+ (1,0) [0|0] "" Vector__XXX
 SG_ LFAnt_SrchSta : 0|2@1+ (1,0) [0|0] "" Vector__XXX
 SG_ RSPA_ModSta_SMK : 0|3@1+ (1,0) [0|0] "" Vector__XXX
 SG_ RSPA_FobBattSta : 0|3@1+ (1,0) [0|0] "" Vector__XXX
 SG_ USM_SmrtTrnkTlgtModSta : 0|3@1+ (1,0) [0|0] "" Vector__XXX
 SG_ USM_WALModSta : 0|3@1+ (1,0) [0|0] "" Vector__XXX
 SG_ BCM_Crc12Val : 0|8@1+ (1,0) [0|0] "" Vector__XXX
 SG_ BCM_AlvCnt12Val : 0|4@1+ (1,0) [0|0] "" Vector__XXX
 SG_ BCM_CntryConfgTyp : 0|4@1+ (1,0) [0|0] "" Vector__XXX
 SG_ BCM_SmkOptTyp : 0|2@1+ (1,0) [0|0] "" Vector__XXX
 SG_ Window_DrvrSdWdwSta_BCM : 0|2@1+ (1,0) [0|0] "" Vector__XXX
 SG_ Window_AsstSdWdwSta_BCM : 0|2@1+ (1,0) [0|0] "" Vector__XXX
 SG_ Window_RrLftWdwSta_BCM : 0|2@1+ (1,0) [0|0] "" Vector__XXX
 SG_ Window_RrRtWdwSta_BCM : 0|2@1+ (1,0) [0|0] "" Vector__XXX
 SG_ Window_TunlModAutoIndSta : 0|2@1+ (1,0) [0|0] "" Vector__XXX
 SG_ ACU_Crc2Val : 0|16@1+ (1,0) [0|0] "" Vector__XXX
 SG_ ACU_AlvCnt2Val : 0|8@1+ (1,0) [0|0] "" Vector__XXX
 SG_ ACU_CrshActvSta : 0|2@1+ (1,0) [0|0] "" Vector__XXX
 SG_ APSS_SldTch : 0|2@1+ (1,0) [0|0] "" Vector__XXX
 SG_ APSS_RclTch : 0|2@1+ (1,0) [0|0] "" Vector__XXX
 SG_ APSS_LmbrTch : 0|2@1+ (1,0) [0|0] "" Vector__XXX
 SG_ ALU_LumbarUpSw : 0|2@1+ (1,0) [0|0] "" Vector__XXX
 SG_ ALU_LumbarMidSw : 0|2@1+ (1,0) [0|0] "" Vector__XXX
 SG_ ALU_LumbarLowSw : 0|2@1+ (1,0) [0|0] "" Vector__XXX
 SG_ ALU_LumbarDefSw : 0|2@1+ (1,0) [0|0] "" Vector__XXX
 SG_ C_LH_Folding_State_PopUp : 0|3@1+ (1,0) [0|0] "" Vector__XXX
 SG_ C_RH_Folding_State_PopUp : 0|3@1+ (1,0) [0|0] "" Vector__XXX
 SG_ MLM_MdLmpBrgtnsVal : 0|5@1+ (1,0) [0|0] "" Vector__XXX
 SG_ MLM_MdLmpDrvngVal : 0|2@1+ (1,0) [0|0] "" Vector__XXX
 SG_ MLM_MdLmpRedVal : 0|10@1+ (1,0) [0|0] "" Vector__XXX
 SG_ MLM_MdLmpGreenVal : 0|10@1+ (1,0) [0|0] "" Vector__XXX
 SG_ MLM_MdLmpBlueVal : 0|10@1+ (1,0) [0|0] "" Vector__XXX
 SG_ ILCU_RH_Crc2Val : 0|8@1+ (1,0) [0|0] "" Vector__XXX
 SG_ ILCU_RH_AlvCnt2Val : 0|4@1+ (1,0) [0|0] "" Vector__XXX
 SG_ ILCURH_HeightSnsrFront_Val : 0|16@1- (1,0) [0|0] "" Vector__XXX
 SG_ ILCURH_HeightSnsrFront_Stat : 0|2@1+ (1,0) [0|0] "" Vector__XXX
 SG_ ILCURH_LevelActuator_Sta : 0|2@1+ (1,0) [0|0] "" Vector__XXX
 SG_ SMK_Crc3Val : 0|8@1+ (1,0) [0|0] "" Vector__XXX
 SG_ SMK_AlvCnt3Val : 0|4@1+ (1,0) [0|0] "" Vector__XXX
 SG_ ESCL_EsclMngrSta : 0|4@1+ (1,0) [0|0] "" Vector__XXX
 SG_ ESCL_EsclPwrSupSta : 0|2@1+ (1,0) [0|0] "" Vector__XXX
 SG_ ESCL_EsclEnaSta : 0|2@1+ (1,0) [0|0] "" Vector__XXX
 SG_ ESCL_EsclUnitSta : 0|3@1+ (1,0) [0|0] "" Vector__XXX
 SG_ ESCL_EsclBoltSta : 0|3@1+ (1,0) [0|0] "" Vector__XXX
 SG_ ESCL_EsclLoBattSta : 0|3@1+ (1,0) [0|0] "" Vector__XXX
 SG_ ESCL_EsclUnLkSwSta : 0|3@1+ (1,0) [0|0] "" Vector__XXX
 SG_ C_LH_Folding_Position : 0|3@1+ (1,0) [0|0] "" Vector__XXX
 SG_ C_RH_Folding_Position : 0|3@1+ (1,0) [0|0] "" Vector__XXX
 SG_ PFSU_RL_Folding_SW : 0|2@1+ (1,0) [0|0] "" Vector__XXX
 SG_ PFSU_RR_Folding_SW : 0|2@1+ (1,0) [0|0] "" Vector__XXX
 SG_ PFSU_RL_Unfolding_SW : 0|2@1+ (1,0) [0|0] "" Vector__XXX
 SG_ PFSU_RR_Unfolding_SW : 0|2@1+ (1,0) [0|0] "" Vector__XXX
 SG_ RR_SHVU_SeatOptSta : 0|3@1+ (1,0) [0|0] "" Vector__XXX
 SG_ RR_SHVU_SeatHtOperSta : 0|4@1+ (1,0) [0|0] "" Vector__XXX
 SG_ IAU_EncryptedResult1Val : 0|64@1+ (1,0) [0|0] "" Vector__XXX
 SG_ APSU_AstStSldFwdDis : 0|2@1+ (1,0) [0|0] "" Vector__XXX
 SG_ APSU_AstStSldBckwdDis : 0|2@1+ (1,0) [0|0] "" Vector__XXX
 SG_ APSU_AstStReclneFwdDis : 0|2@1+ (1,0) [0|0] "" Vector__XXX
 SG_ APSU_AstStReclneBckwdDis : 0|2@1+ (1,0) [0|0] "" Vector__XXX
 SG_ APSU_AstStTiltUpDis : 0|2@1+ (1,0) [0|0] "" Vector__XXX
 SG_ APSU_AstStTiltDnDis : 0|2@1+ (1,0) [0|0] "" Vector__XXX
 SG_ APSU_AstStHghtUpDis : 0|2@1+ (1,0) [0|0] "" Vector__XXX
 SG_ APSU_AstStHghtDnDis : 0|2@1+ (1,0) [0|0] "" Vector__XXX
 SG_ APSU_AstStLmbrDefDis : 0|2@1+ (1,0) [0|0] "" Vector__XXX
 SG_ APSU_AstStLmbrLoDis : 0|2@1+ (1,0) [0|0] "" Vector__XXX
 SG_ APSU_AstStLmbrMdlDis : 0|2@1+ (1,0) [0|0] "" Vector__XXX
 SG_ APSU_AstStLmbrUpDis : 0|2@1+ (1,0) [0|0] "" Vector__XXX
 SG_ APSU_LmbrSigSrcTyp : 0|2@1+ (1,0) [0|0] "" Vector__XXX
 SG_ DLBCU_CushInfDis : 0|2@1+ (1,0) [0|0] "" Vector__XXX
 SG_ DLBCU_CushDefDis : 0|2@1+ (1,0) [0|0] "" Vector__XXX
 SG_ ICSC_Crc2Val : 0|16@1+ (1,0) [0|0] "" Vector__XXX
 SG_ ICSC_AlvCnt2Val : 0|8@1+ (1,0) [0|0] "" Vector__XXX
 SG_ DMIC_DrvModSta : 0|4@1+ (1,0) [0|0] "" Vector__XXX
 SG_ DMIC_SmtShftModSta : 0|2@1+ (1,0) [0|0] "" Vector__XXX
 SG_ DMIC_EngModSta : 0|4@1+ (1,0) [0|0] "" Vector__XXX
 SG_ DMIC_TmModSta : 0|4@1+ (1,0) [0|0] "" Vector__XXX
 SG_ DMIC_AwdModSta : 0|4@1+ (1,0) [0|0] "" Vector__XXX
 SG_ APSU_AstStEsyAcsUSMSta : 0|3@1+ (1,0) [0|0] "" Vector__XXX
 SG_ APSU_AutoHtrCtrlUSMSta : 0|2@1+ (1,0) [0|0] "" Vector__XXX
 SG_ DLBCU_LumbarUpDis : 0|2@1+ (1,0) [0|0] "" Vector__XXX
 SG_ DLBCU_LumbarMidDis : 0|2@1+ (1,0) [0|0] "" Vector__XXX
 SG_ DLBCU_LumbarLowDis : 0|2@1+ (1,0) [0|0] "" Vector__XXX
 SG_ DLBCU_LumbarDefDis : 0|2@1+ (1,0) [0|0] "" Vector__XXX
 SG_ DLBCU_BolsterInfDis : 0|2@1+ (1,0) [0|0] "" Vector__XXX
 SG_ DLBCU_BolsterDefDis : 0|2@1+ (1,0) [0|0] "" Vector__XXX
 SG_ DPSS_LumbarUpSw : 0|2@1+ (1,0) [0|0] "" Vector__XXX
 SG_ DPSS_LumbarMidSw : 0|2@1+ (1,0) [0|0] "" Vector__XXX
 SG_ DPSS_LumbarLowSw : 0|2@1+ (1,0) [0|0] "" Vector__XXX
 SG_ DPSS_LumbarDefSw : 0|2@1+ (1,0) [0|0] "" Vector__XXX
 SG_ DPSS_BolsterInfSw : 0|2@1+ (1,0) [0|0] "" Vector__XXX
 SG_ DPSS_BolsterDefSw : 0|2@1+ (1,0) [0|0] "" Vector__XXX
 SG_ DPSS_ActiveSw : 0|2@1+ (1,0) [0|0] "" Vector__XXX
 SG_ DPSS_SldTch : 0|2@1+ (1,0) [0|0] "" Vector__XXX
 SG_ DPSS_RclTch : 0|2@1+ (1,0) [0|0] "" Vector__XXX
 SG_ DPSS_ExtTch : 0|2@1+ (1,0) [0|0] "" Vector__XXX
 SG_ DPSS_LmbrTch : 0|2@1+ (1,0) [0|0] "" Vector__XXX
 SG_ DPSS_CushOnOffTch : 0|2@1+ (1,0) [0|0] "" Vector__XXX
 SG_ ACU_ActvFltSta : 0|3@1+ (1,0) [0|0] "" Vector__XXX
 SG_ ACU_SdArbgExtTyp : 0|3@1+ (1,0) [0|0] "" Vector__XXX
 SG_ DPSS_StExtFwdMvBtn : 0|2@1+ (1,0) [0|0] "" Vector__XXX
 SG_ DPSS_StExtBwdMvBtn : 0|2@1+ (1,0) [0|0] "" Vector__XXX
 SG_ DPSS_StSldFwdMvBtn : 0|2@1+ (1,0) [0|0] "" Vector__XXX
 SG_ DPSS_StSldBwdMvBtn : 0|2@1+ (1,0) [0|0] "" Vector__XXX
 SG_ DPSS_StRclFwdMvBtn : 0|2@1+ (1,0) [0|0] "" Vector__XXX
 SG_ DPSS_StRclBwdMvBtn : 0|2@1+ (1,0) [0|0] "" Vector__XXX
 SG_ DPSS_StHgtUpMvBtn : 0|2@1+ (1,0) [0|0] "" Vector__XXX
 SG_ DPSS_StHgtDnMvBtn : 0|2@1+ (1,0) [0|0] "" Vector__XXX
 SG_ DPSS_StTltUpMvBtn : 0|2@1+ (1,0) [0|0] "" Vector__XXX
 SG_ DPSS_StTltDnMvBtn : 0|2@1+ (1,0) [0|0] "" Vector__XXX
 SG_ Window_RrLftWdwSwSta : 0|3@1+ (1,0) [0|0] "" Vector__XXX
 SG_ Window_RrRtWdwSwSta : 0|3@1+ (1,0) [0|0] "" Vector__XXX
 SG_ SMK_Crc9Val : 0|8@1+ (1,0) [0|0] "" Vector__XXX
 SG_ SMK_AlvCnt9Val : 0|4@1+ (1,0) [0|0] "" Vector__XXX
 SG_ Auth_EncryptRespData2 : 0|48@1+ (1,0) [0|0] "" Vector__XXX
 SG_ SMK_Crc10Val : 0|8@1+ (1,0) [0|0] "" Vector__XXX
 SG_ SMK_AlvCnt10Val : 0|4@1+ (1,0) [0|0] "" Vector__XXX
 SG_ Auth_EncryptRespData3 : 0|48@1+ (1,0) [0|0] "" Vector__XXX
 SG_ SMK_Crc7Val : 0|8@1+ (1,0) [0|0] "" Vector__XXX
 SG_ SMK_AlvCnt7Val : 0|4@1+ (1,0) [0|0] "" Vector__XXX
 SG_ Auth_RndNum : 0|48@1+ (1,0) [0|0] "" Vector__XXX
 SG_ ACU_Crc1Val : 0|16@1+ (1,0) [0|0] "" Vector__XXX
 SG_ ACU_AlvCnt1Val : 0|8@1+ (1,0) [0|0] "" Vector__XXX
 SG_ ACU_SysWrngLmpDis : 0|3@1+ (1,0) [0|0] "" Vector__XXX
 SG_ ACU_TlltlLmpDis : 0|3@1+ (1,0) [0|0] "" Vector__XXX
 SG_ ACU_OdsIDReq : 0|2@1+ (1,0) [0|0] "" Vector__XXX
 SG_ SeatBelt_PassBcklFltSta : 0|2@1+ (1,0) [0|0] "" Vector__XXX
 SG_ SeatBelt_DrvrBcklFltSta : 0|2@1+ (1,0) [0|0] "" Vector__XXX
 SG_ SeatBelt_PassBcklSta : 0|2@1+ (1,0) [0|0] "" Vector__XXX
 SG_ SeatBelt_DrvrBcklSta : 0|2@1+ (1,0) [0|0] "" Vector__XXX
 SG_ ACU_DiagTrblCodVal : 0|16@1+ (1,0) [0|0] "" Vector__XXX
 SG_ ACU_FltNumVal : 0|8@1+ (1,0) [0|0] "" Vector__XXX
 SG_ SMK_Crc8Val : 0|8@1+ (1,0) [0|0] "" Vector__XXX
 SG_ SMK_AlvCnt8Val : 0|4@1+ (1,0) [0|0] "" Vector__XXX
 SG_ Auth_EncryptRespData1 : 0|48@1+ (1,0) [0|0] "" Vector__XXX
 SG_ CLU_Crc11Val : 0|16@1+ (1,0) [0|0] "" Vector__XXX
 SG_ CLU_ICUDlvrModOffSetReq : 0|2@1+ (1,0) [0|0] "" Vector__XXX
 SG_ CLU_SMKKeyOutWarnOffReq : 0|2@1+ (1,0) [0|0] "" Vector__XXX
 SG_ CLU_DrvngLampChgnSta : 0|4@1+ (1,0) [0|0] "" Vector__XXX
 SG_ FR_SHVU_SeatOptSta : 0|3@1+ (1,0) [0|0] "" Vector__XXX
 SG_ FR_SHVU_SeatHtOperSta : 0|4@1+ (1,0) [0|0] "" Vector__XXX
 SG_ FR_SHVU_HtSwHiIndSta : 0|2@1+ (1,0) [0|0] "" Vector__XXX
 SG_ FR_SHVU_HtSwMidIndSta : 0|2@1+ (1,0) [0|0] "" Vector__XXX
 SG_ FR_SHVU_HtSwLowIndSta : 0|2@1+ (1,0) [0|0] "" Vector__XXX
 SG_ FR_SHVU_VntSwHiIndSta : 0|2@1+ (1,0) [0|0] "" Vector__XXX
 SG_ FR_SHVU_VntSwMidIndSta : 0|2@1+ (1,0) [0|0] "" Vector__XXX
 SG_ FR_SHVU_VntSwLowIndSta : 0|2@1+ (1,0) [0|0] "" Vector__XXX
 SG_ SCC_DrvOvrRidSta : 0|2@1+ (1,0) [0|0] "" Vector__XXX
 SG_ SCC_SccFlrDetSta : 0|2@1+ (1,0) [0|0] "" Vector__XXX
 SG_ SCC_FuncFlrDetSta : 0|2@1+ (1,0) [0|0] "" Vector__XXX
 SG_ SCC_SccOffStaDetSta : 0|2@1+ (1,0) [0|0] "" Vector__XXX
 SG_ SCC_BrkLtSwFlrDetSta : 0|2@1+ (1,0) [0|0] "" Vector__XXX
 SG_ ISA_IsaFuncSta : 0|2@1+ (1,0) [0|0] "" Vector__XXX
 SG_ SCC_StrtLimFuncSta : 0|2@1+ (1,0) [0|0] "" Vector__XXX
 SG_ EMS_SafetyFunctSta : 0|2@1+ (1,0) [0|0] "" Vector__XXX
 SG_ InAirTempVal : 0|8@1+ (0.75,-48) [0|0] "℃" Vector__XXX
 SG_ OBD_RbmSta : 0|7@1+ (1,0) [0|0] "" Vector__XXX
 SG_ OBD_IgnCycCntVal : 0|16@1+ (1,0) [0|0] "" Vector__XXX
 SG_ OBD_DnmntrCalcVal : 0|16@1+ (1,0) [0|0] "" Vector__XXX
 SG_ TCU_NetrlCtrlSta : 0|2@1+ (1,0) [0|0] "" Vector__XXX
 SG_ TCU_ShftPtrnSta : 0|4@1+ (1,0) [0|0] "" Vector__XXX
 SG_ TCU_VgisInhbtReq : 0|2@1+ (1,0) [0|0] "" Vector__XXX
 SG_ TCU_EngTqIncReqVal : 0|12@1- (1,0) [0|0] "Nm" Vector__XXX
 SG_ SCR_LvlWrngLmpSta : 0|2@1+ (1,0) [0|0] "" Vector__XXX
 SG_ SCR_LvlWrngMsgDis : 0|3@1+ (1,0) [0|0] "" Vector__XXX

CM_ BO_ 3221225472 "This is a message for not used signals, created by Vector CANdb++ DBC OLE DB Provider.";
CM_ SG_ 3221225472 IFS_HllAngle_RH "ILCU_LH System status";
CM_ SG_ 3221225472 IFS_10Ch_Stat_RH "ILCU_LH System status";
CM_ SG_ 3221225472 IFS_9Ch_Stat_RH "ILCU_LH System status";
CM_ SG_ 3221225472 IFS_8Ch_Stat_RH "ILCU_LH System status";
CM_ SG_ 3221225472 IFS_7Ch_Stat_RH "ILCU_LH System status";
CM_ SG_ 3221225472 IFS_6Ch_Stat_RH "ILCU_LH System status";
CM_ SG_ 3221225472 IFS_5Ch_Stat_RH "ILCU_LH System status";
CM_ SG_ 3221225472 IFS_4Ch_Stat_RH "ILCU_LH System status";
CM_ SG_ 3221225472 IFS_3Ch_Stat_RH "ILCU_LH System status";
CM_ SG_ 3221225472 IFS_2Ch_Stat_RH "ILCU_LH System status";
CM_ SG_ 3221225472 IFS_1Ch_Stat_RH "ILCU_LH System status";
CM_ SG_ 3221225472 IFS_HllAngle_LH "ILCU_LH System status";
CM_ SG_ 3221225472 IFS_10Ch_Stat_LH "ILCU_LH System status";
CM_ SG_ 3221225472 IFS_9Ch_Stat_LH "ILCU_LH System status";
CM_ SG_ 3221225472 IFS_8Ch_Stat_LH "ILCU_LH System status";
CM_ SG_ 3221225472 IFS_7Ch_Stat_LH "ILCU_LH System status";
CM_ SG_ 3221225472 IFS_6Ch_Stat_LH "ILCU_LH System status";
CM_ SG_ 3221225472 IFS_5Ch_Stat_LH "ILCU_LH System status";
CM_ SG_ 3221225472 IFS_4Ch_Stat_LH "ILCU_LH System status";
CM_ SG_ 3221225472 IFS_3Ch_Stat_LH "ILCU_LH System status";
CM_ SG_ 3221225472 IFS_2Ch_Stat_LH "ILCU_LH System status";
CM_ SG_ 3221225472 IFS_1Ch_Stat_LH "ILCU_LH System status";
CM_ SG_ 3221225472 CLU_Crc2Val "CLU_CyclicRedundancyCheck2Value";
CM_ SG_ 3221225472 CLU_AlvCnt2Val "CLU_AliveCounter2Value";
CM_ SG_ 3221225472 CLU_OutTempCSta "CLU_DisplayOutsideTemperatureCStatus";
CM_ SG_ 3221225472 CLU_DTEVal "CLU_DTEValue";
CM_ SG_ 3221225472 CLU_SndTyp "CLU_SoundType";
CM_ SG_ 3221225472 CLU_TripUnitSta "CLU_TripUnitStatus";
CM_ SG_ 3221225472 CLU_AvgFuelCnsmptnVal "CLU_AverageFuelConsumptionValue";
CM_ SG_ 3221225472 CLU_AvgFuelCnsmptnUnitSta "CLU_AverageFuelConsumptionUnitStatus";
CM_ SG_ 3221225472 CLU_LoFuelWrngSta "CLU_LowFuelWarningStatus";
CM_ SG_ 3221225472 CLU_RefuelDetSta "CLU_RefuelDetectedStatus";
CM_ SG_ 3221225472 CLU_TerrainMainSwSta "CLU_TerrainMainSwitchStatus";
CM_ SG_ 3221225472 CLU_LngSta "CLU_LanguageStatus";
CM_ SG_ 3221225472 CLU_SRSWrngLmpSta "CLU_SRSWarningLampStatus";
CM_ SG_ 3221225472 CLU_OdoVal "CLU_OdometerValue";
CM_ SG_ 3221225472 CLU_DawLastBrkTimeVal "CLU_DawLastBreakTimeValue";
CM_ SG_ 3221225472 CLU_RefuelWrnSta "CLU_RefuelWarningStatus";
CM_ SG_ 3221225472 CLU_IceWrnIndSta "CLU_IceWarnIndicatorStatus";
CM_ SG_ 3221225472 CLU_DrvngModSwSta "CLU_DrivingModeSwitchStatus";
CM_ SG_ 3221225472 CLU_FuelLvlSta "CLU_FuelLevelStatus";
CM_ SG_ 3221225472 CLU_OutTempFSta "CLU_DisplayOutsideTemperatureFStatus";
CM_ SG_ 3221225472 CLU_TerrainModSwSta "CLU_TerrainModeSwitchStatus";
CM_ SG_ 3221225472 SWRC_Crc1Val "SWRC_CyclicRedundancyCheck1Value";
CM_ SG_ 3221225472 SWRC_AlvCnt1Val "SWRC_AliveCounter1Value";
CM_ SG_ 3221225472 Audio_VcRecSwSta "Audio_VoiceReconitionSwitchStatus";
CM_ SG_ 3221225472 Audio_BluetoothPhnClSwSta "Audio_BluetoothPhoneCallSwitchStatus";
CM_ SG_ 3221225472 Audio_ModSwSta "Audio_ModeSwitchStatus";
CM_ SG_ 3221225472 Audio_MutSwSta "Audio_MuteSwitchStatus";
CM_ SG_ 3221225472 Audio_SeekDnSwSta "Audio_SeekDownSwitchStatus";
CM_ SG_ 3221225472 Audio_SeekUpSwSta "Audio_SeekUpSwitchStatus";
CM_ SG_ 3221225472 Cluster_ModeSwSta "Cluster_ModeSwitchStatus";
CM_ SG_ 3221225472 Cluster_ScrlOkSwSta "Cluster_ScrollOkSwitchStatus";
CM_ SG_ 3221225472 Audio_CustomSwSta "Audio_CustomSwitchStatus";
CM_ SG_ 3221225472 USM_CmdWPCSta "USM_CommandWPCStatus";
CM_ SG_ 3221225472 WPC_PhnLftWrngSta "WPC_PhoneLeftWarningStatus";
CM_ SG_ 3221225472 WPC_NFCDeviceDetSta "NFC Device on WPC  detection status 
if NFC device is not on WPC, then the pre-authetication would be canceled.";
CM_ SG_ 3221225472 SMK_Crc2Val "SMK_CyclicRedundancyCheck2Value";
CM_ SG_ 3221225472 SMK_AlvCnt2Val "SMK_AliveCounter2Value";
CM_ SG_ 3221225472 SSB_StrtStpBtnSw1Sta "SSB_StartStopButtonSwitch1Status ##2G##SMK - SMKmsg19 - C_SSBSW1";
CM_ SG_ 3221225472 SSB_StrtStpBtnSw2Sta "SSB_StartStopButtonSwitch2Status ##2G##SMK - SMKmsg19 - C_SSBSW2";
CM_ SG_ 3221225472 SMK_TrmnlCtrlSta "SMK_TerminalControlStatus ##2G##SMK - SMKmsg19 - C_TerminalControlState";
CM_ SG_ 3221225472 SMK_TrmnlMngrSta "SMK_TerminalManagerStatus ##2G##SMK - SMKmsg19 - C_TerminalsManagerState";
CM_ SG_ 3221225472 SMK_AuthSta "SMK_AuthentificationStatus ##2G##SMK - SMKmsg18 - C_AuthState";
CM_ SG_ 3221225472 SMK_Ign1InSta "SMK_Ign1InputStatus ##2G##SMK - SMKmsg19 - C_Ign1SMK";
CM_ SG_ 3221225472 SMK_Ign1RlySta "SMK_Ign1RelayStatus ##2G##SMK - SMKmsg19 - C_Ign1RelayState";
CM_ SG_ 3221225472 SMK_Ign2InSta "SMK_Ign2InputStatus ##2G##SMK - SMKmsg19 - C_Ign2SMK";
CM_ SG_ 3221225472 SMK_Ign2RlySta "SMK_Ign2RelayStatus ##2G##SMK - SMKmsg19 - C_Ign2RelayState";
CM_ SG_ 3221225472 SMK_StrtFdbckSta "SMK_StartFeedbackStatus ##2G##SMK - SMKmsg19 - C_StartFeedback";
CM_ SG_ 3221225472 SMK_StrtrRlyOutSta "SMK_StarterRelayOutputStatus ##2G##SMK - SMKmsg18 - C_StarterRlyState";
CM_ SG_ 3221225472 SMK_AccInSta "SMK_AccInputStatus ##2G##SMK - SMKmsg19 - C_AccSMK";
CM_ SG_ 3221225472 SMK_AccRlySta "SMK_AccRelayStatus ##2G##SMK - SMKmsg19 - C_AccRelayStatus";
CM_ SG_ 3221225472 SMK_CLUAccIndOnReq "SMK_ClusterACCIndicatorOnRequest ##2G##SMK - SMKmsg19 - C_AccINDforCLU";
CM_ SG_ 3221225472 SMK_TlEngRunSta "SMK_TeleEngineRunStatus ##2G##SMK - SMKmsg18 - C_SMKTeleEngineRunning";
CM_ SG_ 3221225472 SMK_TlCrnkModSta "SMK_TeleCrankingModeStatus ##2G##SMK - SMKmsg18 - C_SMKTeleCrankingState";
CM_ SG_ 3221225472 ILCU_LH_Crc2Val "ILCU_LH_CyclicRedundancyCheck2Value";
CM_ SG_ 3221225472 ILCU_LH_AlvCnt2Val "ILCU_LH_AliveCounter2Value";
CM_ SG_ 3221225472 ILCULH_HeightSnsrFront_Val "Front Vehicle Height Sensor output";
CM_ SG_ 3221225472 ILCULH_HeightSnsrFront_Stat "Front Vehicle Height Sensor status feedback";
CM_ SG_ 3221225472 ILCULH_LevelActuator_Sta "LH leveling actuator status";
CM_ SG_ 3221225472 SMK_Crc6Val "SMK_CyclicRedundancyCheck6Value";
CM_ SG_ 3221225472 SMK_AlvCnt6Val "SMK_AliveCounter6Value";
CM_ SG_ 3221225472 Lamp_HzrdBlnkngSta "Lamp_HazardBlinkingStatus ##2G##SMK - SMKmsg17 - C_HazardFromSMK";
CM_ SG_ 3221225472 Lamp_SmrtWlcmLtOnReq "Lamp_SmartWelcomeLightOnRequest ##2G##SMK - SMKmsg17 - C_WlightOn";
CM_ SG_ 3221225472 Fob_BattStaInfo "Fob_BatteryStatusInformation ##2G##SMK - SMKmsg17 - C_FOBBatteryStatusInfo";
CM_ SG_ 3221225472 Fob_FoundDrvWlcmArea "Fob_FoundDriverWelcomeArea ##2G##SMK - SMKmsg17 - C_WelcomeFobFoundDrv";
CM_ SG_ 3221225472 Fob_FoundAsstWlcmArea "Fob_FoundAssistWelcomeArea ##2G##SMK - SMKmsg17 - C_WelcomeFobFoundAst";
CM_ SG_ 3221225472 Fob_FoundExtrnlArea "Fob_FoundExternalArea ##2G##SMK - SMKmsg18 - C_ExtFobPos";
CM_ SG_ 3221225472 Fob_FoundIntArea "Fob_FoundInternalArea ##2G##SMK - SMKmsg18 - C_IntFobPos";
CM_ SG_ 3221225472 Fob_LearntSta "Fob_LearntStatus ##2G##SMK - SMKmsg18 - C_FobLearntState";
CM_ SG_ 3221225472 LFAnt_FltSta "LFAntenna_FaultSatus ##2G##SMK - SMKmsg18 - C_LFANTState";
CM_ SG_ 3221225472 LFAnt_SrchSta "LFAntenna_SearchingStatus ##2G##SMK - SMKmsg19 - C_LFSearchingOn";
CM_ SG_ 3221225472 RSPA_ModSta_SMK "RSPA_ModeStatus ##2G##SMK - SMKmsg18 - C_SMKRSPAMode";
CM_ SG_ 3221225472 RSPA_FobBattSta "RSPA_FobBatteryStatus ##2G##SMK - SMKmsg18 - C_FobBATState";
CM_ SG_ 3221225472 USM_SmrtTrnkTlgtModSta "USM_SmartTunkTailgateModeStatus ##2G##SMK - SMKmsg20 - C_HfreeTrunkTgRValue";
CM_ SG_ 3221225472 USM_WALModSta "USM_WalkAwayLockModeStatus ##2G##SMK - SMKmsg20 - C_WALRValue";
CM_ SG_ 3221225472 BCM_Crc12Val "BCM_CyclicRedundancyCheck12Value";
CM_ SG_ 3221225472 BCM_AlvCnt12Val "BCM_AliveCounter12Value";
CM_ SG_ 3221225472 BCM_CntryConfgTyp "BCM_CountryConfigurationType ##2G##BCM - BCMmsg17 - C_CountryCfg";
CM_ SG_ 3221225472 BCM_SmkOptTyp "BCM_SmkOptionType ##2G##BCM - BCMmsg17 - C_SMKOption";
CM_ SG_ 3221225472 Window_DrvrSdWdwSta_BCM "Window_DriverSideWindowStatus ##2G##BCM - BCMmsg22 - C_DrvWindowOpenState";
CM_ SG_ 3221225472 Window_AsstSdWdwSta_BCM "Window_AssistantSideWindowStatus ##2G##BCM - BCMmsg22 - C_AstWindowOpenState";
CM_ SG_ 3221225472 Window_RrLftWdwSta_BCM "Window_RearLeftWindowStatus ##2G##BCM - BCMmsg22 - C_RLWindowOpenState";
CM_ SG_ 3221225472 Window_RrRtWdwSta_BCM "Window_RearRightPowerWindowStatus ##2G##BCM - BCMmsg22 - C_RRWindowOpenState";
CM_ SG_ 3221225472 Window_TunlModAutoIndSta "Window_TunnelModeAutoIndicatorStatus ##2G##BCM - BCMmsg25 - C_TunnelIND";
CM_ SG_ 3221225472 ACU_Crc2Val "ACU_CyclicRedundancyCheck2Value";
CM_ SG_ 3221225472 ACU_AlvCnt2Val "ACU_AliveCounter2Value";
CM_ SG_ 3221225472 ACU_CrshActvSta "ACU_CrashActiveStatus ##2G##ACU - ACU13 - CF_Acu_CshAct";
CM_ SG_ 3221225472 APSS_SldTch "APSS_SlideTouch";
CM_ SG_ 3221225472 APSS_RclTch "APSS_ReclinerTouch";
CM_ SG_ 3221225472 APSS_LmbrTch "APSS_LumbarTouch";
CM_ SG_ 3221225472 ALU_LumbarUpSw "ALU_LumbarUppperSwitch";
CM_ SG_ 3221225472 ALU_LumbarMidSw "ALU_LumbarMidSwitch";
CM_ SG_ 3221225472 ALU_LumbarLowSw "ALU_LumbarLowerSwitch";
CM_ SG_ 3221225472 ALU_LumbarDefSw "ALU_LumbarDeflationSwitch";
CM_ SG_ 3221225472 MLM_MdLmpBrgtnsVal "USM request value for mood lamp bright setting";
CM_ SG_ 3221225472 MLM_MdLmpDrvngVal "USM request value for mood lamp driving interlock";
CM_ SG_ 3221225472 MLM_MdLmpRedVal "Request for mood lamp color(Red)";
CM_ SG_ 3221225472 MLM_MdLmpGreenVal "Request for mood lamp color(Green)";
CM_ SG_ 3221225472 MLM_MdLmpBlueVal "Request for mood lamp color(Blue)";
CM_ SG_ 3221225472 ILCU_RH_Crc2Val "ILCU_RH_CyclicRedundancyCheck2Value";
CM_ SG_ 3221225472 ILCU_RH_AlvCnt2Val "ILCU_RH_AliveCounter2Value";
CM_ SG_ 3221225472 ILCURH_HeightSnsrFront_Val "Rear Vehicle Height Sensor output";
CM_ SG_ 3221225472 ILCURH_HeightSnsrFront_Stat "Rear Vehicle Height Sensor status feedback";
CM_ SG_ 3221225472 ILCURH_LevelActuator_Sta "RH leveling actuator status";
CM_ SG_ 3221225472 SMK_Crc3Val "SMK_CyclicRedundancyCheck3Value";
CM_ SG_ 3221225472 SMK_AlvCnt3Val "SMK_AliveCounter3Value";
CM_ SG_ 3221225472 ESCL_EsclMngrSta "ESCL_EsclManagerStatus ##2G##SMK - SMKmsg19 - C_EsclManagerState";
CM_ SG_ 3221225472 ESCL_EsclPwrSupSta "ESCL_EsclPowerSupplyStatus ##2G##SMK - SMKmsg19 - C_EsclPowerSupplystatus";
CM_ SG_ 3221225472 ESCL_EsclEnaSta "ESCL_EsclEnableStatus ##2G##SMK - SMKmsg19 - C_EsclEnableStatus";
CM_ SG_ 3221225472 ESCL_EsclUnitSta "ESCL_EsclUnitStatus ##2G##SMK - SMKmsg19 - C_EsclUnitStatus";
CM_ SG_ 3221225472 ESCL_EsclBoltSta "ESCL_EsclBoltStatus ##2G##SMK - SMKmsg19 - C_EsclBoltStatus";
CM_ SG_ 3221225472 ESCL_EsclLoBattSta "ESCL_EsclLowBatteryStatus ##2G##SMK - SMKmsg19 - C_EsclLowBat";
CM_ SG_ 3221225472 ESCL_EsclUnLkSwSta "ESCL_UnLockSwitchStatus ##2G##SMK - SMKmsg19 - C_EsclUnlock";
CM_ SG_ 3221225472 PFSU_RL_Folding_SW "PFSU Rear Left Folding Switch";
CM_ SG_ 3221225472 PFSU_RR_Folding_SW "PFSU Rear Right Folding Switch";
CM_ SG_ 3221225472 PFSU_RL_Unfolding_SW "PFSU Rear Left Unfolding Switch";
CM_ SG_ 3221225472 PFSU_RR_Unfolding_SW "PFSU Rear Right Unfolding Switch";
CM_ SG_ 3221225472 RR_SHVU_SeatOptSta "Rear RH Seat Heater/Vent option info";
CM_ SG_ 3221225472 RR_SHVU_SeatHtOperSta "Rear RH Seat Heater/Vent current operation state";
CM_ SG_ 3221225472 IAU_EncryptedResult1Val "This signal is for a send enrypted result of IAU.";
CM_ SG_ 3221225472 APSU_AstStSldFwdDis "APSU_AssistSlideForwardDisplay";
CM_ SG_ 3221225472 APSU_AstStSldBckwdDis "APSU_AssistSlideBackwardSwitchDisplay";
CM_ SG_ 3221225472 APSU_AstStReclneFwdDis "APSU_AssistSeatReclineForwardSwitchDisplay";
CM_ SG_ 3221225472 APSU_AstStReclneBckwdDis "APSU_AssistSeatReclineBackwardSwitchDisplay";
CM_ SG_ 3221225472 APSU_AstStTiltUpDis "APSU_AssistTiltUpSwitchDisplay";
CM_ SG_ 3221225472 APSU_AstStTiltDnDis "APSU_AssistTiltDownSwitchDisplay";
CM_ SG_ 3221225472 APSU_AstStHghtUpDis "APSU_AssistHeightUpSwitchDisplay";
CM_ SG_ 3221225472 APSU_AstStHghtDnDis "APSU_AssistHeightDownSwitchDisplay";
CM_ SG_ 3221225472 APSU_AstStLmbrDefDis "APSU_AssistLumbarDeFlateSwitchDisplay";
CM_ SG_ 3221225472 APSU_AstStLmbrLoDis "APSU_AssistLumbarLowSwitchDisplay";
CM_ SG_ 3221225472 APSU_AstStLmbrMdlDis "APSU_AssistLumbarMiddleSwitchDisplay";
CM_ SG_ 3221225472 APSU_AstStLmbrUpDis "APSU_AssistLumbarUpSwitchDisplay";
CM_ SG_ 3221225472 APSU_LmbrSigSrcTyp "Lumbar Switch Signal Source(TX)";
CM_ SG_ 3221225472 DLBCU_CushInfDis "DLBCU_CushionInflationDisplay";
CM_ SG_ 3221225472 DLBCU_CushDefDis "DLBCU_CushionDeflationDisplay";
CM_ SG_ 3221225472 ICSC_Crc2Val "ICSC_CyclicRedundancyCheck2Value";
CM_ SG_ 3221225472 ICSC_AlvCnt2Val "ICSC_AliveCounter2Value";
CM_ SG_ 3221225472 DMIC_DrvModSta "DMIC_DriveModeStatus ##2G##ICSC - IVSS11 - DrivingModeState";
CM_ SG_ 3221225472 DMIC_SmtShftModSta "DMIC_SmartShiftModeStatus ##2G##ICSC - IVSS11 - SMART_SHIFT_MODE";
CM_ SG_ 3221225472 DMIC_EngModSta "DMIC_EngineModeStatus ##2G##ICSC - IVSS11 - MODE_ENG";
CM_ SG_ 3221225472 DMIC_TmModSta "DMIC_TmModeStatus ##2G##ICSC - IVSS11 - MODE_TM";
CM_ SG_ 3221225472 DMIC_AwdModSta "DMIC_AwdModeStatus ##2G##ICSC - IVSS11 - MODE_4WD";
CM_ SG_ 3221225472 APSU_AstStEsyAcsUSMSta "USM_MovingValue";
CM_ SG_ 3221225472 APSU_AutoHtrCtrlUSMSta "Auto Down Seat Heater (USM Setting)";
CM_ SG_ 3221225472 DLBCU_LumbarUpDis "DLBCU_LumbarUppperDisplay";
CM_ SG_ 3221225472 DLBCU_LumbarMidDis "DLBCU_LumbarMidDisplay";
CM_ SG_ 3221225472 DLBCU_LumbarLowDis "DLBCU_LumbarLowerDisplay";
CM_ SG_ 3221225472 DLBCU_LumbarDefDis "DLBCU_LumbarDeflationDisplay";
CM_ SG_ 3221225472 DLBCU_BolsterInfDis "DLBCU_BolsterInflationDisplay";
CM_ SG_ 3221225472 DLBCU_BolsterDefDis "DLBCU_BolsterDeflationDisplay";
CM_ SG_ 3221225472 DPSS_LumbarUpSw "DPSS_LumbarUpMoveSwitch";
CM_ SG_ 3221225472 DPSS_LumbarMidSw "DPSS_LumbarMiddleSwitch";
CM_ SG_ 3221225472 DPSS_LumbarLowSw "DPSS_LumbarLowerSwitch";
CM_ SG_ 3221225472 DPSS_LumbarDefSw "DPSS_LumbarDeflationSwitch";
CM_ SG_ 3221225472 DPSS_BolsterInfSw "DPSS_BolsterInflationSwitch";
CM_ SG_ 3221225472 DPSS_BolsterDefSw "DPSS_BolsterDeflationSwitch";
CM_ SG_ 3221225472 DPSS_ActiveSw "DPSS_ActiveSwitch";
CM_ SG_ 3221225472 DPSS_SldTch "DPSS_SlideTouch";
CM_ SG_ 3221225472 DPSS_RclTch "DPSS_ReclinerTouch";
CM_ SG_ 3221225472 DPSS_ExtTch "DPSS_ExtensionTouch";
CM_ SG_ 3221225472 DPSS_LmbrTch "DPSS_LumbarTouch";
CM_ SG_ 3221225472 DPSS_CushOnOffTch "DPSS_CushOnOffTouch";
CM_ SG_ 3221225472 ACU_ActvFltSta "ACU_ActiveFaultStatus ##2G##ACU - ACU11 - CF_Acu_FltStat";
CM_ SG_ 3221225472 ACU_SdArbgExtTyp "ACU_SideAirbagExistanceType ##2G##ACU - ACU11 - CF_Acu_ExtOfSab";
CM_ SG_ 3221225472 DPSS_StExtFwdMvBtn "DPSS_ExtensionForwardMoveButton";
CM_ SG_ 3221225472 DPSS_StExtBwdMvBtn "DPSS_ExtensionBackwardMoveButton";
CM_ SG_ 3221225472 DPSS_StSldFwdMvBtn "DPSS_SlideForwardMoveButton";
CM_ SG_ 3221225472 DPSS_StSldBwdMvBtn "DPSS_SlideBackwardMoveButton";
CM_ SG_ 3221225472 DPSS_StRclFwdMvBtn "DPSS_ReclinerForwardMoveButton";
CM_ SG_ 3221225472 DPSS_StRclBwdMvBtn "DPSS_ReclinerBackwardMoveButton";
CM_ SG_ 3221225472 DPSS_StHgtUpMvBtn "DPSS_HeightUpMoveButton";
CM_ SG_ 3221225472 DPSS_StHgtDnMvBtn "DPSS_HeightDownMoveButton";
CM_ SG_ 3221225472 DPSS_StTltUpMvBtn "DPSS_TiltUpMoveButton";
CM_ SG_ 3221225472 DPSS_StTltDnMvBtn "DPSS_TiltDownMoveButton";
CM_ SG_ 3221225472 Window_RrLftWdwSwSta "Windiw_RearLeftWindowSwitchStatus ##2G##BCM - BCMmsg26 - C_RLWdwSwState";
CM_ SG_ 3221225472 Window_RrRtWdwSwSta "Windiw_ReaRightWindowSwitchStatus ##2G##BCM - BCMmsg26 - C_RRWdwSwState";
CM_ SG_ 3221225472 SMK_Crc9Val "SMK_CyclicRedundancyCheck9Value";
CM_ SG_ 3221225472 SMK_AlvCnt9Val "SMK_AliveCounter9Value";
CM_ SG_ 3221225472 Auth_EncryptRespData2 "Authentication_EncryptionResponseData2";
CM_ SG_ 3221225472 SMK_Crc10Val "SMK_CyclicRedundancyCheck10Value";
CM_ SG_ 3221225472 SMK_AlvCnt10Val "SMK_AliveCounter10Value";
CM_ SG_ 3221225472 Auth_EncryptRespData3 "Authentication_EncryptionResponseData3";
CM_ SG_ 3221225472 SMK_Crc7Val "SMK_CyclicRedundancyCheck7Value";
CM_ SG_ 3221225472 SMK_AlvCnt7Val "SMK_AliveCounter7Value";
CM_ SG_ 3221225472 Auth_RndNum "Authentication_RandomNumber ##2G##SMK - SMKmsg03 - C_SMK_Random";
CM_ SG_ 3221225472 ACU_Crc1Val "ACU_CyclicRedundancyCheck1Value";
CM_ SG_ 3221225472 ACU_AlvCnt1Val "ACU_AliveCounter1Value";
CM_ SG_ 3221225472 ACU_SysWrngLmpDis "ACU_SystemWarningLampDisplay ##2G##ACU - ACU14 - CF_SWL_Ind";
CM_ SG_ 3221225472 ACU_TlltlLmpDis "ACU_TelltaleLampDisplay ##2G##ACU - ACU14 - CF_TTL_Ind";
CM_ SG_ 3221225472 ACU_OdsIDReq "ACU_OdsIDRequest ##2G##ACU - ACU11 - CF_Ods_IDRcv";
CM_ SG_ 3221225472 SeatBelt_PassBcklFltSta "SeatBelt_PassengerBuckleFaultStatus ##2G##ACU - ACU11 - CF_PasBkl_FltStat";
CM_ SG_ 3221225472 SeatBelt_DrvrBcklFltSta "SeatBelt_DriverBuckleFaultStatus ##2G##ACU - ACU11 - CF_DriBkl_FltStat";
CM_ SG_ 3221225472 SeatBelt_PassBcklSta "SeatBelt_PassengerBuckleStatus ##2G##ACU - ACU11 - CF_PasBkl_Stat";
CM_ SG_ 3221225472 SeatBelt_DrvrBcklSta "SeatBelt_DriverBuckleStatus ##2G##ACU - ACU11 - CF_DriBkl_Stat";
CM_ SG_ 3221225472 ACU_DiagTrblCodVal "ACU_DiagnosticTroubleCodeValue ##2G##ACU - ACU11 - CF_Acu_Dtc";
CM_ SG_ 3221225472 ACU_FltNumVal "ACU_FaultNumberValue ##2G##ACU - ACU11 - CF_Acu_NumOfFlt";
CM_ SG_ 3221225472 SMK_Crc8Val "SMK_CyclicRedundancyCheck8Value";
CM_ SG_ 3221225472 SMK_AlvCnt8Val "SMK_AliveCounter8Value";
CM_ SG_ 3221225472 Auth_EncryptRespData1 "Authentication_EncryptionResponseData1";
CM_ SG_ 3221225472 CLU_Crc11Val "CLU_CyclicRedundancyCheck11Value";
CM_ SG_ 3221225472 CLU_ICUDlvrModOffSetReq "CLU_ICUDeliveryModeOffSetRequest";
CM_ SG_ 3221225472 CLU_SMKKeyOutWarnOffReq "CLU_SMKKeyOutWarningOffRequest";
CM_ SG_ 3221225472 CLU_DrvngLampChgnSta "CLU_DrivingModeLampChangingStatus";
CM_ SG_ 3221225472 FR_SHVU_SeatOptSta "Front Right Seat Heater/Vent option info";
CM_ SG_ 3221225472 FR_SHVU_SeatHtOperSta "Front Right Seat Heater/Vent current operation state";
CM_ SG_ 3221225472 FR_SHVU_HtSwHiIndSta "Front Right_Seat Heater Switch High Indicator Status";
CM_ SG_ 3221225472 FR_SHVU_HtSwMidIndSta "Front Right_Seat Heater Switch Mid Indicator Status";
CM_ SG_ 3221225472 FR_SHVU_HtSwLowIndSta "Front Right_Seat Heater Switch Low Indicator Status";
CM_ SG_ 3221225472 FR_SHVU_VntSwHiIndSta "Front Right_Seat Vent Switch High Indicator Status";
CM_ SG_ 3221225472 FR_SHVU_VntSwMidIndSta "Front Right_Seat Vent Switch Mid Indicator Status";
CM_ SG_ 3221225472 FR_SHVU_VntSwLowIndSta "Front Right_Seat Vent Switch Low Indicator Status";
CM_ SG_ 3221225472 SCC_DrvOvrRidSta "SCC_DriverOverRideStatus ##2G##EMS - EMS15 - ECGPOvrd";
CM_ SG_ 3221225472 SCC_SccFlrDetSta "SCC_SccFailureDetectStatus ##2G##EMS - EMS15 - QECACC";
CM_ SG_ 3221225472 SCC_FuncFlrDetSta "SCC_FunctionFailureDetectStatus ##2G##EMS - EMS15 - ECFail";
CM_ SG_ 3221225472 SCC_SccOffStaDetSta "SCC_SccOffConditionDetectStatus ##2G##EMS - EMS15 - SwitchOffCondExt";
CM_ SG_ 3221225472 SCC_BrkLtSwFlrDetSta "SCC_BrakeLightSwFailureDetectStatus ##2G##EMS - EMS15 - BLECFail";
CM_ SG_ 3221225472 ISA_IsaFuncSta "ISA_IntelligentSpeedAssistanceFunctionStatus ##2G##EMS - EMS15 - CF_Ems_IsaAct";
CM_ SG_ 3221225472 SCC_StrtLimFuncSta "SCC_StartLimitFunctionStatus ##2G##EMS - EMS15 - CF_EMS_Start_Limitation";
CM_ SG_ 3221225472 EMS_SafetyFunctSta "SCC_SafetyFunctionStatus ##2G##EMS - EMS15 - CF_EMS_SAFETY_FUNCTION";
CM_ SG_ 3221225472 InAirTempVal "SCC_IntakeAirTemperatureValue ##2G##EMS - EMS15 - IntAirTemp";
CM_ SG_ 3221225472 OBD_RbmSta "OBD_RateBasedMonitoringStatus ##2G##EMS - EMS15 - STATE_DC_OBD";
CM_ SG_ 3221225472 OBD_IgnCycCntVal "OBD_IgnitionCycleCounterValue ##2G##EMS - EMS15 - CTR_IG_CYC_OBD";
CM_ SG_ 3221225472 OBD_DnmntrCalcVal "OBD_DenominatorCalculationValue ##2G##EMS - EMS15 - CTR_CDN_OBD";
CM_ SG_ 3221225472 TCU_NetrlCtrlSta "TCU_NeutralControlStatus";
CM_ SG_ 3221225472 TCU_ShftPtrnSta "TCU_ShiftPatternStatus";
CM_ SG_ 3221225472 TCU_VgisInhbtReq "TCU_VgisInhibitionRequest";
CM_ SG_ 3221225472 TCU_EngTqIncReqVal "TCU_EngineTorqueIncreaseReqValue";
CM_ SG_ 3221225472 SCR_LvlWrngLmpSta "SCR_LevelWarningLampStatus ##2G##EMS - EMS21 - SCR_LEVEL_WARN_LAMP";
CM_ SG_ 3221225472 SCR_LvlWrngMsgDis "SCR_LevelWarningMessageDisplay ##2G##EMS - EMS21 - SCR_LEVEL_WARN";
BA_DEF_ BO_  "UsrMsgIDSforwardDeviation" INT 0 100;
BA_DEF_ BO_  "UsrMsgIDSbackwardDeviation" INT 50 1000;
BA_DEF_  "BusType" STRING ;
BA_DEF_  "DBName" STRING ;
BA_DEF_  "Baudrate" INT 50000 1000000;
BA_DEF_  "GenEnvVarEndingDsp" STRING ;
BA_DEF_  "GenEnvVarEndingSnd" STRING ;
BA_DEF_  "GenEnvVarPrefix" STRING ;
BA_DEF_  "GenNWMApBusSleep" STRING ;
BA_DEF_  "GenNWMApCanNormal" STRING ;
BA_DEF_  "GenNWMApCanOff" STRING ;
BA_DEF_  "GenNWMApCanOn" STRING ;
BA_DEF_  "GenNWMApCanSleep" STRING ;
BA_DEF_  "GenNWMApCanWakeUp" STRING ;
BA_DEF_  "GenNWMGotoMode_Awake" STRING ;
BA_DEF_  "GenNWMGotoMode_BusSleep" STRING ;
BA_DEF_  "GenNWMSleepTime" INT 1375 1650;
BA_DEF_  "GenNWMTalkNM" STRING ;
BA_DEF_  "Manufacturer" STRING ;
BA_DEF_  "NmBaseAddress" HEX 0 2047;
BA_DEF_  "NmMessageCount" INT 0 128;
BA_DEF_  "NmType" STRING ;
BA_DEF_  "SamplePointMax" INT 50 85;
BA_DEF_  "SamplePointMin" INT 55 85;
BA_DEF_  "SyncJumpWidthMax" INT 1 8;
BA_DEF_  "SyncJumpWidthMin" INT 1 4;
BA_DEF_  "VersionDay" INT 1 31;
BA_DEF_  "VersionMonth" INT 1 12;
BA_DEF_  "VersionWeek" INT 1 53;
BA_DEF_  "VersionYear" INT 0 9999;
BA_DEF_ BU_  "NmStationAddress" HEX 0 127;
BA_DEF_ BU_  "NmNode" ENUM  "No","Yes";
BA_DEF_ BU_  "GenNodSleepTime" INT 1375 1650;
BA_DEF_ BU_  "ILUsed" ENUM  "No","Yes";
BA_DEF_ BU_  "NmCAN" INT 1 2;
BA_DEF_ BU_  "NodeLayerModules" STRING ;
BA_DEF_ BU_  "NWM_Knoten" ENUM  "No","Yes";
BA_DEF_ BO_  "GenMsgCycleTime" INT 0 2000;
BA_DEF_ BO_  "GenMsgStartDelayTime" INT 0 2000;
BA_DEF_ BO_  "GenMsgSendType" ENUM  "Cyclic ","NotUsed ","NotUsed ","NotUsed ","NotUsed ","NotUsed ","NotUsed ","IfActive ","NoMsgSendType ","NotUsed","vector_leerstring";
BA_DEF_ BO_  "GenMsgCycleTimeFast" INT 0 500;
BA_DEF_ BO_  "GenMsgILSupport" ENUM  "No","Yes";
BA_DEF_ BO_  "GenMsgNrOfRepetition" INT 0 3;
BA_DEF_ BO_  "VFrameFormat" ENUM  "StandardCAN","ExtendedCAN","reserved","reserved","reserved","reserved","reserved","reserved","reserved","reserved","reserved","reserved","reserved","reserved","StandardCAN_FD","ExtendedCAN_FD";
BA_DEF_ SG_  "UserSigValidity" ENUM  "B+","ACC","IG","IG1","IG2","IG3","IG1 or IG2","IG1 or IG3","Undef";
BA_DEF_ SG_  "GenSigTimeoutTime" INT 0 7000;
BA_DEF_ SG_  "UsrSigTimeoutValue" STRING ;
BA_DEF_ SG_  "UsrSigPurpose" ENUM  "Undef","FN","DIAG","DEV","NM";
BA_DEF_ SG_  "GenSigStartValue" INT 0 1215752192;
BA_DEF_ SG_  "NetworkRequest" ENUM  "Yes","No";
BA_DEF_ SG_  "NetworkRequestHoldingTime" INT 0 65535;
BA_DEF_ SG_  "Description" STRING ;
BA_DEF_ SG_  "Version" STRING ;
BA_DEF_ SG_  "GenSigEnvVarType" ENUM  "Int","Float","Undef";
BA_DEF_ SG_  "GenSigSendType" ENUM  "Cyclic			","OnWrite			","OnWriteWithRepetition			","OnChange			","OnChangeWithRepetition			","IfActive			","IfActiveWithRepetition			","NoSigSendType			","OnChangeAndIfActive			","OnChangeAndIfActiveWithRepetition";
BA_DEF_ SG_  "GwSigLatencyTime" INT 0 65536;
BA_DEF_ SG_  "GwSigMissingSourceType" ENUM  "Undef","OldValue","DefaultValue","InitialValue";
BA_DEF_ SG_  "NWM-WakeupAllowed" ENUM  "<n.a.>";
BA_DEF_ SG_  "RoutingFactor" INT 1 1215752192;
BA_DEF_DEF_  "UsrMsgIDSforwardDeviation" 10;
BA_DEF_DEF_  "UsrMsgIDSbackwardDeviation" 100;
BA_DEF_DEF_  "BusType" "CAN";
BA_DEF_DEF_  "DBName" "";
BA_DEF_DEF_  "Baudrate" 500000;
BA_DEF_DEF_  "GenEnvVarEndingDsp" "Dsp_";
BA_DEF_DEF_  "GenEnvVarEndingSnd" "_";
BA_DEF_DEF_  "GenEnvVarPrefix" "Env";
BA_DEF_DEF_  "GenNWMApBusSleep" "AppNmCanBusSleep()";
BA_DEF_DEF_  "GenNWMApCanNormal" "AppNmCanNormal()";
BA_DEF_DEF_  "GenNWMApCanOff" "ApplCanOffline()";
BA_DEF_DEF_  "GenNWMApCanOn" "ApplCanOnline()";
BA_DEF_DEF_  "GenNWMApCanSleep" "ApplNmCanSleep()";
BA_DEF_DEF_  "GenNWMApCanWakeUp" "ApplCanWakeUp()";
BA_DEF_DEF_  "GenNWMGotoMode_Awake" "GotoMode_Awake()";
BA_DEF_DEF_  "GenNWMGotoMode_BusSleep" "GotoMode_BusSleep()";
BA_DEF_DEF_  "GenNWMSleepTime" 1500;
BA_DEF_DEF_  "GenNWMTalkNM" "TalkNM()";
BA_DEF_DEF_  "Manufacturer" "HMC";
BA_DEF_DEF_  "NmBaseAddress" 1280;
BA_DEF_DEF_  "NmMessageCount" 0;
BA_DEF_DEF_  "NmType" "Vector";
BA_DEF_DEF_  "SamplePointMax" 80;
BA_DEF_DEF_  "SamplePointMin" 80;
BA_DEF_DEF_  "SyncJumpWidthMax" 3;
BA_DEF_DEF_  "SyncJumpWidthMin" 2;
BA_DEF_DEF_  "VersionDay" 1;
BA_DEF_DEF_  "VersionMonth" 1;
BA_DEF_DEF_  "VersionWeek" 1;
BA_DEF_DEF_  "VersionYear" 0;
BA_DEF_DEF_  "NmStationAddress" 0;
BA_DEF_DEF_  "NmNode" "Yes";
BA_DEF_DEF_  "GenNodSleepTime" 1500;
BA_DEF_DEF_  "ILUsed" "Yes";
BA_DEF_DEF_  "NmCAN" 1;
BA_DEF_DEF_  "NodeLayerModules" "oseknm01.dll";
BA_DEF_DEF_  "NWM_Knoten" "Yes";
BA_DEF_DEF_  "GenMsgCycleTime" 200;
BA_DEF_DEF_  "GenMsgStartDelayTime" 0;
BA_DEF_DEF_  "GenMsgSendType" "NoMsgSendType ";
BA_DEF_DEF_  "GenMsgCycleTimeFast" 40;
BA_DEF_DEF_  "GenMsgILSupport" "Yes";
BA_DEF_DEF_  "GenMsgNrOfRepetition" 3;
BA_DEF_DEF_  "VFrameFormat" "StandardCAN";
BA_DEF_DEF_  "UserSigValidity" "IG";
BA_DEF_DEF_  "GenSigTimeoutTime" 500;
BA_DEF_DEF_  "UsrSigTimeoutValue" "Undef";
BA_DEF_DEF_  "UsrSigPurpose" "FN";
BA_DEF_DEF_  "GenSigStartValue" 0;
BA_DEF_DEF_  "NetworkRequest" "No";
BA_DEF_DEF_  "NetworkRequestHoldingTime" 0;
BA_DEF_DEF_  "Description" "";
BA_DEF_DEF_  "Version" "";
BA_DEF_DEF_  "GenSigEnvVarType" "Undef";
BA_DEF_DEF_  "GenSigSendType" "NoSigSendType			";
BA_DEF_DEF_  "GwSigLatencyTime" 40;
BA_DEF_DEF_  "GwSigMissingSourceType" "Undef";
BA_DEF_DEF_  "NWM-WakeupAllowed" "<n.a.>";
BA_DEF_DEF_  "RoutingFactor" 1;
BA_ "VersionDay" 18;
BA_ "VersionMonth" 5;
BA_ "VersionYear" 2018;
BA_ "VersionWeek" 20;
BA_ "NmMessageCount" 128;
BA_ "DBName" "CAN";
BA_ "NmStationAddress" BU_ MLM 41;
BA_ "NmStationAddress" BU_ ILCU_RH 55;
BA_ "NmStationAddress" BU_ MFSW 5;
BA_ "NmStationAddress" BU_ DPSU 56;
BA_ "NmStationAddress" BU_ ILCU_LH 54;
BA_ "NmStationAddress" BU_ PSB 65;
BA_ "NmStationAddress" BU_ APSU 49;
BA_ "NmStationAddress" BU_ DPSS 57;
BA_ "NmStationAddress" BU_ SWRC 8;
BA_ "NmStationAddress" BU_ CGW 22;
BA_ "NmStationAddress" BU_ PTGM 11;
BA_ "NmStationAddress" BU_ DLBCU 64;
BA_ "NmStationAddress" BU_ SCM 7;
BA_ "NmStationAddress" BU_ DAU 2;
BA_ "NmStationAddress" BU_ WPC 30;
BA_ "NmStationAddress" BU_ IAU 44;
BA_ "NmNode" BU_ eCall 0;
BA_ "NmStationAddress" BU_ PFSU 45;
BA_ "NmStationAddress" BU_ RDC 47;
BA_ "NmStationAddress" BU_ PSM 6;
BA_ "UserSigValidity" SG_ 3221225472 IFS_HllAngle_RH 0;
BA_ "GenSigTimeoutTime" SG_ 3221225472 IFS_HllAngle_RH 1500;
BA_ "NetworkRequest" SG_ 3221225472 IFS_HllAngle_RH 0;
BA_ "NetworkRequestHoldingTime" SG_ 3221225472 IFS_HllAngle_RH 5000;
BA_ "Version" SG_ 3221225472 IFS_HllAngle_RH "17.12.02";
BA_ "GenSigSendType" SG_ 3221225472 IFS_HllAngle_RH 0;
BA_ "UserSigValidity" SG_ 3221225472 IFS_10Ch_Stat_RH 0;
BA_ "GenSigTimeoutTime" SG_ 3221225472 IFS_10Ch_Stat_RH 1500;
BA_ "NetworkRequest" SG_ 3221225472 IFS_10Ch_Stat_RH 0;
BA_ "NetworkRequestHoldingTime" SG_ 3221225472 IFS_10Ch_Stat_RH 5000;
BA_ "Version" SG_ 3221225472 IFS_10Ch_Stat_RH "17.12.02";
BA_ "GenSigSendType" SG_ 3221225472 IFS_10Ch_Stat_RH 0;
BA_ "UserSigValidity" SG_ 3221225472 IFS_9Ch_Stat_RH 0;
BA_ "GenSigTimeoutTime" SG_ 3221225472 IFS_9Ch_Stat_RH 1500;
BA_ "NetworkRequest" SG_ 3221225472 IFS_9Ch_Stat_RH 0;
BA_ "NetworkRequestHoldingTime" SG_ 3221225472 IFS_9Ch_Stat_RH 5000;
BA_ "Version" SG_ 3221225472 IFS_9Ch_Stat_RH "17.12.02";
BA_ "GenSigSendType" SG_ 3221225472 IFS_9Ch_Stat_RH 0;
BA_ "UserSigValidity" SG_ 3221225472 IFS_8Ch_Stat_RH 0;
BA_ "GenSigTimeoutTime" SG_ 3221225472 IFS_8Ch_Stat_RH 1500;
BA_ "NetworkRequest" SG_ 3221225472 IFS_8Ch_Stat_RH 0;
BA_ "NetworkRequestHoldingTime" SG_ 3221225472 IFS_8Ch_Stat_RH 5000;
BA_ "Version" SG_ 3221225472 IFS_8Ch_Stat_RH "17.12.02";
BA_ "GenSigSendType" SG_ 3221225472 IFS_8Ch_Stat_RH 0;
BA_ "UserSigValidity" SG_ 3221225472 IFS_7Ch_Stat_RH 0;
BA_ "GenSigTimeoutTime" SG_ 3221225472 IFS_7Ch_Stat_RH 1500;
BA_ "NetworkRequest" SG_ 3221225472 IFS_7Ch_Stat_RH 0;
BA_ "NetworkRequestHoldingTime" SG_ 3221225472 IFS_7Ch_Stat_RH 5000;
BA_ "Version" SG_ 3221225472 IFS_7Ch_Stat_RH "17.12.02";
BA_ "GenSigSendType" SG_ 3221225472 IFS_7Ch_Stat_RH 0;
BA_ "UserSigValidity" SG_ 3221225472 IFS_6Ch_Stat_RH 0;
BA_ "GenSigTimeoutTime" SG_ 3221225472 IFS_6Ch_Stat_RH 1500;
BA_ "NetworkRequest" SG_ 3221225472 IFS_6Ch_Stat_RH 0;
BA_ "NetworkRequestHoldingTime" SG_ 3221225472 IFS_6Ch_Stat_RH 5000;
BA_ "Version" SG_ 3221225472 IFS_6Ch_Stat_RH "17.12.02";
BA_ "GenSigSendType" SG_ 3221225472 IFS_6Ch_Stat_RH 0;
BA_ "UserSigValidity" SG_ 3221225472 IFS_5Ch_Stat_RH 0;
BA_ "GenSigTimeoutTime" SG_ 3221225472 IFS_5Ch_Stat_RH 1500;
BA_ "NetworkRequest" SG_ 3221225472 IFS_5Ch_Stat_RH 0;
BA_ "NetworkRequestHoldingTime" SG_ 3221225472 IFS_5Ch_Stat_RH 5000;
BA_ "Version" SG_ 3221225472 IFS_5Ch_Stat_RH "17.12.02";
BA_ "GenSigSendType" SG_ 3221225472 IFS_5Ch_Stat_RH 0;
BA_ "UserSigValidity" SG_ 3221225472 IFS_4Ch_Stat_RH 0;
BA_ "GenSigTimeoutTime" SG_ 3221225472 IFS_4Ch_Stat_RH 1500;
BA_ "NetworkRequest" SG_ 3221225472 IFS_4Ch_Stat_RH 0;
BA_ "NetworkRequestHoldingTime" SG_ 3221225472 IFS_4Ch_Stat_RH 5000;
BA_ "Version" SG_ 3221225472 IFS_4Ch_Stat_RH "17.12.02";
BA_ "GenSigSendType" SG_ 3221225472 IFS_4Ch_Stat_RH 0;
BA_ "UserSigValidity" SG_ 3221225472 IFS_3Ch_Stat_RH 0;
BA_ "GenSigTimeoutTime" SG_ 3221225472 IFS_3Ch_Stat_RH 1500;
BA_ "NetworkRequest" SG_ 3221225472 IFS_3Ch_Stat_RH 0;
BA_ "NetworkRequestHoldingTime" SG_ 3221225472 IFS_3Ch_Stat_RH 5000;
BA_ "Version" SG_ 3221225472 IFS_3Ch_Stat_RH "17.12.02";
BA_ "GenSigSendType" SG_ 3221225472 IFS_3Ch_Stat_RH 0;
BA_ "UserSigValidity" SG_ 3221225472 IFS_2Ch_Stat_RH 0;
BA_ "GenSigTimeoutTime" SG_ 3221225472 IFS_2Ch_Stat_RH 1500;
BA_ "NetworkRequest" SG_ 3221225472 IFS_2Ch_Stat_RH 0;
BA_ "NetworkRequestHoldingTime" SG_ 3221225472 IFS_2Ch_Stat_RH 5000;
BA_ "Version" SG_ 3221225472 IFS_2Ch_Stat_RH "17.12.02";
BA_ "GenSigSendType" SG_ 3221225472 IFS_2Ch_Stat_RH 0;
BA_ "UserSigValidity" SG_ 3221225472 IFS_1Ch_Stat_RH 0;
BA_ "GenSigTimeoutTime" SG_ 3221225472 IFS_1Ch_Stat_RH 1500;
BA_ "NetworkRequest" SG_ 3221225472 IFS_1Ch_Stat_RH 0;
BA_ "NetworkRequestHoldingTime" SG_ 3221225472 IFS_1Ch_Stat_RH 5000;
BA_ "Version" SG_ 3221225472 IFS_1Ch_Stat_RH "17.12.02";
BA_ "GenSigSendType" SG_ 3221225472 IFS_1Ch_Stat_RH 0;
BA_ "UserSigValidity" SG_ 3221225472 IFS_HllAngle_LH 0;
BA_ "GenSigTimeoutTime" SG_ 3221225472 IFS_HllAngle_LH 1500;
BA_ "NetworkRequest" SG_ 3221225472 IFS_HllAngle_LH 0;
BA_ "NetworkRequestHoldingTime" SG_ 3221225472 IFS_HllAngle_LH 5000;
BA_ "Version" SG_ 3221225472 IFS_HllAngle_LH "17.12.02";
BA_ "GenSigSendType" SG_ 3221225472 IFS_HllAngle_LH 0;
BA_ "UserSigValidity" SG_ 3221225472 IFS_10Ch_Stat_LH 0;
BA_ "GenSigTimeoutTime" SG_ 3221225472 IFS_10Ch_Stat_LH 1500;
BA_ "NetworkRequest" SG_ 3221225472 IFS_10Ch_Stat_LH 0;
BA_ "NetworkRequestHoldingTime" SG_ 3221225472 IFS_10Ch_Stat_LH 5000;
BA_ "Version" SG_ 3221225472 IFS_10Ch_Stat_LH "17.12.02";
BA_ "GenSigSendType" SG_ 3221225472 IFS_10Ch_Stat_LH 0;
BA_ "UserSigValidity" SG_ 3221225472 IFS_9Ch_Stat_LH 0;
BA_ "GenSigTimeoutTime" SG_ 3221225472 IFS_9Ch_Stat_LH 1500;
BA_ "NetworkRequest" SG_ 3221225472 IFS_9Ch_Stat_LH 0;
BA_ "NetworkRequestHoldingTime" SG_ 3221225472 IFS_9Ch_Stat_LH 5000;
BA_ "Version" SG_ 3221225472 IFS_9Ch_Stat_LH "17.12.02";
BA_ "GenSigSendType" SG_ 3221225472 IFS_9Ch_Stat_LH 0;
BA_ "UserSigValidity" SG_ 3221225472 IFS_8Ch_Stat_LH 0;
BA_ "GenSigTimeoutTime" SG_ 3221225472 IFS_8Ch_Stat_LH 1500;
BA_ "NetworkRequest" SG_ 3221225472 IFS_8Ch_Stat_LH 0;
BA_ "NetworkRequestHoldingTime" SG_ 3221225472 IFS_8Ch_Stat_LH 5000;
BA_ "Version" SG_ 3221225472 IFS_8Ch_Stat_LH "17.12.02";
BA_ "GenSigSendType" SG_ 3221225472 IFS_8Ch_Stat_LH 0;
BA_ "UserSigValidity" SG_ 3221225472 IFS_7Ch_Stat_LH 0;
BA_ "GenSigTimeoutTime" SG_ 3221225472 IFS_7Ch_Stat_LH 1500;
BA_ "NetworkRequest" SG_ 3221225472 IFS_7Ch_Stat_LH 0;
BA_ "NetworkRequestHoldingTime" SG_ 3221225472 IFS_7Ch_Stat_LH 5000;
BA_ "Version" SG_ 3221225472 IFS_7Ch_Stat_LH "17.12.02";
BA_ "GenSigSendType" SG_ 3221225472 IFS_7Ch_Stat_LH 0;
BA_ "UserSigValidity" SG_ 3221225472 IFS_6Ch_Stat_LH 0;
BA_ "GenSigTimeoutTime" SG_ 3221225472 IFS_6Ch_Stat_LH 1500;
BA_ "NetworkRequest" SG_ 3221225472 IFS_6Ch_Stat_LH 0;
BA_ "NetworkRequestHoldingTime" SG_ 3221225472 IFS_6Ch_Stat_LH 5000;
BA_ "Version" SG_ 3221225472 IFS_6Ch_Stat_LH "17.12.02";
BA_ "GenSigSendType" SG_ 3221225472 IFS_6Ch_Stat_LH 0;
BA_ "UserSigValidity" SG_ 3221225472 IFS_5Ch_Stat_LH 0;
BA_ "GenSigTimeoutTime" SG_ 3221225472 IFS_5Ch_Stat_LH 1500;
BA_ "NetworkRequest" SG_ 3221225472 IFS_5Ch_Stat_LH 0;
BA_ "NetworkRequestHoldingTime" SG_ 3221225472 IFS_5Ch_Stat_LH 5000;
BA_ "Version" SG_ 3221225472 IFS_5Ch_Stat_LH "17.12.02";
BA_ "GenSigSendType" SG_ 3221225472 IFS_5Ch_Stat_LH 0;
BA_ "UserSigValidity" SG_ 3221225472 IFS_4Ch_Stat_LH 0;
BA_ "GenSigTimeoutTime" SG_ 3221225472 IFS_4Ch_Stat_LH 1500;
BA_ "NetworkRequest" SG_ 3221225472 IFS_4Ch_Stat_LH 0;
BA_ "NetworkRequestHoldingTime" SG_ 3221225472 IFS_4Ch_Stat_LH 5000;
BA_ "Version" SG_ 3221225472 IFS_4Ch_Stat_LH "17.12.02";
BA_ "GenSigSendType" SG_ 3221225472 IFS_4Ch_Stat_LH 0;
BA_ "UserSigValidity" SG_ 3221225472 IFS_3Ch_Stat_LH 0;
BA_ "GenSigTimeoutTime" SG_ 3221225472 IFS_3Ch_Stat_LH 1500;
BA_ "NetworkRequest" SG_ 3221225472 IFS_3Ch_Stat_LH 0;
BA_ "NetworkRequestHoldingTime" SG_ 3221225472 IFS_3Ch_Stat_LH 5000;
BA_ "Version" SG_ 3221225472 IFS_3Ch_Stat_LH "17.12.02";
BA_ "GenSigSendType" SG_ 3221225472 IFS_3Ch_Stat_LH 0;
BA_ "UserSigValidity" SG_ 3221225472 IFS_2Ch_Stat_LH 0;
BA_ "GenSigTimeoutTime" SG_ 3221225472 IFS_2Ch_Stat_LH 1500;
BA_ "NetworkRequest" SG_ 3221225472 IFS_2Ch_Stat_LH 0;
BA_ "NetworkRequestHoldingTime" SG_ 3221225472 IFS_2Ch_Stat_LH 5000;
BA_ "Version" SG_ 3221225472 IFS_2Ch_Stat_LH "17.12.02";
BA_ "GenSigSendType" SG_ 3221225472 IFS_2Ch_Stat_LH 0;
BA_ "UserSigValidity" SG_ 3221225472 IFS_1Ch_Stat_LH 0;
BA_ "GenSigTimeoutTime" SG_ 3221225472 IFS_1Ch_Stat_LH 1500;
BA_ "NetworkRequest" SG_ 3221225472 IFS_1Ch_Stat_LH 0;
BA_ "NetworkRequestHoldingTime" SG_ 3221225472 IFS_1Ch_Stat_LH 5000;
BA_ "Version" SG_ 3221225472 IFS_1Ch_Stat_LH "17.12.02";
BA_ "GenSigSendType" SG_ 3221225472 IFS_1Ch_Stat_LH 0;
BA_ "Description" SG_ 3221225472 CLU_Crc2Val "The CRC checking process calculates the CRC over the entire data block, including the CRC result.

- CRC Polynomial (0x1021) , Initial Value : 0xFFFF, XOR value : 0x0000

- The mathematical expression to 16 bit CRC polynomial is given here. G(x) = x16 + ";
BA_ "GenSigStartValue" SG_ 3221225472 CLU_Crc2Val 65535;
BA_ "UserSigValidity" SG_ 3221225472 CLU_Crc2Val 3;
BA_ "GenSigTimeoutTime" SG_ 3221225472 CLU_Crc2Val 1500;
BA_ "RoutingFactor" SG_ 3221225472 CLU_Crc2Val 2;
BA_ "Version" SG_ 3221225472 CLU_Crc2Val "17.11.00";
BA_ "Description" SG_ 3221225472 CLU_AlvCnt2Val "For the first transmission request for a data element the counter shall be initialized with 0 and shall be incremented by 1

for every subsequent send request. When the counter reaches the maximum value(0xFF), then it shall restart with ? for the next se";
BA_ "UserSigValidity" SG_ 3221225472 CLU_AlvCnt2Val 3;
BA_ "GenSigTimeoutTime" SG_ 3221225472 CLU_AlvCnt2Val 1500;
BA_ "RoutingFactor" SG_ 3221225472 CLU_AlvCnt2Val 2;
BA_ "Version" SG_ 3221225472 CLU_AlvCnt2Val "17.11.00";
BA_ "Description" SG_ 3221225472 CLU_OutTempCSta "The signal is outside temerature of the cluster (Unit: ℃)";
BA_ "UserSigValidity" SG_ 3221225472 CLU_OutTempCSta 3;
BA_ "GenSigTimeoutTime" SG_ 3221225472 CLU_OutTempCSta 1500;
BA_ "RoutingFactor" SG_ 3221225472 CLU_OutTempCSta 2;
BA_ "Version" SG_ 3221225472 CLU_OutTempCSta "17.12.03";
BA_ "Description" SG_ 3221225472 CLU_DTEVal "This signal indicates DTE.

0x0: Invalid

0x1: Not account (DTE display not in available : less than 50km)

0x2~0x3FF : Valid DTE (50~1023km)";
BA_ "UserSigValidity" SG_ 3221225472 CLU_DTEVal 3;
BA_ "GenSigTimeoutTime" SG_ 3221225472 CLU_DTEVal 1500;
BA_ "RoutingFactor" SG_ 3221225472 CLU_DTEVal 2;
BA_ "Version" SG_ 3221225472 CLU_DTEVal "17.11.00";
BA_ "Description" SG_ 3221225472 CLU_SndTyp "This signal is for sound type of Cluster.

The Cluster applied buzzer is can generate only on channel sound

and the Cluster applied speaker can generate multi channel sound.";
BA_ "UserSigValidity" SG_ 3221225472 CLU_SndTyp 3;
BA_ "GenSigTimeoutTime" SG_ 3221225472 CLU_SndTyp 1500;
BA_ "RoutingFactor" SG_ 3221225472 CLU_SndTyp 2;
BA_ "Version" SG_ 3221225472 CLU_SndTyp "17.11.00";
BA_ "Description" SG_ 3221225472 CLU_TripUnitSta "This signal indicates Distance to Empty UNIT";
BA_ "UserSigValidity" SG_ 3221225472 CLU_TripUnitSta 3;
BA_ "GenSigTimeoutTime" SG_ 3221225472 CLU_TripUnitSta 1500;
BA_ "RoutingFactor" SG_ 3221225472 CLU_TripUnitSta 2;
BA_ "Version" SG_ 3221225472 CLU_TripUnitSta "17.11.00";
BA_ "Description" SG_ 3221225472 CLU_AvgFuelCnsmptnVal "This average fuel consumption which is displayed in the trip-computer has to be sent to Tele-matics control unit. 

This signal is applied to the case cluster displays in the trip-computer.";
BA_ "UserSigValidity" SG_ 3221225472 CLU_AvgFuelCnsmptnVal 3;
BA_ "GenSigTimeoutTime" SG_ 3221225472 CLU_AvgFuelCnsmptnVal 1500;
BA_ "RoutingFactor" SG_ 3221225472 CLU_AvgFuelCnsmptnVal 2;
BA_ "Version" SG_ 3221225472 CLU_AvgFuelCnsmptnVal "17.11.00";
BA_ "Description" SG_ 3221225472 CLU_AvgFuelCnsmptnUnitSta "This signal indicates the unit of average fuel consumption displayed in the trip computer.

This signal is applied to the case cluster displays in the trip-computer.";
BA_ "UserSigValidity" SG_ 3221225472 CLU_AvgFuelCnsmptnUnitSta 3;
BA_ "GenSigTimeoutTime" SG_ 3221225472 CLU_AvgFuelCnsmptnUnitSta 1500;
BA_ "RoutingFactor" SG_ 3221225472 CLU_AvgFuelCnsmptnUnitSta 2;
BA_ "Version" SG_ 3221225472 CLU_AvgFuelCnsmptnUnitSta "17.11.00";
BA_ "Description" SG_ 3221225472 CLU_LoFuelWrngSta "This signal indicates that the Low fuel warning in the cluster is On or Off. When Low Fuel Warning is On, its value is 01H otherwise its value is 00H.";
BA_ "UserSigValidity" SG_ 3221225472 CLU_LoFuelWrngSta 3;
BA_ "GenSigTimeoutTime" SG_ 3221225472 CLU_LoFuelWrngSta 1500;
BA_ "RoutingFactor" SG_ 3221225472 CLU_LoFuelWrngSta 2;
BA_ "Version" SG_ 3221225472 CLU_LoFuelWrngSta "17.11.00";
BA_ "Description" SG_ 3221225472 CLU_RefuelDetSta "This signal sends the refuel detected status to the tele-matics control unit. 

It transfers 3 times during refuel detected event why if valid one is missing, valid signals are used for extra signal.";
BA_ "UserSigValidity" SG_ 3221225472 CLU_RefuelDetSta 3;
BA_ "GenSigTimeoutTime" SG_ 3221225472 CLU_RefuelDetSta 1500;
BA_ "RoutingFactor" SG_ 3221225472 CLU_RefuelDetSta 2;
BA_ "Version" SG_ 3221225472 CLU_RefuelDetSta "17.11.00";
BA_ "Description" SG_ 3221225472 CLU_TerrainMainSwSta "This signal represents the terrain mode main switch's state.

0x1:On-Road /0x2:Off-Road";
BA_ "UserSigValidity" SG_ 3221225472 CLU_TerrainMainSwSta 3;
BA_ "GenSigTimeoutTime" SG_ 3221225472 CLU_TerrainMainSwSta 1500;
BA_ "RoutingFactor" SG_ 3221225472 CLU_TerrainMainSwSta 2;
BA_ "Version" SG_ 3221225472 CLU_TerrainMainSwSta "18.04.00";
BA_ "Description" SG_ 3221225472 CLU_LngSta "Language Info. for Display Font";
BA_ "UserSigValidity" SG_ 3221225472 CLU_LngSta 3;
BA_ "GenSigTimeoutTime" SG_ 3221225472 CLU_LngSta 1500;
BA_ "RoutingFactor" SG_ 3221225472 CLU_LngSta 2;
BA_ "Version" SG_ 3221225472 CLU_LngSta "17.11.00";
BA_ "Description" SG_ 3221225472 CLU_SRSWrngLmpSta "This signal is generated by one of the following 5 self-diagnostic result of micro-controller of Cluster.

1) “Lamp ON” status as a self-status diagnostic result of cluster

2) “Lamp OFF” status as a self-status diagnostic result of cluster

3) “Lam";
BA_ "UserSigValidity" SG_ 3221225472 CLU_SRSWrngLmpSta 3;
BA_ "GenSigTimeoutTime" SG_ 3221225472 CLU_SRSWrngLmpSta 1500;
BA_ "RoutingFactor" SG_ 3221225472 CLU_SRSWrngLmpSta 2;
BA_ "Version" SG_ 3221225472 CLU_SRSWrngLmpSta "17.12.03";
BA_ "Description" SG_ 3221225472 CLU_OdoVal "This signal indicates mileage counter of a vehicle. Cluster calculates total mileage and sends it to SCC and CUBIS. This value shall be the same with the mileage that is displayed to a driver.";
BA_ "UserSigValidity" SG_ 3221225472 CLU_OdoVal 3;
BA_ "GenSigTimeoutTime" SG_ 3221225472 CLU_OdoVal 1500;
BA_ "RoutingFactor" SG_ 3221225472 CLU_OdoVal 2;
BA_ "Version" SG_ 3221225472 CLU_OdoVal "17.11.00";
BA_ "Description" SG_ 3221225472 CLU_DawLastBrkTimeVal "This signal indicates that the elapsed time count after last driver's break. The elapsed time count increase 1 at an interval of 30 minutes.";
BA_ "UserSigValidity" SG_ 3221225472 CLU_DawLastBrkTimeVal 3;
BA_ "GenSigTimeoutTime" SG_ 3221225472 CLU_DawLastBrkTimeVal 1500;
BA_ "RoutingFactor" SG_ 3221225472 CLU_DawLastBrkTimeVal 2;
BA_ "Version" SG_ 3221225472 CLU_DawLastBrkTimeVal "17.11.00";
BA_ "Description" SG_ 3221225472 CLU_RefuelWrnSta "This signal indicates that the Refuel popup is the cluster is On or Off.

When Refuel popup is on, its value is 0x1 otherwise its value is 0x0.";
BA_ "UserSigValidity" SG_ 3221225472 CLU_RefuelWrnSta 3;
BA_ "GenSigTimeoutTime" SG_ 3221225472 CLU_RefuelWrnSta 1500;
BA_ "RoutingFactor" SG_ 3221225472 CLU_RefuelWrnSta 2;
BA_ "Version" SG_ 3221225472 CLU_RefuelWrnSta "17.11.00";
BA_ "Description" SG_ 3221225472 CLU_IceWrnIndSta "This signal indicates that the Ice warning indicator in the cluster is on or off.

When Ice warning indicator is on, its value is 0x1 otherwise its value is 0x0.";
BA_ "UserSigValidity" SG_ 3221225472 CLU_IceWrnIndSta 3;
BA_ "GenSigTimeoutTime" SG_ 3221225472 CLU_IceWrnIndSta 1500;
BA_ "RoutingFactor" SG_ 3221225472 CLU_IceWrnIndSta 2;
BA_ "Version" SG_ 3221225472 CLU_IceWrnIndSta "17.11.00";
BA_ "Description" SG_ 3221225472 CLU_DrvngModSwSta "This signal occurs when drive mode switch is selected either 'Normal' or 'Eco' or 'Sport' or 'Sport+' or 'Smart' or 'Custom' or 'N-mode'.";
BA_ "UserSigValidity" SG_ 3221225472 CLU_DrvngModSwSta 3;
BA_ "GenSigTimeoutTime" SG_ 3221225472 CLU_DrvngModSwSta 1500;
BA_ "RoutingFactor" SG_ 3221225472 CLU_DrvngModSwSta 2;
BA_ "Version" SG_ 3221225472 CLU_DrvngModSwSta "18.02.03";
BA_ "Description" SG_ 3221225472 CLU_FuelLvlSta "The signal is fuel level of the cluster that fuel gauge indicate (Unit: %)";
BA_ "UserSigValidity" SG_ 3221225472 CLU_FuelLvlSta 3;
BA_ "GenSigTimeoutTime" SG_ 3221225472 CLU_FuelLvlSta 1500;
BA_ "RoutingFactor" SG_ 3221225472 CLU_FuelLvlSta 2;
BA_ "Version" SG_ 3221225472 CLU_FuelLvlSta "17.12.03";
BA_ "Description" SG_ 3221225472 CLU_OutTempFSta "The signal is outside temerature of the cluster (Unit: ℉)";
BA_ "UserSigValidity" SG_ 3221225472 CLU_OutTempFSta 3;
BA_ "GenSigTimeoutTime" SG_ 3221225472 CLU_OutTempFSta 1500;
BA_ "RoutingFactor" SG_ 3221225472 CLU_OutTempFSta 2;
BA_ "Version" SG_ 3221225472 CLU_OutTempFSta "17.12.03";
BA_ "Description" SG_ 3221225472 CLU_TerrainModSwSta "This signal occurs when terrain mode switch is selected either 'Snow' or 'Sand' or 'Mud'.";
BA_ "UserSigValidity" SG_ 3221225472 CLU_TerrainModSwSta 3;
BA_ "GenSigTimeoutTime" SG_ 3221225472 CLU_TerrainModSwSta 1500;
BA_ "RoutingFactor" SG_ 3221225472 CLU_TerrainModSwSta 2;
BA_ "Version" SG_ 3221225472 CLU_TerrainModSwSta "18.02.03";
BA_ "Description" SG_ 3221225472 SWRC_Crc1Val "The CRC checking process calculates the CRC over the entire data block, including the CRC result CRC Polynomial (0x1D) ,

Initial Value : 0x00, XOR value : 0x00

The mathematical expression to 8 bit CRC polynomial is given here. G(x) = x8 + x4 + x3 + x2 ";
BA_ "GenSigSendType" SG_ 3221225472 SWRC_Crc1Val 4;
BA_ "GenSigStartValue" SG_ 3221225472 SWRC_Crc1Val 255;
BA_ "UserSigValidity" SG_ 3221225472 SWRC_Crc1Val 1;
BA_ "GenSigTimeoutTime" SG_ 3221225472 SWRC_Crc1Val 1500;
BA_ "Version" SG_ 3221225472 SWRC_Crc1Val "17.11.00";
BA_ "Description" SG_ 3221225472 SWRC_AlvCnt1Val "For the first transmission request for a data element the counter shall be initialized with 0 and shall be incremented by 1

for every subsequent send request. When the counter reaches the maximum value(0xE), then it shall restart with ? for the next sen";
BA_ "GenSigSendType" SG_ 3221225472 SWRC_AlvCnt1Val 4;
BA_ "UserSigValidity" SG_ 3221225472 SWRC_AlvCnt1Val 1;
BA_ "GenSigTimeoutTime" SG_ 3221225472 SWRC_AlvCnt1Val 1500;
BA_ "Version" SG_ 3221225472 SWRC_AlvCnt1Val "17.11.00";
BA_ "Description" SG_ 3221225472 Audio_VcRecSwSta "Audio Voice recognition switch



MM-CAN Gateway needed";
BA_ "GenSigSendType" SG_ 3221225472 Audio_VcRecSwSta 4;
BA_ "UserSigValidity" SG_ 3221225472 Audio_VcRecSwSta 1;
BA_ "GenSigTimeoutTime" SG_ 3221225472 Audio_VcRecSwSta 1500;
BA_ "NetworkRequest" SG_ 3221225472 Audio_VcRecSwSta 0;
BA_ "NetworkRequestHoldingTime" SG_ 3221225472 Audio_VcRecSwSta 5000;
BA_ "Version" SG_ 3221225472 Audio_VcRecSwSta "17.11.00";
BA_ "Description" SG_ 3221225472 Audio_BluetoothPhnClSwSta "Bluetooth phone call switch on/off



MM-CAN Gateway needed";
BA_ "GenSigSendType" SG_ 3221225472 Audio_BluetoothPhnClSwSta 4;
BA_ "UserSigValidity" SG_ 3221225472 Audio_BluetoothPhnClSwSta 1;
BA_ "GenSigTimeoutTime" SG_ 3221225472 Audio_BluetoothPhnClSwSta 1500;
BA_ "NetworkRequest" SG_ 3221225472 Audio_BluetoothPhnClSwSta 0;
BA_ "NetworkRequestHoldingTime" SG_ 3221225472 Audio_BluetoothPhnClSwSta 5000;
BA_ "Version" SG_ 3221225472 Audio_BluetoothPhnClSwSta "17.11.00";
BA_ "Description" SG_ 3221225472 Audio_ModSwSta "Audio Mode switch



MM-CAN Gateway needed";
BA_ "GenSigSendType" SG_ 3221225472 Audio_ModSwSta 4;
BA_ "UserSigValidity" SG_ 3221225472 Audio_ModSwSta 1;
BA_ "GenSigTimeoutTime" SG_ 3221225472 Audio_ModSwSta 1500;
BA_ "NetworkRequest" SG_ 3221225472 Audio_ModSwSta 0;
BA_ "NetworkRequestHoldingTime" SG_ 3221225472 Audio_ModSwSta 5000;
BA_ "Version" SG_ 3221225472 Audio_ModSwSta "17.11.00";
BA_ "Description" SG_ 3221225472 Audio_MutSwSta "Audio Mute switch



MM-CAN Gateway needed";
BA_ "GenSigSendType" SG_ 3221225472 Audio_MutSwSta 4;
BA_ "UserSigValidity" SG_ 3221225472 Audio_MutSwSta 1;
BA_ "GenSigTimeoutTime" SG_ 3221225472 Audio_MutSwSta 1500;
BA_ "NetworkRequest" SG_ 3221225472 Audio_MutSwSta 0;
BA_ "NetworkRequestHoldingTime" SG_ 3221225472 Audio_MutSwSta 5000;
BA_ "Version" SG_ 3221225472 Audio_MutSwSta "17.11.00";
BA_ "Description" SG_ 3221225472 Audio_SeekDnSwSta "Audio Seek Down switch



MM-CAN Gateway needed";
BA_ "GenSigSendType" SG_ 3221225472 Audio_SeekDnSwSta 4;
BA_ "UserSigValidity" SG_ 3221225472 Audio_SeekDnSwSta 1;
BA_ "GenSigTimeoutTime" SG_ 3221225472 Audio_SeekDnSwSta 1500;
BA_ "NetworkRequest" SG_ 3221225472 Audio_SeekDnSwSta 0;
BA_ "NetworkRequestHoldingTime" SG_ 3221225472 Audio_SeekDnSwSta 5000;
BA_ "Version" SG_ 3221225472 Audio_SeekDnSwSta "17.11.00";
BA_ "Description" SG_ 3221225472 Audio_SeekUpSwSta "Audio Seek Up switch



MM-CAN Gateway needed";
BA_ "GenSigSendType" SG_ 3221225472 Audio_SeekUpSwSta 4;
BA_ "UserSigValidity" SG_ 3221225472 Audio_SeekUpSwSta 1;
BA_ "GenSigTimeoutTime" SG_ 3221225472 Audio_SeekUpSwSta 1500;
BA_ "NetworkRequest" SG_ 3221225472 Audio_SeekUpSwSta 0;
BA_ "NetworkRequestHoldingTime" SG_ 3221225472 Audio_SeekUpSwSta 5000;
BA_ "Version" SG_ 3221225472 Audio_SeekUpSwSta "17.11.00";
BA_ "GenSigSendType" SG_ 3221225472 Cluster_ModeSwSta 4;
BA_ "UserSigValidity" SG_ 3221225472 Cluster_ModeSwSta 1;
BA_ "GenSigTimeoutTime" SG_ 3221225472 Cluster_ModeSwSta 1500;
BA_ "NetworkRequest" SG_ 3221225472 Cluster_ModeSwSta 0;
BA_ "NetworkRequestHoldingTime" SG_ 3221225472 Cluster_ModeSwSta 5000;
BA_ "Version" SG_ 3221225472 Cluster_ModeSwSta "17.11.00";
BA_ "GenSigSendType" SG_ 3221225472 Cluster_ScrlOkSwSta 4;
BA_ "UserSigValidity" SG_ 3221225472 Cluster_ScrlOkSwSta 1;
BA_ "GenSigTimeoutTime" SG_ 3221225472 Cluster_ScrlOkSwSta 1500;
BA_ "NetworkRequest" SG_ 3221225472 Cluster_ScrlOkSwSta 0;
BA_ "NetworkRequestHoldingTime" SG_ 3221225472 Cluster_ScrlOkSwSta 5000;
BA_ "Version" SG_ 3221225472 Cluster_ScrlOkSwSta "17.11.00";
BA_ "Description" SG_ 3221225472 Audio_CustomSwSta "Audio Custom switch MM-CAN Gateway needed";
BA_ "GenSigSendType" SG_ 3221225472 Audio_CustomSwSta 4;
BA_ "UserSigValidity" SG_ 3221225472 Audio_CustomSwSta 1;
BA_ "GenSigTimeoutTime" SG_ 3221225472 Audio_CustomSwSta 1500;
BA_ "NetworkRequest" SG_ 3221225472 Audio_CustomSwSta 0;
BA_ "NetworkRequestHoldingTime" SG_ 3221225472 Audio_CustomSwSta 5000;
BA_ "Version" SG_ 3221225472 Audio_CustomSwSta "18.01.00";
BA_ "Description" SG_ 3221225472 USM_CmdWPCSta "USM request value of WPC";
BA_ "GenSigSendType" SG_ 3221225472 USM_CmdWPCSta 4;
BA_ "UserSigValidity" SG_ 3221225472 USM_CmdWPCSta 0;
BA_ "GenSigTimeoutTime" SG_ 3221225472 USM_CmdWPCSta 1500;
BA_ "NetworkRequest" SG_ 3221225472 USM_CmdWPCSta 0;
BA_ "NetworkRequestHoldingTime" SG_ 3221225472 USM_CmdWPCSta 5000;
BA_ "Version" SG_ 3221225472 USM_CmdWPCSta "17.11.00";
BA_ "Description" SG_ 3221225472 WPC_PhnLftWrngSta "Warning by WPC for User (Phone left in vehicle)";
BA_ "GenSigSendType" SG_ 3221225472 WPC_PhnLftWrngSta 4;
BA_ "UserSigValidity" SG_ 3221225472 WPC_PhnLftWrngSta 0;
BA_ "GenSigTimeoutTime" SG_ 3221225472 WPC_PhnLftWrngSta 1500;
BA_ "NetworkRequest" SG_ 3221225472 WPC_PhnLftWrngSta 0;
BA_ "NetworkRequestHoldingTime" SG_ 3221225472 WPC_PhnLftWrngSta 5000;
BA_ "Version" SG_ 3221225472 WPC_PhnLftWrngSta "18.02.03";
BA_ "Description" SG_ 3221225472 WPC_NFCDeviceDetSta "Warning by WPC for User (Phone left in vehicle)";
BA_ "GenSigSendType" SG_ 3221225472 WPC_NFCDeviceDetSta 4;
BA_ "UserSigValidity" SG_ 3221225472 WPC_NFCDeviceDetSta 0;
BA_ "GenSigTimeoutTime" SG_ 3221225472 WPC_NFCDeviceDetSta 1500;
BA_ "NetworkRequest" SG_ 3221225472 WPC_NFCDeviceDetSta 0;
BA_ "NetworkRequestHoldingTime" SG_ 3221225472 WPC_NFCDeviceDetSta 5000;
BA_ "Version" SG_ 3221225472 WPC_NFCDeviceDetSta "17.11.00";
BA_ "Description" SG_ 3221225472 SMK_Crc2Val "The CRC checking process calculates the CRC over the entire data block, including the CRC result CRC Polynomial (0x1D) ,

Initial Value : 0x00, XOR value : 0x00

The mathematical expression to 8 bit CRC polynomial is given here. G(x) = x8 + x4 + x3 + x2 ";
BA_ "GenSigSendType" SG_ 3221225472 SMK_Crc2Val 4;
BA_ "GenSigStartValue" SG_ 3221225472 SMK_Crc2Val 255;
BA_ "UserSigValidity" SG_ 3221225472 SMK_Crc2Val 0;
BA_ "GenSigTimeoutTime" SG_ 3221225472 SMK_Crc2Val 1500;
BA_ "Version" SG_ 3221225472 SMK_Crc2Val "17.11.00";
BA_ "Description" SG_ 3221225472 SMK_AlvCnt2Val "For the first transmission request for a data element the counter shall be initialized with 0 and shall be incremented by 1

for every subsequent send request. When the counter reaches the maximum value(0xE), then it shall restart with ? for the next sen";
BA_ "GenSigSendType" SG_ 3221225472 SMK_AlvCnt2Val 4;
BA_ "UserSigValidity" SG_ 3221225472 SMK_AlvCnt2Val 0;
BA_ "GenSigTimeoutTime" SG_ 3221225472 SMK_AlvCnt2Val 1500;
BA_ "Version" SG_ 3221225472 SMK_AlvCnt2Val "17.11.00";
BA_ "Description" SG_ 3221225472 SSB_StrtStpBtnSw1Sta "StartStop button switch #1 status";
BA_ "GenSigSendType" SG_ 3221225472 SSB_StrtStpBtnSw1Sta 4;
BA_ "UserSigValidity" SG_ 3221225472 SSB_StrtStpBtnSw1Sta 0;
BA_ "GenSigTimeoutTime" SG_ 3221225472 SSB_StrtStpBtnSw1Sta 1500;
BA_ "Version" SG_ 3221225472 SSB_StrtStpBtnSw1Sta "17.12.00";
BA_ "Description" SG_ 3221225472 SSB_StrtStpBtnSw2Sta "StartStop button switch #2 status";
BA_ "GenSigSendType" SG_ 3221225472 SSB_StrtStpBtnSw2Sta 4;
BA_ "UserSigValidity" SG_ 3221225472 SSB_StrtStpBtnSw2Sta 0;
BA_ "GenSigTimeoutTime" SG_ 3221225472 SSB_StrtStpBtnSw2Sta 1500;
BA_ "Version" SG_ 3221225472 SSB_StrtStpBtnSw2Sta "17.12.00";
BA_ "Description" SG_ 3221225472 SMK_TrmnlCtrlSta "Mirror value of TerminalControlState";
BA_ "GenSigSendType" SG_ 3221225472 SMK_TrmnlCtrlSta 4;
BA_ "UserSigValidity" SG_ 3221225472 SMK_TrmnlCtrlSta 0;
BA_ "GenSigTimeoutTime" SG_ 3221225472 SMK_TrmnlCtrlSta 1500;
BA_ "Version" SG_ 3221225472 SMK_TrmnlCtrlSta "17.12.00";
BA_ "Description" SG_ 3221225472 SMK_TrmnlMngrSta "Mirror valeu of TerminalsManager Stat";
BA_ "GenSigSendType" SG_ 3221225472 SMK_TrmnlMngrSta 4;
BA_ "UserSigValidity" SG_ 3221225472 SMK_TrmnlMngrSta 0;
BA_ "GenSigTimeoutTime" SG_ 3221225472 SMK_TrmnlMngrSta 1500;
BA_ "Version" SG_ 3221225472 SMK_TrmnlMngrSta "17.12.00";
BA_ "GenSigSendType" SG_ 3221225472 SMK_AuthSta 4;
BA_ "UserSigValidity" SG_ 3221225472 SMK_AuthSta 0;
BA_ "GenSigTimeoutTime" SG_ 3221225472 SMK_AuthSta 1500;
BA_ "Version" SG_ 3221225472 SMK_AuthSta "17.12.00";
BA_ "Description" SG_ 3221225472 SMK_Ign1InSta "Ignition1 Input Status at SMK";
BA_ "GenSigSendType" SG_ 3221225472 SMK_Ign1InSta 4;
BA_ "UserSigValidity" SG_ 3221225472 SMK_Ign1InSta 0;
BA_ "GenSigTimeoutTime" SG_ 3221225472 SMK_Ign1InSta 1500;
BA_ "Version" SG_ 3221225472 SMK_Ign1InSta "17.12.00";
BA_ "Description" SG_ 3221225472 SMK_Ign1RlySta "Development for SMK";
BA_ "GenSigSendType" SG_ 3221225472 SMK_Ign1RlySta 4;
BA_ "UserSigValidity" SG_ 3221225472 SMK_Ign1RlySta 0;
BA_ "GenSigTimeoutTime" SG_ 3221225472 SMK_Ign1RlySta 1500;
BA_ "Version" SG_ 3221225472 SMK_Ign1RlySta "17.12.00";
BA_ "Description" SG_ 3221225472 SMK_Ign2InSta "Ignition2 Input Status at SMK";
BA_ "GenSigSendType" SG_ 3221225472 SMK_Ign2InSta 4;
BA_ "UserSigValidity" SG_ 3221225472 SMK_Ign2InSta 0;
BA_ "GenSigTimeoutTime" SG_ 3221225472 SMK_Ign2InSta 1500;
BA_ "Version" SG_ 3221225472 SMK_Ign2InSta "17.12.00";
BA_ "Description" SG_ 3221225472 SMK_Ign2RlySta "Development for SMK";
BA_ "GenSigSendType" SG_ 3221225472 SMK_Ign2RlySta 4;
BA_ "UserSigValidity" SG_ 3221225472 SMK_Ign2RlySta 0;
BA_ "GenSigTimeoutTime" SG_ 3221225472 SMK_Ign2RlySta 1500;
BA_ "Version" SG_ 3221225472 SMK_Ign2RlySta "17.12.00";
BA_ "Description" SG_ 3221225472 SMK_StrtFdbckSta "Mirror value of L_StartFeedback";
BA_ "GenSigSendType" SG_ 3221225472 SMK_StrtFdbckSta 4;
BA_ "UserSigValidity" SG_ 3221225472 SMK_StrtFdbckSta 0;
BA_ "GenSigTimeoutTime" SG_ 3221225472 SMK_StrtFdbckSta 1500;
BA_ "Version" SG_ 3221225472 SMK_StrtFdbckSta "17.12.00";
BA_ "Description" SG_ 3221225472 SMK_StrtrRlyOutSta "-(Old)C_StarterRelayStatus";
BA_ "GenSigSendType" SG_ 3221225472 SMK_StrtrRlyOutSta 4;
BA_ "UserSigValidity" SG_ 3221225472 SMK_StrtrRlyOutSta 0;
BA_ "GenSigTimeoutTime" SG_ 3221225472 SMK_StrtrRlyOutSta 1500;
BA_ "Version" SG_ 3221225472 SMK_StrtrRlyOutSta "17.12.00";
BA_ "Description" SG_ 3221225472 SMK_AccInSta "ACC Input Status at SMK";
BA_ "GenSigSendType" SG_ 3221225472 SMK_AccInSta 4;
BA_ "UserSigValidity" SG_ 3221225472 SMK_AccInSta 0;
BA_ "GenSigTimeoutTime" SG_ 3221225472 SMK_AccInSta 1500;
BA_ "Version" SG_ 3221225472 SMK_AccInSta "17.12.00";
BA_ "Description" SG_ 3221225472 SMK_AccRlySta "Development for SMK";
BA_ "GenSigSendType" SG_ 3221225472 SMK_AccRlySta 4;
BA_ "UserSigValidity" SG_ 3221225472 SMK_AccRlySta 0;
BA_ "GenSigTimeoutTime" SG_ 3221225472 SMK_AccRlySta 1500;
BA_ "Version" SG_ 3221225472 SMK_AccRlySta "17.12.00";
BA_ "Description" SG_ 3221225472 SMK_CLUAccIndOnReq "Request to Cluster ACC Indicator On

(This is only used for CLU)";
BA_ "GenSigSendType" SG_ 3221225472 SMK_CLUAccIndOnReq 4;
BA_ "UserSigValidity" SG_ 3221225472 SMK_CLUAccIndOnReq 0;
BA_ "GenSigTimeoutTime" SG_ 3221225472 SMK_CLUAccIndOnReq 1500;
BA_ "Version" SG_ 3221225472 SMK_CLUAccIndOnReq "17.12.00";
BA_ "GenSigSendType" SG_ 3221225472 SMK_TlEngRunSta 4;
BA_ "UserSigValidity" SG_ 3221225472 SMK_TlEngRunSta 0;
BA_ "GenSigTimeoutTime" SG_ 3221225472 SMK_TlEngRunSta 1500;
BA_ "Version" SG_ 3221225472 SMK_TlEngRunSta "17.12.00";
BA_ "GenSigSendType" SG_ 3221225472 SMK_TlCrnkModSta 4;
BA_ "UserSigValidity" SG_ 3221225472 SMK_TlCrnkModSta 0;
BA_ "GenSigTimeoutTime" SG_ 3221225472 SMK_TlCrnkModSta 1500;
BA_ "Version" SG_ 3221225472 SMK_TlCrnkModSta "17.12.00";
BA_ "Description" SG_ 3221225472 ILCU_LH_Crc2Val "The CRC checking process calculates the CRC over the entire data block, including the CRC result CRC Polynomial (0x1D) ,

Initial Value : 0x00, XOR value : 0x00

The mathematical expression to 8 bit CRC polynomial is given here. G(x) = x8 + x4 + x3 + x2 ";
BA_ "GenSigStartValue" SG_ 3221225472 ILCU_LH_Crc2Val 255;
BA_ "UserSigValidity" SG_ 3221225472 ILCU_LH_Crc2Val 0;
BA_ "Version" SG_ 3221225472 ILCU_LH_Crc2Val "17.12.02";
BA_ "Description" SG_ 3221225472 ILCU_LH_AlvCnt2Val "For the first transmission request for a data element the counter shall be initialized with 0 and shall be incremented by 1

for every subsequent send request. When the counter reaches the maximum value(0xE), then it shall restart with ? for the next sen";
BA_ "UserSigValidity" SG_ 3221225472 ILCU_LH_AlvCnt2Val 0;
BA_ "Version" SG_ 3221225472 ILCU_LH_AlvCnt2Val "17.12.02";
BA_ "UserSigValidity" SG_ 3221225472 ILCULH_HeightSnsrFront_Val 3;
BA_ "NetworkRequest" SG_ 3221225472 ILCULH_HeightSnsrFront_Val 0;
BA_ "NetworkRequestHoldingTime" SG_ 3221225472 ILCULH_HeightSnsrFront_Val 5000;
BA_ "Version" SG_ 3221225472 ILCULH_HeightSnsrFront_Val "17.12.02";
BA_ "UserSigValidity" SG_ 3221225472 ILCULH_HeightSnsrFront_Stat 3;
BA_ "NetworkRequest" SG_ 3221225472 ILCULH_HeightSnsrFront_Stat 0;
BA_ "NetworkRequestHoldingTime" SG_ 3221225472 ILCULH_HeightSnsrFront_Stat 5000;
BA_ "Version" SG_ 3221225472 ILCULH_HeightSnsrFront_Stat "17.12.02";
BA_ "UserSigValidity" SG_ 3221225472 ILCULH_LevelActuator_Sta 3;
BA_ "NetworkRequest" SG_ 3221225472 ILCULH_LevelActuator_Sta 0;
BA_ "NetworkRequestHoldingTime" SG_ 3221225472 ILCULH_LevelActuator_Sta 5000;
BA_ "Version" SG_ 3221225472 ILCULH_LevelActuator_Sta "17.12.02";
BA_ "Description" SG_ 3221225472 SMK_Crc6Val "The CRC checking process calculates the CRC over the entire data block, including the CRC result CRC Polynomial (0x1D) ,

Initial Value : 0x00, XOR value : 0x00

The mathematical expression to 8 bit CRC polynomial is given here. G(x) = x8 + x4 + x3 + x2 ";
BA_ "GenSigSendType" SG_ 3221225472 SMK_Crc6Val 4;
BA_ "GenSigStartValue" SG_ 3221225472 SMK_Crc6Val 255;
BA_ "UserSigValidity" SG_ 3221225472 SMK_Crc6Val 0;
BA_ "GenSigTimeoutTime" SG_ 3221225472 SMK_Crc6Val 1500;
BA_ "Version" SG_ 3221225472 SMK_Crc6Val "17.11.00";
BA_ "Description" SG_ 3221225472 SMK_AlvCnt6Val "For the first transmission request for a data element the counter shall be initialized with 0 and shall be incremented by 1

for every subsequent send request. When the counter reaches the maximum value(0xE), then it shall restart with ? for the next sen";
BA_ "GenSigSendType" SG_ 3221225472 SMK_AlvCnt6Val 4;
BA_ "UserSigValidity" SG_ 3221225472 SMK_AlvCnt6Val 0;
BA_ "GenSigTimeoutTime" SG_ 3221225472 SMK_AlvCnt6Val 1500;
BA_ "Version" SG_ 3221225472 SMK_AlvCnt6Val "17.11.00";
BA_ "Description" SG_ 3221225472 Lamp_HzrdBlnkngSta "Hazard Signal for Hands Free Trunk/Tailgate";
BA_ "GenSigSendType" SG_ 3221225472 Lamp_HzrdBlnkngSta 4;
BA_ "UserSigValidity" SG_ 3221225472 Lamp_HzrdBlnkngSta 0;
BA_ "GenSigTimeoutTime" SG_ 3221225472 Lamp_HzrdBlnkngSta 1500;
BA_ "Version" SG_ 3221225472 Lamp_HzrdBlnkngSta "17.12.00";
BA_ "Description" SG_ 3221225472 Lamp_SmrtWlcmLtOnReq "Smart Key welcome light on request.";
BA_ "GenSigSendType" SG_ 3221225472 Lamp_SmrtWlcmLtOnReq 4;
BA_ "UserSigValidity" SG_ 3221225472 Lamp_SmrtWlcmLtOnReq 0;
BA_ "GenSigTimeoutTime" SG_ 3221225472 Lamp_SmrtWlcmLtOnReq 1500;
BA_ "NetworkRequest" SG_ 3221225472 Lamp_SmrtWlcmLtOnReq 0;
BA_ "NetworkRequestHoldingTime" SG_ 3221225472 Lamp_SmrtWlcmLtOnReq 5000;
BA_ "Version" SG_ 3221225472 Lamp_SmrtWlcmLtOnReq "17.12.00";
BA_ "Description" SG_ 3221225472 Fob_BattStaInfo "Received Fob Battery Status for Telematics Vehicle Information Service";
BA_ "GenSigSendType" SG_ 3221225472 Fob_BattStaInfo 4;
BA_ "UserSigValidity" SG_ 3221225472 Fob_BattStaInfo 0;
BA_ "GenSigTimeoutTime" SG_ 3221225472 Fob_BattStaInfo 1500;
BA_ "Version" SG_ 3221225472 Fob_BattStaInfo "17.12.00";
BA_ "Description" SG_ 3221225472 Fob_FoundDrvWlcmArea "This Signal Indicates direction of user approach to vehicle.

If User Approach to vehicle Driver direction, This signal set On.";
BA_ "GenSigSendType" SG_ 3221225472 Fob_FoundDrvWlcmArea 4;
BA_ "UserSigValidity" SG_ 3221225472 Fob_FoundDrvWlcmArea 0;
BA_ "GenSigTimeoutTime" SG_ 3221225472 Fob_FoundDrvWlcmArea 1500;
BA_ "Version" SG_ 3221225472 Fob_FoundDrvWlcmArea "17.12.00";
BA_ "Description" SG_ 3221225472 Fob_FoundAsstWlcmArea "This Signal Indicates direction of user approach to vehicle.

If User Approach to vehicle Assistant direction, This signal set On.";
BA_ "GenSigSendType" SG_ 3221225472 Fob_FoundAsstWlcmArea 4;
BA_ "UserSigValidity" SG_ 3221225472 Fob_FoundAsstWlcmArea 0;
BA_ "GenSigTimeoutTime" SG_ 3221225472 Fob_FoundAsstWlcmArea 1500;
BA_ "Version" SG_ 3221225472 Fob_FoundAsstWlcmArea "17.12.00";
BA_ "Description" SG_ 3221225472 Fob_FoundExtrnlArea "Exterior FOB Position recognize";
BA_ "GenSigSendType" SG_ 3221225472 Fob_FoundExtrnlArea 4;
BA_ "UserSigValidity" SG_ 3221225472 Fob_FoundExtrnlArea 0;
BA_ "GenSigTimeoutTime" SG_ 3221225472 Fob_FoundExtrnlArea 1500;
BA_ "Version" SG_ 3221225472 Fob_FoundExtrnlArea "17.12.00";
BA_ "Description" SG_ 3221225472 Fob_FoundIntArea "Interior FOB Position recognize";
BA_ "GenSigSendType" SG_ 3221225472 Fob_FoundIntArea 4;
BA_ "UserSigValidity" SG_ 3221225472 Fob_FoundIntArea 0;
BA_ "GenSigTimeoutTime" SG_ 3221225472 Fob_FoundIntArea 1500;
BA_ "Version" SG_ 3221225472 Fob_FoundIntArea "17.12.00";
BA_ "Description" SG_ 3221225472 Fob_LearntSta "Fob key registration status information";
BA_ "GenSigSendType" SG_ 3221225472 Fob_LearntSta 4;
BA_ "GenSigStartValue" SG_ 3221225472 Fob_LearntSta 1;
BA_ "UserSigValidity" SG_ 3221225472 Fob_LearntSta 0;
BA_ "GenSigTimeoutTime" SG_ 3221225472 Fob_LearntSta 1500;
BA_ "NetworkRequest" SG_ 3221225472 Fob_LearntSta 0;
BA_ "NetworkRequestHoldingTime" SG_ 3221225472 Fob_LearntSta 5000;
BA_ "Version" SG_ 3221225472 Fob_LearntSta "17.12.00";
BA_ "Description" SG_ 3221225472 LFAnt_FltSta "This signal represents LF ANT's Error condition. 

If one of LF ANT has Fault(ex, timeout), signal has fault value.";
BA_ "GenSigSendType" SG_ 3221225472 LFAnt_FltSta 4;
BA_ "UserSigValidity" SG_ 3221225472 LFAnt_FltSta 0;
BA_ "GenSigTimeoutTime" SG_ 3221225472 LFAnt_FltSta 1500;
BA_ "Version" SG_ 3221225472 LFAnt_FltSta "17.12.00";
BA_ "Description" SG_ 3221225472 LFAnt_SrchSta "SMK LF Searching Status



This signal indicates that SMK operates LF searching for finding FOB.

WPC uses this signal for suspending wirless charging.";
BA_ "GenSigSendType" SG_ 3221225472 LFAnt_SrchSta 4;
BA_ "UserSigValidity" SG_ 3221225472 LFAnt_SrchSta 0;
BA_ "GenSigTimeoutTime" SG_ 3221225472 LFAnt_SrchSta 1500;
BA_ "Version" SG_ 3221225472 LFAnt_SrchSta "17.12.00";
BA_ "Description" SG_ 3221225472 RSPA_ModSta_SMK "State of RSPA system operate";
BA_ "GenSigSendType" SG_ 3221225472 RSPA_ModSta_SMK 4;
BA_ "UserSigValidity" SG_ 3221225472 RSPA_ModSta_SMK 0;
BA_ "GenSigTimeoutTime" SG_ 3221225472 RSPA_ModSta_SMK 1500;
BA_ "Version" SG_ 3221225472 RSPA_ModSta_SMK "17.12.00";
BA_ "Description" SG_ 3221225472 RSPA_FobBattSta "FOB Battery's Low Battery(discharge) state.

Low Battery condition is same with 'C_KeyBATDischargeWarn' Signal";
BA_ "GenSigSendType" SG_ 3221225472 RSPA_FobBattSta 4;
BA_ "UserSigValidity" SG_ 3221225472 RSPA_FobBattSta 0;
BA_ "GenSigTimeoutTime" SG_ 3221225472 RSPA_FobBattSta 1500;
BA_ "Version" SG_ 3221225472 RSPA_FobBattSta "17.12.00";
BA_ "GenSigSendType" SG_ 3221225472 USM_SmrtTrnkTlgtModSta 4;
BA_ "UserSigValidity" SG_ 3221225472 USM_SmrtTrnkTlgtModSta 0;
BA_ "GenSigTimeoutTime" SG_ 3221225472 USM_SmrtTrnkTlgtModSta 1500;
BA_ "Version" SG_ 3221225472 USM_SmrtTrnkTlgtModSta "17.12.00";
BA_ "Description" SG_ 3221225472 USM_WALModSta "Current USM Setting value of Walk Away Lock(WAL) mode";
BA_ "GenSigSendType" SG_ 3221225472 USM_WALModSta 4;
BA_ "UserSigValidity" SG_ 3221225472 USM_WALModSta 0;
BA_ "GenSigTimeoutTime" SG_ 3221225472 USM_WALModSta 1500;
BA_ "Version" SG_ 3221225472 USM_WALModSta "17.12.00";
BA_ "Description" SG_ 3221225472 BCM_Crc12Val "The CRC checking process calculates the CRC over the entire data block, including the CRC result CRC Polynomial (0x1D) ,

Initial Value : 0x00, XOR value : 0x00

The mathematical expression to 8 bit CRC polynomial is given here. G(x) = x8 + x4 + x3 + x2 ";
BA_ "GenSigSendType" SG_ 3221225472 BCM_Crc12Val 4;
BA_ "GenSigStartValue" SG_ 3221225472 BCM_Crc12Val 255;
BA_ "UserSigValidity" SG_ 3221225472 BCM_Crc12Val 0;
BA_ "GenSigTimeoutTime" SG_ 3221225472 BCM_Crc12Val 1500;
BA_ "Version" SG_ 3221225472 BCM_Crc12Val "17.11.00";
BA_ "Description" SG_ 3221225472 BCM_AlvCnt12Val "For the first transmission request for a data element the counter shall be initialized with 0 and shall be incremented by 1

for every subsequent send request. When the counter reaches the maximum value(0xE), then it shall restart with ? for the next sen";
BA_ "GenSigSendType" SG_ 3221225472 BCM_AlvCnt12Val 4;
BA_ "UserSigValidity" SG_ 3221225472 BCM_AlvCnt12Val 0;
BA_ "GenSigTimeoutTime" SG_ 3221225472 BCM_AlvCnt12Val 1500;
BA_ "Version" SG_ 3221225472 BCM_AlvCnt12Val "17.11.00";
BA_ "GenSigSendType" SG_ 3221225472 BCM_CntryConfgTyp 4;
BA_ "UserSigValidity" SG_ 3221225472 BCM_CntryConfgTyp 0;
BA_ "GenSigTimeoutTime" SG_ 3221225472 BCM_CntryConfgTyp 1500;
BA_ "NetworkRequest" SG_ 3221225472 BCM_CntryConfgTyp 0;
BA_ "NetworkRequestHoldingTime" SG_ 3221225472 BCM_CntryConfgTyp 5000;
BA_ "Version" SG_ 3221225472 BCM_CntryConfgTyp "17.12.00";
BA_ "Description" SG_ 3221225472 BCM_SmkOptTyp "-(Old)C_PICOption";
BA_ "GenSigSendType" SG_ 3221225472 BCM_SmkOptTyp 4;
BA_ "UserSigValidity" SG_ 3221225472 BCM_SmkOptTyp 0;
BA_ "GenSigTimeoutTime" SG_ 3221225472 BCM_SmkOptTyp 1500;
BA_ "NetworkRequest" SG_ 3221225472 BCM_SmkOptTyp 0;
BA_ "NetworkRequestHoldingTime" SG_ 3221225472 BCM_SmkOptTyp 5000;
BA_ "Version" SG_ 3221225472 BCM_SmkOptTyp "17.12.00";
BA_ "GenSigSendType" SG_ 3221225472 Window_DrvrSdWdwSta_BCM 4;
BA_ "UserSigValidity" SG_ 3221225472 Window_DrvrSdWdwSta_BCM 0;
BA_ "GenSigTimeoutTime" SG_ 3221225472 Window_DrvrSdWdwSta_BCM 1500;
BA_ "NetworkRequest" SG_ 3221225472 Window_DrvrSdWdwSta_BCM 0;
BA_ "NetworkRequestHoldingTime" SG_ 3221225472 Window_DrvrSdWdwSta_BCM 5000;
BA_ "Version" SG_ 3221225472 Window_DrvrSdWdwSta_BCM "17.12.00";
BA_ "Description" SG_ 3221225472 Window_AsstSdWdwSta_BCM "-(Old)C_AstWdwStat";
BA_ "GenSigSendType" SG_ 3221225472 Window_AsstSdWdwSta_BCM 4;
BA_ "UserSigValidity" SG_ 3221225472 Window_AsstSdWdwSta_BCM 0;
BA_ "GenSigTimeoutTime" SG_ 3221225472 Window_AsstSdWdwSta_BCM 1500;
BA_ "NetworkRequest" SG_ 3221225472 Window_AsstSdWdwSta_BCM 0;
BA_ "NetworkRequestHoldingTime" SG_ 3221225472 Window_AsstSdWdwSta_BCM 5000;
BA_ "Version" SG_ 3221225472 Window_AsstSdWdwSta_BCM "17.12.00";
BA_ "Description" SG_ 3221225472 Window_RrLftWdwSta_BCM "-(Old)C_RLWdwSta";
BA_ "GenSigSendType" SG_ 3221225472 Window_RrLftWdwSta_BCM 4;
BA_ "UserSigValidity" SG_ 3221225472 Window_RrLftWdwSta_BCM 0;
BA_ "GenSigTimeoutTime" SG_ 3221225472 Window_RrLftWdwSta_BCM 1500;
BA_ "NetworkRequest" SG_ 3221225472 Window_RrLftWdwSta_BCM 0;
BA_ "NetworkRequestHoldingTime" SG_ 3221225472 Window_RrLftWdwSta_BCM 5000;
BA_ "Version" SG_ 3221225472 Window_RrLftWdwSta_BCM "17.12.00";
BA_ "Description" SG_ 3221225472 Window_RrRtWdwSta_BCM "-(Old)C_RRWdwStat";
BA_ "GenSigSendType" SG_ 3221225472 Window_RrRtWdwSta_BCM 4;
BA_ "UserSigValidity" SG_ 3221225472 Window_RrRtWdwSta_BCM 0;
BA_ "GenSigTimeoutTime" SG_ 3221225472 Window_RrRtWdwSta_BCM 1500;
BA_ "NetworkRequest" SG_ 3221225472 Window_RrRtWdwSta_BCM 0;
BA_ "NetworkRequestHoldingTime" SG_ 3221225472 Window_RrRtWdwSta_BCM 5000;
BA_ "Version" SG_ 3221225472 Window_RrRtWdwSta_BCM "17.12.00";
BA_ "Description" SG_ 3221225472 Window_TunlModAutoIndSta "To indicate the tunnel mode comfort function control";
BA_ "GenSigSendType" SG_ 3221225472 Window_TunlModAutoIndSta 4;
BA_ "UserSigValidity" SG_ 3221225472 Window_TunlModAutoIndSta 0;
BA_ "GenSigTimeoutTime" SG_ 3221225472 Window_TunlModAutoIndSta 1500;
BA_ "NetworkRequest" SG_ 3221225472 Window_TunlModAutoIndSta 0;
BA_ "NetworkRequestHoldingTime" SG_ 3221225472 Window_TunlModAutoIndSta 5000;
BA_ "Version" SG_ 3221225472 Window_TunlModAutoIndSta "17.12.00";
BA_ "Description" SG_ 3221225472 ACU_Crc2Val "The CRC checking process calculates the CRC over the entire data block, including the CRC result.

- CRC Polynomial (0x1021) , Initial Value : 0xFFFF, XOR value : 0x0000

- The mathematical expression to 16 bit CRC polynomial is given here. G(x) = x16 + ";
BA_ "GenSigSendType" SG_ 3221225472 ACU_Crc2Val 2;
BA_ "GenSigStartValue" SG_ 3221225472 ACU_Crc2Val 65535;
BA_ "UserSigValidity" SG_ 3221225472 ACU_Crc2Val 3;
BA_ "GenSigTimeoutTime" SG_ 3221225472 ACU_Crc2Val 0;
BA_ "Version" SG_ 3221225472 ACU_Crc2Val "17.11.00";
BA_ "Description" SG_ 3221225472 ACU_AlvCnt2Val "For the first transmission request for a data element the counter shall be initialized with 0 and shall be incremented by 1

for every subsequent send request. When the counter reaches the maximum value(0xFF), then it shall restart with ? for the next se";
BA_ "GenSigSendType" SG_ 3221225472 ACU_AlvCnt2Val 2;
BA_ "UserSigValidity" SG_ 3221225472 ACU_AlvCnt2Val 3;
BA_ "GenSigTimeoutTime" SG_ 3221225472 ACU_AlvCnt2Val 0;
BA_ "Version" SG_ 3221225472 ACU_AlvCnt2Val "17.11.00";
BA_ "Description" SG_ 3221225472 ACU_CrshActvSta "Information regarding the crash. It indicates crash is active or inactive.";
BA_ "GenSigSendType" SG_ 3221225472 ACU_CrshActvSta 2;
BA_ "UserSigValidity" SG_ 3221225472 ACU_CrshActvSta 3;
BA_ "GenSigTimeoutTime" SG_ 3221225472 ACU_CrshActvSta 0;
BA_ "Version" SG_ 3221225472 ACU_CrshActvSta "17.12.00";
BA_ "GenSigSendType" SG_ 3221225472 APSS_SldTch 4;
BA_ "UserSigValidity" SG_ 3221225472 APSS_SldTch 3;
BA_ "GenSigTimeoutTime" SG_ 3221225472 APSS_SldTch 1500;
BA_ "NetworkRequest" SG_ 3221225472 APSS_SldTch 0;
BA_ "NetworkRequestHoldingTime" SG_ 3221225472 APSS_SldTch 5000;
BA_ "Version" SG_ 3221225472 APSS_SldTch "18.02.03";
BA_ "GenSigSendType" SG_ 3221225472 APSS_RclTch 4;
BA_ "UserSigValidity" SG_ 3221225472 APSS_RclTch 3;
BA_ "GenSigTimeoutTime" SG_ 3221225472 APSS_RclTch 1500;
BA_ "NetworkRequest" SG_ 3221225472 APSS_RclTch 0;
BA_ "NetworkRequestHoldingTime" SG_ 3221225472 APSS_RclTch 5000;
BA_ "Version" SG_ 3221225472 APSS_RclTch "18.02.03";
BA_ "GenSigSendType" SG_ 3221225472 APSS_LmbrTch 4;
BA_ "UserSigValidity" SG_ 3221225472 APSS_LmbrTch 3;
BA_ "GenSigTimeoutTime" SG_ 3221225472 APSS_LmbrTch 1500;
BA_ "NetworkRequest" SG_ 3221225472 APSS_LmbrTch 0;
BA_ "NetworkRequestHoldingTime" SG_ 3221225472 APSS_LmbrTch 5000;
BA_ "Version" SG_ 3221225472 APSS_LmbrTch "18.02.03";
BA_ "Description" SG_ 3221225472 ALU_LumbarUpSw "This signal is used to display the seat movement to AVN";
BA_ "GenSigSendType" SG_ 3221225472 ALU_LumbarUpSw 4;
BA_ "UserSigValidity" SG_ 3221225472 ALU_LumbarUpSw 1;
BA_ "GenSigTimeoutTime" SG_ 3221225472 ALU_LumbarUpSw 1500;
BA_ "NetworkRequest" SG_ 3221225472 ALU_LumbarUpSw 0;
BA_ "NetworkRequestHoldingTime" SG_ 3221225472 ALU_LumbarUpSw 5000;
BA_ "Version" SG_ 3221225472 ALU_LumbarUpSw "18.02.03";
BA_ "Description" SG_ 3221225472 ALU_LumbarMidSw "This signal is used to display the seat movement to AVN";
BA_ "GenSigSendType" SG_ 3221225472 ALU_LumbarMidSw 4;
BA_ "UserSigValidity" SG_ 3221225472 ALU_LumbarMidSw 1;
BA_ "GenSigTimeoutTime" SG_ 3221225472 ALU_LumbarMidSw 1500;
BA_ "NetworkRequest" SG_ 3221225472 ALU_LumbarMidSw 0;
BA_ "NetworkRequestHoldingTime" SG_ 3221225472 ALU_LumbarMidSw 5000;
BA_ "Version" SG_ 3221225472 ALU_LumbarMidSw "18.02.03";
BA_ "Description" SG_ 3221225472 ALU_LumbarLowSw "This signal is used to display the seat movement to AVN";
BA_ "GenSigSendType" SG_ 3221225472 ALU_LumbarLowSw 4;
BA_ "UserSigValidity" SG_ 3221225472 ALU_LumbarLowSw 1;
BA_ "GenSigTimeoutTime" SG_ 3221225472 ALU_LumbarLowSw 1500;
BA_ "NetworkRequest" SG_ 3221225472 ALU_LumbarLowSw 0;
BA_ "NetworkRequestHoldingTime" SG_ 3221225472 ALU_LumbarLowSw 5000;
BA_ "Version" SG_ 3221225472 ALU_LumbarLowSw "18.02.03";
BA_ "Description" SG_ 3221225472 ALU_LumbarDefSw "This signal is used to display the seat movement to AVN";
BA_ "GenSigSendType" SG_ 3221225472 ALU_LumbarDefSw 4;
BA_ "UserSigValidity" SG_ 3221225472 ALU_LumbarDefSw 1;
BA_ "GenSigTimeoutTime" SG_ 3221225472 ALU_LumbarDefSw 1500;
BA_ "NetworkRequest" SG_ 3221225472 ALU_LumbarDefSw 0;
BA_ "NetworkRequestHoldingTime" SG_ 3221225472 ALU_LumbarDefSw 5000;
BA_ "Version" SG_ 3221225472 ALU_LumbarDefSw "18.02.03";
BA_ "Description" SG_ 3221225472 C_LH_Folding_State_PopUp "AVN 조작 신호에 따른 3열 LH측 시트 백 동작 완료 정보 (AVN 팝업 표시 신호)

 - 3rd LH seat Moving Finish / Mode-Fail signal";
BA_ "GenSigSendType" SG_ 3221225472 C_LH_Folding_State_PopUp 4;
BA_ "UserSigValidity" SG_ 3221225472 C_LH_Folding_State_PopUp 0;
BA_ "GenSigTimeoutTime" SG_ 3221225472 C_LH_Folding_State_PopUp 0;
BA_ "NetworkRequest" SG_ 3221225472 C_LH_Folding_State_PopUp 0;
BA_ "NetworkRequestHoldingTime" SG_ 3221225472 C_LH_Folding_State_PopUp 5000;
BA_ "Version" SG_ 3221225472 C_LH_Folding_State_PopUp "18.03.01";
BA_ "Description" SG_ 3221225472 C_RH_Folding_State_PopUp "AVN 조작 신호에 따른 3열 RH측 시트 백 동작 완료 정보 (AVN 팝업 표시 신호)

 - 3rd RH seat Moving Finish / Mode-Fail signal";
BA_ "GenSigSendType" SG_ 3221225472 C_RH_Folding_State_PopUp 4;
BA_ "UserSigValidity" SG_ 3221225472 C_RH_Folding_State_PopUp 0;
BA_ "GenSigTimeoutTime" SG_ 3221225472 C_RH_Folding_State_PopUp 0;
BA_ "NetworkRequest" SG_ 3221225472 C_RH_Folding_State_PopUp 0;
BA_ "NetworkRequestHoldingTime" SG_ 3221225472 C_RH_Folding_State_PopUp 5000;
BA_ "Version" SG_ 3221225472 C_RH_Folding_State_PopUp "18.03.01";
BA_ "GenSigSendType" SG_ 3221225472 MLM_MdLmpBrgtnsVal 4;
BA_ "UserSigValidity" SG_ 3221225472 MLM_MdLmpBrgtnsVal 0;
BA_ "GenSigTimeoutTime" SG_ 3221225472 MLM_MdLmpBrgtnsVal 1500;
BA_ "NetworkRequest" SG_ 3221225472 MLM_MdLmpBrgtnsVal 0;
BA_ "NetworkRequestHoldingTime" SG_ 3221225472 MLM_MdLmpBrgtnsVal 5000;
BA_ "Version" SG_ 3221225472 MLM_MdLmpBrgtnsVal "17.11.00";
BA_ "GenSigSendType" SG_ 3221225472 MLM_MdLmpDrvngVal 4;
BA_ "UserSigValidity" SG_ 3221225472 MLM_MdLmpDrvngVal 0;
BA_ "GenSigTimeoutTime" SG_ 3221225472 MLM_MdLmpDrvngVal 1500;
BA_ "NetworkRequest" SG_ 3221225472 MLM_MdLmpDrvngVal 0;
BA_ "NetworkRequestHoldingTime" SG_ 3221225472 MLM_MdLmpDrvngVal 5000;
BA_ "Version" SG_ 3221225472 MLM_MdLmpDrvngVal "17.11.00";
BA_ "GenSigSendType" SG_ 3221225472 MLM_MdLmpRedVal 4;
BA_ "GenSigStartValue" SG_ 3221225472 MLM_MdLmpRedVal 512;
BA_ "UserSigValidity" SG_ 3221225472 MLM_MdLmpRedVal 1;
BA_ "GenSigTimeoutTime" SG_ 3221225472 MLM_MdLmpRedVal 1500;
BA_ "Version" SG_ 3221225472 MLM_MdLmpRedVal "17.11.00";
BA_ "GenSigSendType" SG_ 3221225472 MLM_MdLmpGreenVal 4;
BA_ "GenSigStartValue" SG_ 3221225472 MLM_MdLmpGreenVal 512;
BA_ "UserSigValidity" SG_ 3221225472 MLM_MdLmpGreenVal 1;
BA_ "GenSigTimeoutTime" SG_ 3221225472 MLM_MdLmpGreenVal 1500;
BA_ "Version" SG_ 3221225472 MLM_MdLmpGreenVal "17.11.00";
BA_ "GenSigSendType" SG_ 3221225472 MLM_MdLmpBlueVal 4;
BA_ "GenSigStartValue" SG_ 3221225472 MLM_MdLmpBlueVal 512;
BA_ "UserSigValidity" SG_ 3221225472 MLM_MdLmpBlueVal 1;
BA_ "GenSigTimeoutTime" SG_ 3221225472 MLM_MdLmpBlueVal 1500;
BA_ "Version" SG_ 3221225472 MLM_MdLmpBlueVal "17.11.00";
BA_ "Description" SG_ 3221225472 ILCU_RH_Crc2Val "The CRC checking process calculates the CRC over the entire data block, including the CRC result CRC Polynomial (0x1D) ,

Initial Value : 0x00, XOR value : 0x00

The mathematical expression to 8 bit CRC polynomial is given here. G(x) = x8 + x4 + x3 + x2 ";
BA_ "GenSigStartValue" SG_ 3221225472 ILCU_RH_Crc2Val 255;
BA_ "UserSigValidity" SG_ 3221225472 ILCU_RH_Crc2Val 0;
BA_ "Version" SG_ 3221225472 ILCU_RH_Crc2Val "17.12.02";
BA_ "Description" SG_ 3221225472 ILCU_RH_AlvCnt2Val "For the first transmission request for a data element the counter shall be initialized with 0 and shall be incremented by 1

for every subsequent send request. When the counter reaches the maximum value(0xE), then it shall restart with ? for the next sen";
BA_ "UserSigValidity" SG_ 3221225472 ILCU_RH_AlvCnt2Val 0;
BA_ "Version" SG_ 3221225472 ILCU_RH_AlvCnt2Val "17.12.02";
BA_ "UserSigValidity" SG_ 3221225472 ILCURH_HeightSnsrFront_Val 3;
BA_ "NetworkRequest" SG_ 3221225472 ILCURH_HeightSnsrFront_Val 0;
BA_ "NetworkRequestHoldingTime" SG_ 3221225472 ILCURH_HeightSnsrFront_Val 5000;
BA_ "Version" SG_ 3221225472 ILCURH_HeightSnsrFront_Val "17.12.02";
BA_ "UserSigValidity" SG_ 3221225472 ILCURH_HeightSnsrFront_Stat 3;
BA_ "NetworkRequest" SG_ 3221225472 ILCURH_HeightSnsrFront_Stat 0;
BA_ "NetworkRequestHoldingTime" SG_ 3221225472 ILCURH_HeightSnsrFront_Stat 5000;
BA_ "Version" SG_ 3221225472 ILCURH_HeightSnsrFront_Stat "17.12.02";
BA_ "UserSigValidity" SG_ 3221225472 ILCURH_LevelActuator_Sta 3;
BA_ "NetworkRequest" SG_ 3221225472 ILCURH_LevelActuator_Sta 0;
BA_ "NetworkRequestHoldingTime" SG_ 3221225472 ILCURH_LevelActuator_Sta 5000;
BA_ "Version" SG_ 3221225472 ILCURH_LevelActuator_Sta "17.12.02";
BA_ "Description" SG_ 3221225472 SMK_Crc3Val "The CRC checking process calculates the CRC over the entire data block, including the CRC result CRC Polynomial (0x1D) ,

Initial Value : 0x00, XOR value : 0x00

The mathematical expression to 8 bit CRC polynomial is given here. G(x) = x8 + x4 + x3 + x2 ";
BA_ "GenSigSendType" SG_ 3221225472 SMK_Crc3Val 4;
BA_ "GenSigStartValue" SG_ 3221225472 SMK_Crc3Val 255;
BA_ "UserSigValidity" SG_ 3221225472 SMK_Crc3Val 0;
BA_ "GenSigTimeoutTime" SG_ 3221225472 SMK_Crc3Val 1500;
BA_ "Version" SG_ 3221225472 SMK_Crc3Val "17.11.00";
BA_ "Description" SG_ 3221225472 SMK_AlvCnt3Val "For the first transmission request for a data element the counter shall be initialized with 0 and shall be incremented by 1

for every subsequent send request. When the counter reaches the maximum value(0xE), then it shall restart with ? for the next sen";
BA_ "GenSigSendType" SG_ 3221225472 SMK_AlvCnt3Val 4;
BA_ "UserSigValidity" SG_ 3221225472 SMK_AlvCnt3Val 0;
BA_ "GenSigTimeoutTime" SG_ 3221225472 SMK_AlvCnt3Val 1500;
BA_ "Version" SG_ 3221225472 SMK_AlvCnt3Val "17.11.00";
BA_ "Description" SG_ 3221225472 ESCL_EsclMngrSta "ESCL manager state";
BA_ "GenSigSendType" SG_ 3221225472 ESCL_EsclMngrSta 4;
BA_ "UserSigValidity" SG_ 3221225472 ESCL_EsclMngrSta 0;
BA_ "GenSigTimeoutTime" SG_ 3221225472 ESCL_EsclMngrSta 1500;
BA_ "Version" SG_ 3221225472 ESCL_EsclMngrSta "17.12.00";
BA_ "Description" SG_ 3221225472 ESCL_EsclPwrSupSta "ESCL GND & BAT supply line status";
BA_ "GenSigSendType" SG_ 3221225472 ESCL_EsclPwrSupSta 4;
BA_ "UserSigValidity" SG_ 3221225472 ESCL_EsclPwrSupSta 0;
BA_ "GenSigTimeoutTime" SG_ 3221225472 ESCL_EsclPwrSupSta 1500;
BA_ "Version" SG_ 3221225472 ESCL_EsclPwrSupSta "17.12.00";
BA_ "Description" SG_ 3221225472 ESCL_EsclEnaSta "SMK ESCL Enable output status";
BA_ "GenSigSendType" SG_ 3221225472 ESCL_EsclEnaSta 4;
BA_ "UserSigValidity" SG_ 3221225472 ESCL_EsclEnaSta 0;
BA_ "GenSigTimeoutTime" SG_ 3221225472 ESCL_EsclEnaSta 1500;
BA_ "Version" SG_ 3221225472 ESCL_EsclEnaSta "17.12.00";
BA_ "Description" SG_ 3221225472 ESCL_EsclUnitSta "ESCL unit status";
BA_ "GenSigSendType" SG_ 3221225472 ESCL_EsclUnitSta 4;
BA_ "UserSigValidity" SG_ 3221225472 ESCL_EsclUnitSta 0;
BA_ "GenSigTimeoutTime" SG_ 3221225472 ESCL_EsclUnitSta 1500;
BA_ "Version" SG_ 3221225472 ESCL_EsclUnitSta "17.12.00";
BA_ "Description" SG_ 3221225472 ESCL_EsclBoltSta "ESCL bolt status";
BA_ "GenSigSendType" SG_ 3221225472 ESCL_EsclBoltSta 4;
BA_ "UserSigValidity" SG_ 3221225472 ESCL_EsclBoltSta 0;
BA_ "GenSigTimeoutTime" SG_ 3221225472 ESCL_EsclBoltSta 1500;
BA_ "Version" SG_ 3221225472 ESCL_EsclBoltSta "17.12.00";
BA_ "Description" SG_ 3221225472 ESCL_EsclLoBattSta "Mirror value of ESCL Low Battery bit in ESCL Status bytes";
BA_ "GenSigSendType" SG_ 3221225472 ESCL_EsclLoBattSta 4;
BA_ "UserSigValidity" SG_ 3221225472 ESCL_EsclLoBattSta 0;
BA_ "GenSigTimeoutTime" SG_ 3221225472 ESCL_EsclLoBattSta 1500;
BA_ "Version" SG_ 3221225472 ESCL_EsclLoBattSta "17.12.00";
BA_ "Description" SG_ 3221225472 ESCL_EsclUnLkSwSta "ESCL unlock switch status";
BA_ "GenSigSendType" SG_ 3221225472 ESCL_EsclUnLkSwSta 4;
BA_ "UserSigValidity" SG_ 3221225472 ESCL_EsclUnLkSwSta 0;
BA_ "GenSigTimeoutTime" SG_ 3221225472 ESCL_EsclUnLkSwSta 1500;
BA_ "Version" SG_ 3221225472 ESCL_EsclUnLkSwSta "17.12.00";
BA_ "Description" SG_ 3221225472 C_LH_Folding_Position "3열 LH 시트 백 현재 위치 상태 정보 송신

 - Seat Position Information signal for 3rd LH seat";
BA_ "GenSigSendType" SG_ 3221225472 C_LH_Folding_Position 4;
BA_ "UserSigValidity" SG_ 3221225472 C_LH_Folding_Position 0;
BA_ "GenSigTimeoutTime" SG_ 3221225472 C_LH_Folding_Position 1500;
BA_ "NetworkRequest" SG_ 3221225472 C_LH_Folding_Position 0;
BA_ "NetworkRequestHoldingTime" SG_ 3221225472 C_LH_Folding_Position 5000;
BA_ "Version" SG_ 3221225472 C_LH_Folding_Position "18.03.01";
BA_ "Description" SG_ 3221225472 C_RH_Folding_Position "3열 RH 시트 백 현재 위치 상태 정보 송신

 - Seat Position Information signal for 3rd RH seat";
BA_ "GenSigSendType" SG_ 3221225472 C_RH_Folding_Position 4;
BA_ "UserSigValidity" SG_ 3221225472 C_RH_Folding_Position 0;
BA_ "GenSigTimeoutTime" SG_ 3221225472 C_RH_Folding_Position 1500;
BA_ "NetworkRequest" SG_ 3221225472 C_RH_Folding_Position 0;
BA_ "NetworkRequestHoldingTime" SG_ 3221225472 C_RH_Folding_Position 5000;
BA_ "Version" SG_ 3221225472 C_RH_Folding_Position "18.03.01";
BA_ "Description" SG_ 3221225472 PFSU_RL_Folding_SW "3열 Left 폴딩 스위치를 연동 동작 위해 2열 Left에 전달

- 3rd LH Seat folding Information to 2nd LH Seat";
BA_ "GenSigSendType" SG_ 3221225472 PFSU_RL_Folding_SW 4;
BA_ "UserSigValidity" SG_ 3221225472 PFSU_RL_Folding_SW 0;
BA_ "GenSigTimeoutTime" SG_ 3221225472 PFSU_RL_Folding_SW 1500;
BA_ "NetworkRequest" SG_ 3221225472 PFSU_RL_Folding_SW 0;
BA_ "NetworkRequestHoldingTime" SG_ 3221225472 PFSU_RL_Folding_SW 5000;
BA_ "Version" SG_ 3221225472 PFSU_RL_Folding_SW "18.05.00";
BA_ "Description" SG_ 3221225472 PFSU_RR_Folding_SW "3열 Right 폴딩 스위치를 연동 동작 위해 2열 Right에 전달

- 3rd RH Seat folding Information to 2nd RH Seat";
BA_ "GenSigSendType" SG_ 3221225472 PFSU_RR_Folding_SW 4;
BA_ "UserSigValidity" SG_ 3221225472 PFSU_RR_Folding_SW 0;
BA_ "GenSigTimeoutTime" SG_ 3221225472 PFSU_RR_Folding_SW 1500;
BA_ "NetworkRequest" SG_ 3221225472 PFSU_RR_Folding_SW 0;
BA_ "NetworkRequestHoldingTime" SG_ 3221225472 PFSU_RR_Folding_SW 5000;
BA_ "Version" SG_ 3221225472 PFSU_RR_Folding_SW "18.05.00";
BA_ "Description" SG_ 3221225472 PFSU_RL_Unfolding_SW "3열 Left 언폴딩 스위치를 연동 동작 위해 2열 Left에 전달

- 3rd LH Seat unfolding Information to 2nd LH Seat";
BA_ "GenSigSendType" SG_ 3221225472 PFSU_RL_Unfolding_SW 4;
BA_ "UserSigValidity" SG_ 3221225472 PFSU_RL_Unfolding_SW 0;
BA_ "GenSigTimeoutTime" SG_ 3221225472 PFSU_RL_Unfolding_SW 1500;
BA_ "NetworkRequest" SG_ 3221225472 PFSU_RL_Unfolding_SW 0;
BA_ "NetworkRequestHoldingTime" SG_ 3221225472 PFSU_RL_Unfolding_SW 5000;
BA_ "Version" SG_ 3221225472 PFSU_RL_Unfolding_SW "18.05.00";
BA_ "Description" SG_ 3221225472 PFSU_RR_Unfolding_SW "3열 Right 언폴딩 스위치를 연동 동작 위해 2열 Right에 전달

- 3rd RH Seat unfolding Information to 2nd RH Seat";
BA_ "GenSigSendType" SG_ 3221225472 PFSU_RR_Unfolding_SW 4;
BA_ "UserSigValidity" SG_ 3221225472 PFSU_RR_Unfolding_SW 0;
BA_ "GenSigTimeoutTime" SG_ 3221225472 PFSU_RR_Unfolding_SW 1500;
BA_ "NetworkRequest" SG_ 3221225472 PFSU_RR_Unfolding_SW 0;
BA_ "NetworkRequestHoldingTime" SG_ 3221225472 PFSU_RR_Unfolding_SW 5000;
BA_ "Version" SG_ 3221225472 PFSU_RR_Unfolding_SW "18.05.00";
BA_ "Description" SG_ 3221225472 RR_SHVU_SeatOptSta "후석 RH 시트에 적용된 히터/통풍 옵션 사양";
BA_ "GenSigSendType" SG_ 3221225472 RR_SHVU_SeatOptSta 4;
BA_ "UserSigValidity" SG_ 3221225472 RR_SHVU_SeatOptSta 3;
BA_ "GenSigTimeoutTime" SG_ 3221225472 RR_SHVU_SeatOptSta 1500;
BA_ "NetworkRequest" SG_ 3221225472 RR_SHVU_SeatOptSta 0;
BA_ "NetworkRequestHoldingTime" SG_ 3221225472 RR_SHVU_SeatOptSta 5000;
BA_ "Version" SG_ 3221225472 RR_SHVU_SeatOptSta "17.12.03";
BA_ "Description" SG_ 3221225472 RR_SHVU_SeatHtOperSta "후석 RH 시트 현재 작동 중인 히터/통풍 단수 상태";
BA_ "GenSigSendType" SG_ 3221225472 RR_SHVU_SeatHtOperSta 4;
BA_ "UserSigValidity" SG_ 3221225472 RR_SHVU_SeatHtOperSta 3;
BA_ "GenSigTimeoutTime" SG_ 3221225472 RR_SHVU_SeatHtOperSta 1500;
BA_ "NetworkRequest" SG_ 3221225472 RR_SHVU_SeatHtOperSta 0;
BA_ "NetworkRequestHoldingTime" SG_ 3221225472 RR_SHVU_SeatHtOperSta 5000;
BA_ "Version" SG_ 3221225472 RR_SHVU_SeatHtOperSta "17.12.03";
BA_ "GenSigSendType" SG_ 3221225472 IAU_EncryptedResult1Val 4;
BA_ "UserSigValidity" SG_ 3221225472 IAU_EncryptedResult1Val 0;
BA_ "GenSigTimeoutTime" SG_ 3221225472 IAU_EncryptedResult1Val 0;
BA_ "NetworkRequest" SG_ 3221225472 IAU_EncryptedResult1Val 0;
BA_ "NetworkRequestHoldingTime" SG_ 3221225472 IAU_EncryptedResult1Val 5000;
BA_ "Version" SG_ 3221225472 IAU_EncryptedResult1Val "17.12.08";
BA_ "Description" SG_ 3221225472 APSU_AstStSldFwdDis "This signal is used to display the seat movement to AVN";
BA_ "GenSigSendType" SG_ 3221225472 APSU_AstStSldFwdDis 4;
BA_ "UserSigValidity" SG_ 3221225472 APSU_AstStSldFwdDis 1;
BA_ "GenSigTimeoutTime" SG_ 3221225472 APSU_AstStSldFwdDis 1500;
BA_ "NetworkRequest" SG_ 3221225472 APSU_AstStSldFwdDis 0;
BA_ "NetworkRequestHoldingTime" SG_ 3221225472 APSU_AstStSldFwdDis 5000;
BA_ "Version" SG_ 3221225472 APSU_AstStSldFwdDis "18.02.01";
BA_ "Description" SG_ 3221225472 APSU_AstStSldBckwdDis "This signal is used to display the seat movement to AVN";
BA_ "GenSigSendType" SG_ 3221225472 APSU_AstStSldBckwdDis 4;
BA_ "UserSigValidity" SG_ 3221225472 APSU_AstStSldBckwdDis 1;
BA_ "GenSigTimeoutTime" SG_ 3221225472 APSU_AstStSldBckwdDis 1500;
BA_ "NetworkRequest" SG_ 3221225472 APSU_AstStSldBckwdDis 0;
BA_ "NetworkRequestHoldingTime" SG_ 3221225472 APSU_AstStSldBckwdDis 5000;
BA_ "Version" SG_ 3221225472 APSU_AstStSldBckwdDis "18.02.01";
BA_ "Description" SG_ 3221225472 APSU_AstStReclneFwdDis "This signal is used to display the seat movement to AVN";
BA_ "GenSigSendType" SG_ 3221225472 APSU_AstStReclneFwdDis 4;
BA_ "UserSigValidity" SG_ 3221225472 APSU_AstStReclneFwdDis 1;
BA_ "GenSigTimeoutTime" SG_ 3221225472 APSU_AstStReclneFwdDis 1500;
BA_ "NetworkRequest" SG_ 3221225472 APSU_AstStReclneFwdDis 0;
BA_ "NetworkRequestHoldingTime" SG_ 3221225472 APSU_AstStReclneFwdDis 5000;
BA_ "Version" SG_ 3221225472 APSU_AstStReclneFwdDis "18.02.01";
BA_ "Description" SG_ 3221225472 APSU_AstStReclneBckwdDis "This signal is used to display the seat movement to AVN";
BA_ "GenSigSendType" SG_ 3221225472 APSU_AstStReclneBckwdDis 4;
BA_ "UserSigValidity" SG_ 3221225472 APSU_AstStReclneBckwdDis 1;
BA_ "GenSigTimeoutTime" SG_ 3221225472 APSU_AstStReclneBckwdDis 1500;
BA_ "NetworkRequest" SG_ 3221225472 APSU_AstStReclneBckwdDis 0;
BA_ "NetworkRequestHoldingTime" SG_ 3221225472 APSU_AstStReclneBckwdDis 5000;
BA_ "Version" SG_ 3221225472 APSU_AstStReclneBckwdDis "18.02.01";
BA_ "Description" SG_ 3221225472 APSU_AstStTiltUpDis "This signal is used to display the seat movement to AVN";
BA_ "GenSigSendType" SG_ 3221225472 APSU_AstStTiltUpDis 4;
BA_ "UserSigValidity" SG_ 3221225472 APSU_AstStTiltUpDis 1;
BA_ "GenSigTimeoutTime" SG_ 3221225472 APSU_AstStTiltUpDis 1500;
BA_ "NetworkRequest" SG_ 3221225472 APSU_AstStTiltUpDis 0;
BA_ "NetworkRequestHoldingTime" SG_ 3221225472 APSU_AstStTiltUpDis 5000;
BA_ "Version" SG_ 3221225472 APSU_AstStTiltUpDis "18.02.01";
BA_ "Description" SG_ 3221225472 APSU_AstStTiltDnDis "This signal is used to display the seat movement to AVN";
BA_ "GenSigSendType" SG_ 3221225472 APSU_AstStTiltDnDis 4;
BA_ "UserSigValidity" SG_ 3221225472 APSU_AstStTiltDnDis 1;
BA_ "GenSigTimeoutTime" SG_ 3221225472 APSU_AstStTiltDnDis 1500;
BA_ "NetworkRequest" SG_ 3221225472 APSU_AstStTiltDnDis 0;
BA_ "NetworkRequestHoldingTime" SG_ 3221225472 APSU_AstStTiltDnDis 5000;
BA_ "Version" SG_ 3221225472 APSU_AstStTiltDnDis "18.02.01";
BA_ "Description" SG_ 3221225472 APSU_AstStHghtUpDis "This signal is used to display the seat movement to AVN";
BA_ "GenSigSendType" SG_ 3221225472 APSU_AstStHghtUpDis 4;
BA_ "UserSigValidity" SG_ 3221225472 APSU_AstStHghtUpDis 1;
BA_ "GenSigTimeoutTime" SG_ 3221225472 APSU_AstStHghtUpDis 1500;
BA_ "NetworkRequest" SG_ 3221225472 APSU_AstStHghtUpDis 0;
BA_ "NetworkRequestHoldingTime" SG_ 3221225472 APSU_AstStHghtUpDis 5000;
BA_ "Version" SG_ 3221225472 APSU_AstStHghtUpDis "18.02.01";
BA_ "Description" SG_ 3221225472 APSU_AstStHghtDnDis "This signal is used to display the seat movement to AVN";
BA_ "GenSigSendType" SG_ 3221225472 APSU_AstStHghtDnDis 4;
BA_ "UserSigValidity" SG_ 3221225472 APSU_AstStHghtDnDis 1;
BA_ "GenSigTimeoutTime" SG_ 3221225472 APSU_AstStHghtDnDis 1500;
BA_ "NetworkRequest" SG_ 3221225472 APSU_AstStHghtDnDis 0;
BA_ "NetworkRequestHoldingTime" SG_ 3221225472 APSU_AstStHghtDnDis 5000;
BA_ "Version" SG_ 3221225472 APSU_AstStHghtDnDis "18.02.01";
BA_ "Description" SG_ 3221225472 APSU_AstStLmbrDefDis "This signal is used to display the seat movement to AVN";
BA_ "GenSigSendType" SG_ 3221225472 APSU_AstStLmbrDefDis 4;
BA_ "UserSigValidity" SG_ 3221225472 APSU_AstStLmbrDefDis 1;
BA_ "GenSigTimeoutTime" SG_ 3221225472 APSU_AstStLmbrDefDis 1500;
BA_ "NetworkRequest" SG_ 3221225472 APSU_AstStLmbrDefDis 0;
BA_ "NetworkRequestHoldingTime" SG_ 3221225472 APSU_AstStLmbrDefDis 5000;
BA_ "Version" SG_ 3221225472 APSU_AstStLmbrDefDis "18.02.01";
BA_ "Description" SG_ 3221225472 APSU_AstStLmbrLoDis "This signal is used to display the seat movement to AVN";
BA_ "GenSigSendType" SG_ 3221225472 APSU_AstStLmbrLoDis 4;
BA_ "UserSigValidity" SG_ 3221225472 APSU_AstStLmbrLoDis 1;
BA_ "GenSigTimeoutTime" SG_ 3221225472 APSU_AstStLmbrLoDis 1500;
BA_ "NetworkRequest" SG_ 3221225472 APSU_AstStLmbrLoDis 0;
BA_ "NetworkRequestHoldingTime" SG_ 3221225472 APSU_AstStLmbrLoDis 5000;
BA_ "Version" SG_ 3221225472 APSU_AstStLmbrLoDis "18.02.01";
BA_ "Description" SG_ 3221225472 APSU_AstStLmbrMdlDis "This signal is used to display the seat movement to AVN";
BA_ "GenSigSendType" SG_ 3221225472 APSU_AstStLmbrMdlDis 4;
BA_ "UserSigValidity" SG_ 3221225472 APSU_AstStLmbrMdlDis 1;
BA_ "GenSigTimeoutTime" SG_ 3221225472 APSU_AstStLmbrMdlDis 1500;
BA_ "NetworkRequest" SG_ 3221225472 APSU_AstStLmbrMdlDis 0;
BA_ "NetworkRequestHoldingTime" SG_ 3221225472 APSU_AstStLmbrMdlDis 5000;
BA_ "Version" SG_ 3221225472 APSU_AstStLmbrMdlDis "18.02.01";
BA_ "Description" SG_ 3221225472 APSU_AstStLmbrUpDis "This signal is used to display the seat movement to AVN";
BA_ "GenSigSendType" SG_ 3221225472 APSU_AstStLmbrUpDis 4;
BA_ "UserSigValidity" SG_ 3221225472 APSU_AstStLmbrUpDis 1;
BA_ "GenSigTimeoutTime" SG_ 3221225472 APSU_AstStLmbrUpDis 1500;
BA_ "NetworkRequest" SG_ 3221225472 APSU_AstStLmbrUpDis 0;
BA_ "NetworkRequestHoldingTime" SG_ 3221225472 APSU_AstStLmbrUpDis 5000;
BA_ "Version" SG_ 3221225472 APSU_AstStLmbrUpDis "18.02.01";
BA_ "Description" SG_ 3221225472 APSU_LmbrSigSrcTyp "-(Old)C_APSULumbarOpt";
BA_ "GenSigSendType" SG_ 3221225472 APSU_LmbrSigSrcTyp 4;
BA_ "UserSigValidity" SG_ 3221225472 APSU_LmbrSigSrcTyp 0;
BA_ "GenSigTimeoutTime" SG_ 3221225472 APSU_LmbrSigSrcTyp 1500;
BA_ "NetworkRequest" SG_ 3221225472 APSU_LmbrSigSrcTyp 0;
BA_ "NetworkRequestHoldingTime" SG_ 3221225472 APSU_LmbrSigSrcTyp 5000;
BA_ "Version" SG_ 3221225472 APSU_LmbrSigSrcTyp "18.02.01";
BA_ "Description" SG_ 3221225472 DLBCU_CushInfDis "This signal is used to display the seat movement to AVN";
BA_ "GenSigSendType" SG_ 3221225472 DLBCU_CushInfDis 4;
BA_ "UserSigValidity" SG_ 3221225472 DLBCU_CushInfDis 1;
BA_ "GenSigTimeoutTime" SG_ 3221225472 DLBCU_CushInfDis 1500;
BA_ "NetworkRequest" SG_ 3221225472 DLBCU_CushInfDis 0;
BA_ "NetworkRequestHoldingTime" SG_ 3221225472 DLBCU_CushInfDis 5000;
BA_ "Version" SG_ 3221225472 DLBCU_CushInfDis "18.03.07";
BA_ "Description" SG_ 3221225472 DLBCU_CushDefDis "This signal is used to display the seat movement to AVN";
BA_ "GenSigSendType" SG_ 3221225472 DLBCU_CushDefDis 4;
BA_ "UserSigValidity" SG_ 3221225472 DLBCU_CushDefDis 1;
BA_ "GenSigTimeoutTime" SG_ 3221225472 DLBCU_CushDefDis 1500;
BA_ "NetworkRequest" SG_ 3221225472 DLBCU_CushDefDis 0;
BA_ "NetworkRequestHoldingTime" SG_ 3221225472 DLBCU_CushDefDis 5000;
BA_ "Version" SG_ 3221225472 DLBCU_CushDefDis "18.03.07";
BA_ "Description" SG_ 3221225472 ICSC_Crc2Val "The CRC checking process calculates the CRC over the entire data block, including the CRC result.

- CRC Polynomial (0x1021) , Initial Value : 0xFFFF, XOR value : 0x0000

- The mathematical expression to 16 bit CRC polynomial is given here. G(x) = x16 + ";
BA_ "GenSigStartValue" SG_ 3221225472 ICSC_Crc2Val 65535;
BA_ "UserSigValidity" SG_ 3221225472 ICSC_Crc2Val 3;
BA_ "GenSigTimeoutTime" SG_ 3221225472 ICSC_Crc2Val 1500;
BA_ "RoutingFactor" SG_ 3221225472 ICSC_Crc2Val 2;
BA_ "Version" SG_ 3221225472 ICSC_Crc2Val "17.11.00";
BA_ "Description" SG_ 3221225472 ICSC_AlvCnt2Val "For the first transmission request for a data element the counter shall be initialized with 0 and shall be incremented by 1

for every subsequent send request. When the counter reaches the maximum value(0xFF), then it shall restart with ? for the next se";
BA_ "UserSigValidity" SG_ 3221225472 ICSC_AlvCnt2Val 3;
BA_ "GenSigTimeoutTime" SG_ 3221225472 ICSC_AlvCnt2Val 1500;
BA_ "RoutingFactor" SG_ 3221225472 ICSC_AlvCnt2Val 2;
BA_ "Version" SG_ 3221225472 ICSC_AlvCnt2Val "17.11.00";
BA_ "Description" SG_ 3221225472 DMIC_DrvModSta "This signal is feedback state of driving mode for Cluster/AVN

This message is for DMIC(Driving Mode Integrated Control)";
BA_ "UserSigValidity" SG_ 3221225472 DMIC_DrvModSta 3;
BA_ "GenSigTimeoutTime" SG_ 3221225472 DMIC_DrvModSta 1500;
BA_ "RoutingFactor" SG_ 3221225472 DMIC_DrvModSta 2;
BA_ "Version" SG_ 3221225472 DMIC_DrvModSta "17.12.00";
BA_ "Description" SG_ 3221225472 DMIC_SmtShftModSta "This signal is a smart shift mode flag.";
BA_ "UserSigValidity" SG_ 3221225472 DMIC_SmtShftModSta 3;
BA_ "GenSigTimeoutTime" SG_ 3221225472 DMIC_SmtShftModSta 1500;
BA_ "RoutingFactor" SG_ 3221225472 DMIC_SmtShftModSta 2;
BA_ "Version" SG_ 3221225472 DMIC_SmtShftModSta "17.12.00";
BA_ "Description" SG_ 3221225472 DMIC_EngModSta "This Signal is the request on mode transition for Controlling the Driving Mode.";
BA_ "UserSigValidity" SG_ 3221225472 DMIC_EngModSta 3;
BA_ "GenSigTimeoutTime" SG_ 3221225472 DMIC_EngModSta 1500;
BA_ "RoutingFactor" SG_ 3221225472 DMIC_EngModSta 2;
BA_ "Version" SG_ 3221225472 DMIC_EngModSta "17.12.00";
BA_ "Description" SG_ 3221225472 DMIC_TmModSta "This Signal is the request on mode transition for Controlling the Driving Mode.";
BA_ "UserSigValidity" SG_ 3221225472 DMIC_TmModSta 3;
BA_ "GenSigTimeoutTime" SG_ 3221225472 DMIC_TmModSta 1500;
BA_ "RoutingFactor" SG_ 3221225472 DMIC_TmModSta 2;
BA_ "Version" SG_ 3221225472 DMIC_TmModSta "17.12.00";
BA_ "Description" SG_ 3221225472 DMIC_AwdModSta "This Signal is the request on mode transition for Controlling the Driving Mode.";
BA_ "UserSigValidity" SG_ 3221225472 DMIC_AwdModSta 3;
BA_ "GenSigTimeoutTime" SG_ 3221225472 DMIC_AwdModSta 1500;
BA_ "RoutingFactor" SG_ 3221225472 DMIC_AwdModSta 2;
BA_ "Version" SG_ 3221225472 DMIC_AwdModSta "17.12.00";
BA_ "GenSigSendType" SG_ 3221225472 APSU_AstStEsyAcsUSMSta 4;
BA_ "UserSigValidity" SG_ 3221225472 APSU_AstStEsyAcsUSMSta 0;
BA_ "GenSigTimeoutTime" SG_ 3221225472 APSU_AstStEsyAcsUSMSta 1500;
BA_ "NetworkRequest" SG_ 3221225472 APSU_AstStEsyAcsUSMSta 0;
BA_ "NetworkRequestHoldingTime" SG_ 3221225472 APSU_AstStEsyAcsUSMSta 5000;
BA_ "Version" SG_ 3221225472 APSU_AstStEsyAcsUSMSta "18.02.01";
BA_ "Description" SG_ 3221225472 APSU_AutoHtrCtrlUSMSta "-(Old)C_AstAutoHeatRValue";
BA_ "GenSigSendType" SG_ 3221225472 APSU_AutoHtrCtrlUSMSta 4;
BA_ "UserSigValidity" SG_ 3221225472 APSU_AutoHtrCtrlUSMSta 0;
BA_ "GenSigTimeoutTime" SG_ 3221225472 APSU_AutoHtrCtrlUSMSta 1500;
BA_ "NetworkRequest" SG_ 3221225472 APSU_AutoHtrCtrlUSMSta 0;
BA_ "NetworkRequestHoldingTime" SG_ 3221225472 APSU_AutoHtrCtrlUSMSta 5000;
BA_ "Version" SG_ 3221225472 APSU_AutoHtrCtrlUSMSta "18.02.01";
BA_ "Description" SG_ 3221225472 DLBCU_LumbarUpDis "This signal is used to display the seat movement to AVN";
BA_ "GenSigSendType" SG_ 3221225472 DLBCU_LumbarUpDis 4;
BA_ "UserSigValidity" SG_ 3221225472 DLBCU_LumbarUpDis 1;
BA_ "GenSigTimeoutTime" SG_ 3221225472 DLBCU_LumbarUpDis 1500;
BA_ "NetworkRequest" SG_ 3221225472 DLBCU_LumbarUpDis 0;
BA_ "NetworkRequestHoldingTime" SG_ 3221225472 DLBCU_LumbarUpDis 5000;
BA_ "Version" SG_ 3221225472 DLBCU_LumbarUpDis "18.03.07";
BA_ "Description" SG_ 3221225472 DLBCU_LumbarMidDis "This signal is used to display the seat movement to AVN";
BA_ "GenSigSendType" SG_ 3221225472 DLBCU_LumbarMidDis 4;
BA_ "UserSigValidity" SG_ 3221225472 DLBCU_LumbarMidDis 1;
BA_ "GenSigTimeoutTime" SG_ 3221225472 DLBCU_LumbarMidDis 1500;
BA_ "NetworkRequest" SG_ 3221225472 DLBCU_LumbarMidDis 0;
BA_ "NetworkRequestHoldingTime" SG_ 3221225472 DLBCU_LumbarMidDis 5000;
BA_ "Version" SG_ 3221225472 DLBCU_LumbarMidDis "18.03.07";
BA_ "Description" SG_ 3221225472 DLBCU_LumbarLowDis "This signal is used to display the seat movement to AVN";
BA_ "GenSigSendType" SG_ 3221225472 DLBCU_LumbarLowDis 4;
BA_ "UserSigValidity" SG_ 3221225472 DLBCU_LumbarLowDis 1;
BA_ "GenSigTimeoutTime" SG_ 3221225472 DLBCU_LumbarLowDis 1500;
BA_ "NetworkRequest" SG_ 3221225472 DLBCU_LumbarLowDis 0;
BA_ "NetworkRequestHoldingTime" SG_ 3221225472 DLBCU_LumbarLowDis 5000;
BA_ "Version" SG_ 3221225472 DLBCU_LumbarLowDis "18.03.07";
BA_ "Description" SG_ 3221225472 DLBCU_LumbarDefDis "This signal is used to display the seat movement to AVN";
BA_ "GenSigSendType" SG_ 3221225472 DLBCU_LumbarDefDis 4;
BA_ "UserSigValidity" SG_ 3221225472 DLBCU_LumbarDefDis 1;
BA_ "GenSigTimeoutTime" SG_ 3221225472 DLBCU_LumbarDefDis 1500;
BA_ "NetworkRequest" SG_ 3221225472 DLBCU_LumbarDefDis 0;
BA_ "NetworkRequestHoldingTime" SG_ 3221225472 DLBCU_LumbarDefDis 5000;
BA_ "Version" SG_ 3221225472 DLBCU_LumbarDefDis "18.03.07";
BA_ "Description" SG_ 3221225472 DLBCU_BolsterInfDis "This signal is used to display the seat movement to AVN";
BA_ "GenSigSendType" SG_ 3221225472 DLBCU_BolsterInfDis 4;
BA_ "UserSigValidity" SG_ 3221225472 DLBCU_BolsterInfDis 1;
BA_ "GenSigTimeoutTime" SG_ 3221225472 DLBCU_BolsterInfDis 1500;
BA_ "NetworkRequest" SG_ 3221225472 DLBCU_BolsterInfDis 0;
BA_ "NetworkRequestHoldingTime" SG_ 3221225472 DLBCU_BolsterInfDis 5000;
BA_ "Version" SG_ 3221225472 DLBCU_BolsterInfDis "18.03.07";
BA_ "Description" SG_ 3221225472 DLBCU_BolsterDefDis "This signal is used to display the seat movement to AVN";
BA_ "GenSigSendType" SG_ 3221225472 DLBCU_BolsterDefDis 4;
BA_ "UserSigValidity" SG_ 3221225472 DLBCU_BolsterDefDis 1;
BA_ "GenSigTimeoutTime" SG_ 3221225472 DLBCU_BolsterDefDis 1500;
BA_ "NetworkRequest" SG_ 3221225472 DLBCU_BolsterDefDis 0;
BA_ "NetworkRequestHoldingTime" SG_ 3221225472 DLBCU_BolsterDefDis 5000;
BA_ "Version" SG_ 3221225472 DLBCU_BolsterDefDis "18.03.07";
BA_ "Description" SG_ 3221225472 DPSS_LumbarUpSw "운전석 럼버 업 스위치";
BA_ "GenSigSendType" SG_ 3221225472 DPSS_LumbarUpSw 4;
BA_ "UserSigValidity" SG_ 3221225472 DPSS_LumbarUpSw 0;
BA_ "GenSigTimeoutTime" SG_ 3221225472 DPSS_LumbarUpSw 1500;
BA_ "NetworkRequest" SG_ 3221225472 DPSS_LumbarUpSw 0;
BA_ "NetworkRequestHoldingTime" SG_ 3221225472 DPSS_LumbarUpSw 5000;
BA_ "Version" SG_ 3221225472 DPSS_LumbarUpSw "18.02.01";
BA_ "Description" SG_ 3221225472 DPSS_LumbarMidSw "운전석 럼버 미들 스위치";
BA_ "GenSigSendType" SG_ 3221225472 DPSS_LumbarMidSw 4;
BA_ "UserSigValidity" SG_ 3221225472 DPSS_LumbarMidSw 0;
BA_ "GenSigTimeoutTime" SG_ 3221225472 DPSS_LumbarMidSw 1500;
BA_ "NetworkRequest" SG_ 3221225472 DPSS_LumbarMidSw 0;
BA_ "NetworkRequestHoldingTime" SG_ 3221225472 DPSS_LumbarMidSw 5000;
BA_ "Version" SG_ 3221225472 DPSS_LumbarMidSw "18.02.01";
BA_ "Description" SG_ 3221225472 DPSS_LumbarLowSw "운전석 럼버 하단 버튼";
BA_ "GenSigSendType" SG_ 3221225472 DPSS_LumbarLowSw 4;
BA_ "UserSigValidity" SG_ 3221225472 DPSS_LumbarLowSw 0;
BA_ "GenSigTimeoutTime" SG_ 3221225472 DPSS_LumbarLowSw 1500;
BA_ "NetworkRequest" SG_ 3221225472 DPSS_LumbarLowSw 0;
BA_ "NetworkRequestHoldingTime" SG_ 3221225472 DPSS_LumbarLowSw 5000;
BA_ "Version" SG_ 3221225472 DPSS_LumbarLowSw "18.02.01";
BA_ "Description" SG_ 3221225472 DPSS_LumbarDefSw "운전석 럼버 디플레이션 버튼";
BA_ "GenSigSendType" SG_ 3221225472 DPSS_LumbarDefSw 4;
BA_ "UserSigValidity" SG_ 3221225472 DPSS_LumbarDefSw 0;
BA_ "GenSigTimeoutTime" SG_ 3221225472 DPSS_LumbarDefSw 1500;
BA_ "NetworkRequest" SG_ 3221225472 DPSS_LumbarDefSw 0;
BA_ "NetworkRequestHoldingTime" SG_ 3221225472 DPSS_LumbarDefSw 5000;
BA_ "Version" SG_ 3221225472 DPSS_LumbarDefSw "18.02.01";
BA_ "Description" SG_ 3221225472 DPSS_BolsterInfSw "운전석 볼스터 흡기 버튼";
BA_ "GenSigSendType" SG_ 3221225472 DPSS_BolsterInfSw 4;
BA_ "UserSigValidity" SG_ 3221225472 DPSS_BolsterInfSw 0;
BA_ "GenSigTimeoutTime" SG_ 3221225472 DPSS_BolsterInfSw 1500;
BA_ "NetworkRequest" SG_ 3221225472 DPSS_BolsterInfSw 0;
BA_ "NetworkRequestHoldingTime" SG_ 3221225472 DPSS_BolsterInfSw 5000;
BA_ "Version" SG_ 3221225472 DPSS_BolsterInfSw "18.02.01";
BA_ "Description" SG_ 3221225472 DPSS_BolsterDefSw "운전석 볼스터 배기 버튼";
BA_ "GenSigSendType" SG_ 3221225472 DPSS_BolsterDefSw 4;
BA_ "UserSigValidity" SG_ 3221225472 DPSS_BolsterDefSw 0;
BA_ "GenSigTimeoutTime" SG_ 3221225472 DPSS_BolsterDefSw 1500;
BA_ "NetworkRequest" SG_ 3221225472 DPSS_BolsterDefSw 0;
BA_ "NetworkRequestHoldingTime" SG_ 3221225472 DPSS_BolsterDefSw 5000;
BA_ "Version" SG_ 3221225472 DPSS_BolsterDefSw "18.02.01";
BA_ "Description" SG_ 3221225472 DPSS_ActiveSw "운전석 쿠션 볼스터 조절 스위치";
BA_ "GenSigSendType" SG_ 3221225472 DPSS_ActiveSw 4;
BA_ "UserSigValidity" SG_ 3221225472 DPSS_ActiveSw 0;
BA_ "GenSigTimeoutTime" SG_ 3221225472 DPSS_ActiveSw 1500;
BA_ "NetworkRequest" SG_ 3221225472 DPSS_ActiveSw 0;
BA_ "NetworkRequestHoldingTime" SG_ 3221225472 DPSS_ActiveSw 5000;
BA_ "Version" SG_ 3221225472 DPSS_ActiveSw "18.03.07";
BA_ "Description" SG_ 3221225472 DPSS_SldTch "터치 스위치 정보";
BA_ "GenSigSendType" SG_ 3221225472 DPSS_SldTch 4;
BA_ "UserSigValidity" SG_ 3221225472 DPSS_SldTch 3;
BA_ "GenSigTimeoutTime" SG_ 3221225472 DPSS_SldTch 1500;
BA_ "NetworkRequest" SG_ 3221225472 DPSS_SldTch 0;
BA_ "NetworkRequestHoldingTime" SG_ 3221225472 DPSS_SldTch 5000;
BA_ "Version" SG_ 3221225472 DPSS_SldTch "18.02.01";
BA_ "Description" SG_ 3221225472 DPSS_RclTch "터치 스위치 정보";
BA_ "GenSigSendType" SG_ 3221225472 DPSS_RclTch 4;
BA_ "UserSigValidity" SG_ 3221225472 DPSS_RclTch 3;
BA_ "GenSigTimeoutTime" SG_ 3221225472 DPSS_RclTch 1500;
BA_ "NetworkRequest" SG_ 3221225472 DPSS_RclTch 0;
BA_ "NetworkRequestHoldingTime" SG_ 3221225472 DPSS_RclTch 5000;
BA_ "Version" SG_ 3221225472 DPSS_RclTch "18.02.01";
BA_ "Description" SG_ 3221225472 DPSS_ExtTch "터치 스위치 정보";
BA_ "GenSigSendType" SG_ 3221225472 DPSS_ExtTch 4;
BA_ "UserSigValidity" SG_ 3221225472 DPSS_ExtTch 3;
BA_ "GenSigTimeoutTime" SG_ 3221225472 DPSS_ExtTch 1500;
BA_ "NetworkRequest" SG_ 3221225472 DPSS_ExtTch 0;
BA_ "NetworkRequestHoldingTime" SG_ 3221225472 DPSS_ExtTch 5000;
BA_ "Version" SG_ 3221225472 DPSS_ExtTch "18.02.01";
BA_ "Description" SG_ 3221225472 DPSS_LmbrTch "터치 스위치 정보";
BA_ "GenSigSendType" SG_ 3221225472 DPSS_LmbrTch 4;
BA_ "UserSigValidity" SG_ 3221225472 DPSS_LmbrTch 3;
BA_ "GenSigTimeoutTime" SG_ 3221225472 DPSS_LmbrTch 1500;
BA_ "NetworkRequest" SG_ 3221225472 DPSS_LmbrTch 0;
BA_ "NetworkRequestHoldingTime" SG_ 3221225472 DPSS_LmbrTch 5000;
BA_ "Version" SG_ 3221225472 DPSS_LmbrTch "18.02.01";
BA_ "Description" SG_ 3221225472 DPSS_CushOnOffTch "터치 스위치 정보";
BA_ "GenSigSendType" SG_ 3221225472 DPSS_CushOnOffTch 4;
BA_ "UserSigValidity" SG_ 3221225472 DPSS_CushOnOffTch 3;
BA_ "GenSigTimeoutTime" SG_ 3221225472 DPSS_CushOnOffTch 1500;
BA_ "NetworkRequest" SG_ 3221225472 DPSS_CushOnOffTch 0;
BA_ "NetworkRequestHoldingTime" SG_ 3221225472 DPSS_CushOnOffTch 5000;
BA_ "Version" SG_ 3221225472 DPSS_CushOnOffTch "18.02.01";
BA_ "Description" SG_ 3221225472 ACU_ActvFltSta "This signal means information regarding fault status, whether it is an active fault or not.



1) Default value : 0x2

2) Default value Transmit condition

    - When the input condition is not supported.";
BA_ "GenSigStartValue" SG_ 3221225472 ACU_ActvFltSta 2;
BA_ "UserSigValidity" SG_ 3221225472 ACU_ActvFltSta 3;
BA_ "GenSigTimeoutTime" SG_ 3221225472 ACU_ActvFltSta 1500;
BA_ "RoutingFactor" SG_ 3221225472 ACU_ActvFltSta 2;
BA_ "Version" SG_ 3221225472 ACU_ActvFltSta "17.12.00";
BA_ "Description" SG_ 3221225472 ACU_SdArbgExtTyp "This signal does not specify the types or variations of the side restraints such as the front side airbag only or both the front and the rear side airbag. If any side restraint is equipped, the signal responds as 'exists'.";
BA_ "UserSigValidity" SG_ 3221225472 ACU_SdArbgExtTyp 3;
BA_ "GenSigTimeoutTime" SG_ 3221225472 ACU_SdArbgExtTyp 1500;
BA_ "RoutingFactor" SG_ 3221225472 ACU_SdArbgExtTyp 2;
BA_ "Version" SG_ 3221225472 ACU_SdArbgExtTyp "17.12.00";
BA_ "Description" SG_ 3221225472 DPSS_StExtFwdMvBtn "운전석 쿠션 익스텐션 포워드 버튼";
BA_ "GenSigSendType" SG_ 3221225472 DPSS_StExtFwdMvBtn 4;
BA_ "UserSigValidity" SG_ 3221225472 DPSS_StExtFwdMvBtn 0;
BA_ "GenSigTimeoutTime" SG_ 3221225472 DPSS_StExtFwdMvBtn 1500;
BA_ "NetworkRequest" SG_ 3221225472 DPSS_StExtFwdMvBtn 0;
BA_ "NetworkRequestHoldingTime" SG_ 3221225472 DPSS_StExtFwdMvBtn 5000;
BA_ "Version" SG_ 3221225472 DPSS_StExtFwdMvBtn "18.02.01";
BA_ "Description" SG_ 3221225472 DPSS_StExtBwdMvBtn "운전석 쿠션 익스텐션 백워드 버튼";
BA_ "GenSigSendType" SG_ 3221225472 DPSS_StExtBwdMvBtn 4;
BA_ "UserSigValidity" SG_ 3221225472 DPSS_StExtBwdMvBtn 0;
BA_ "GenSigTimeoutTime" SG_ 3221225472 DPSS_StExtBwdMvBtn 1500;
BA_ "NetworkRequest" SG_ 3221225472 DPSS_StExtBwdMvBtn 0;
BA_ "NetworkRequestHoldingTime" SG_ 3221225472 DPSS_StExtBwdMvBtn 5000;
BA_ "Version" SG_ 3221225472 DPSS_StExtBwdMvBtn "18.02.01";
BA_ "Description" SG_ 3221225472 DPSS_StSldFwdMvBtn "운전석 슬라이드 포워드 버튼";
BA_ "GenSigSendType" SG_ 3221225472 DPSS_StSldFwdMvBtn 4;
BA_ "UserSigValidity" SG_ 3221225472 DPSS_StSldFwdMvBtn 0;
BA_ "GenSigTimeoutTime" SG_ 3221225472 DPSS_StSldFwdMvBtn 1500;
BA_ "NetworkRequest" SG_ 3221225472 DPSS_StSldFwdMvBtn 0;
BA_ "NetworkRequestHoldingTime" SG_ 3221225472 DPSS_StSldFwdMvBtn 5000;
BA_ "Version" SG_ 3221225472 DPSS_StSldFwdMvBtn "18.02.01";
BA_ "Description" SG_ 3221225472 DPSS_StSldBwdMvBtn "운전석 슬라이드 백워드 버튼";
BA_ "GenSigSendType" SG_ 3221225472 DPSS_StSldBwdMvBtn 4;
BA_ "UserSigValidity" SG_ 3221225472 DPSS_StSldBwdMvBtn 0;
BA_ "GenSigTimeoutTime" SG_ 3221225472 DPSS_StSldBwdMvBtn 1500;
BA_ "NetworkRequest" SG_ 3221225472 DPSS_StSldBwdMvBtn 0;
BA_ "NetworkRequestHoldingTime" SG_ 3221225472 DPSS_StSldBwdMvBtn 5000;
BA_ "Version" SG_ 3221225472 DPSS_StSldBwdMvBtn "18.02.01";
BA_ "Description" SG_ 3221225472 DPSS_StRclFwdMvBtn "운전석 리클라이너 포워드 버튼";
BA_ "GenSigSendType" SG_ 3221225472 DPSS_StRclFwdMvBtn 4;
BA_ "UserSigValidity" SG_ 3221225472 DPSS_StRclFwdMvBtn 0;
BA_ "GenSigTimeoutTime" SG_ 3221225472 DPSS_StRclFwdMvBtn 1500;
BA_ "NetworkRequest" SG_ 3221225472 DPSS_StRclFwdMvBtn 0;
BA_ "NetworkRequestHoldingTime" SG_ 3221225472 DPSS_StRclFwdMvBtn 5000;
BA_ "Version" SG_ 3221225472 DPSS_StRclFwdMvBtn "18.02.01";
BA_ "Description" SG_ 3221225472 DPSS_StRclBwdMvBtn "운전석 리클라이너 백워드 버튼";
BA_ "GenSigSendType" SG_ 3221225472 DPSS_StRclBwdMvBtn 4;
BA_ "UserSigValidity" SG_ 3221225472 DPSS_StRclBwdMvBtn 0;
BA_ "GenSigTimeoutTime" SG_ 3221225472 DPSS_StRclBwdMvBtn 1500;
BA_ "NetworkRequest" SG_ 3221225472 DPSS_StRclBwdMvBtn 0;
BA_ "NetworkRequestHoldingTime" SG_ 3221225472 DPSS_StRclBwdMvBtn 5000;
BA_ "Version" SG_ 3221225472 DPSS_StRclBwdMvBtn "18.02.01";
BA_ "Description" SG_ 3221225472 DPSS_StHgtUpMvBtn "운전석 하이트 업 버튼";
BA_ "GenSigSendType" SG_ 3221225472 DPSS_StHgtUpMvBtn 4;
BA_ "UserSigValidity" SG_ 3221225472 DPSS_StHgtUpMvBtn 0;
BA_ "GenSigTimeoutTime" SG_ 3221225472 DPSS_StHgtUpMvBtn 1500;
BA_ "NetworkRequest" SG_ 3221225472 DPSS_StHgtUpMvBtn 0;
BA_ "NetworkRequestHoldingTime" SG_ 3221225472 DPSS_StHgtUpMvBtn 5000;
BA_ "Version" SG_ 3221225472 DPSS_StHgtUpMvBtn "18.02.01";
BA_ "Description" SG_ 3221225472 DPSS_StHgtDnMvBtn "운전석 하이트 다운 버튼";
BA_ "GenSigSendType" SG_ 3221225472 DPSS_StHgtDnMvBtn 4;
BA_ "UserSigValidity" SG_ 3221225472 DPSS_StHgtDnMvBtn 0;
BA_ "GenSigTimeoutTime" SG_ 3221225472 DPSS_StHgtDnMvBtn 1500;
BA_ "NetworkRequest" SG_ 3221225472 DPSS_StHgtDnMvBtn 0;
BA_ "NetworkRequestHoldingTime" SG_ 3221225472 DPSS_StHgtDnMvBtn 5000;
BA_ "Version" SG_ 3221225472 DPSS_StHgtDnMvBtn "18.02.01";
BA_ "Description" SG_ 3221225472 DPSS_StTltUpMvBtn "운전석 틸트 업 버튼";
BA_ "GenSigSendType" SG_ 3221225472 DPSS_StTltUpMvBtn 4;
BA_ "UserSigValidity" SG_ 3221225472 DPSS_StTltUpMvBtn 0;
BA_ "GenSigTimeoutTime" SG_ 3221225472 DPSS_StTltUpMvBtn 1500;
BA_ "NetworkRequest" SG_ 3221225472 DPSS_StTltUpMvBtn 0;
BA_ "NetworkRequestHoldingTime" SG_ 3221225472 DPSS_StTltUpMvBtn 5000;
BA_ "Version" SG_ 3221225472 DPSS_StTltUpMvBtn "18.02.01";
BA_ "Description" SG_ 3221225472 DPSS_StTltDnMvBtn "운전석 틸트 다운 버튼";
BA_ "GenSigSendType" SG_ 3221225472 DPSS_StTltDnMvBtn 4;
BA_ "UserSigValidity" SG_ 3221225472 DPSS_StTltDnMvBtn 0;
BA_ "GenSigTimeoutTime" SG_ 3221225472 DPSS_StTltDnMvBtn 1500;
BA_ "NetworkRequest" SG_ 3221225472 DPSS_StTltDnMvBtn 0;
BA_ "NetworkRequestHoldingTime" SG_ 3221225472 DPSS_StTltDnMvBtn 5000;
BA_ "Version" SG_ 3221225472 DPSS_StTltDnMvBtn "18.02.01";
BA_ "Description" SG_ 3221225472 Window_RrLftWdwSwSta "Rear Left Window Switch Status from Rear Left Safety Power Window ECU";
BA_ "GenSigSendType" SG_ 3221225472 Window_RrLftWdwSwSta 4;
BA_ "UserSigValidity" SG_ 3221225472 Window_RrLftWdwSwSta 0;
BA_ "GenSigTimeoutTime" SG_ 3221225472 Window_RrLftWdwSwSta 1500;
BA_ "NetworkRequest" SG_ 3221225472 Window_RrLftWdwSwSta 0;
BA_ "NetworkRequestHoldingTime" SG_ 3221225472 Window_RrLftWdwSwSta 5000;
BA_ "Version" SG_ 3221225472 Window_RrLftWdwSwSta "18.03.04";
BA_ "Description" SG_ 3221225472 Window_RrRtWdwSwSta "Rear Right Window Switch Status from Rear RightSafety Power Window ECU";
BA_ "GenSigSendType" SG_ 3221225472 Window_RrRtWdwSwSta 4;
BA_ "UserSigValidity" SG_ 3221225472 Window_RrRtWdwSwSta 0;
BA_ "GenSigTimeoutTime" SG_ 3221225472 Window_RrRtWdwSwSta 1500;
BA_ "NetworkRequest" SG_ 3221225472 Window_RrRtWdwSwSta 0;
BA_ "NetworkRequestHoldingTime" SG_ 3221225472 Window_RrRtWdwSwSta 5000;
BA_ "Version" SG_ 3221225472 Window_RrRtWdwSwSta "18.03.04";
BA_ "Description" SG_ 3221225472 SMK_Crc9Val "The CRC checking process calculates the CRC over the entire data block, including the CRC result CRC Polynomial (0x1D) ,

Initial Value : 0x00, XOR value : 0x00

The mathematical expression to 8 bit CRC polynomial is given here. G(x) = x8 + x4 + x3 + x2 ";
BA_ "GenSigSendType" SG_ 3221225472 SMK_Crc9Val 4;
BA_ "GenSigStartValue" SG_ 3221225472 SMK_Crc9Val 255;
BA_ "UserSigValidity" SG_ 3221225472 SMK_Crc9Val 0;
BA_ "GenSigTimeoutTime" SG_ 3221225472 SMK_Crc9Val 0;
BA_ "Version" SG_ 3221225472 SMK_Crc9Val "18.02.01";
BA_ "Description" SG_ 3221225472 SMK_AlvCnt9Val "For the first transmission request for a data element the counter shall be initialized with 0 and shall be incremented by 1

for every subsequent send request. When the counter reaches the maximum value(0xE), then it shall restart with ? for the next sen";
BA_ "GenSigSendType" SG_ 3221225472 SMK_AlvCnt9Val 4;
BA_ "UserSigValidity" SG_ 3221225472 SMK_AlvCnt9Val 0;
BA_ "GenSigTimeoutTime" SG_ 3221225472 SMK_AlvCnt9Val 0;
BA_ "Version" SG_ 3221225472 SMK_AlvCnt9Val "18.02.01";
BA_ "GenSigSendType" SG_ 3221225472 Auth_EncryptRespData2 4;
BA_ "UserSigValidity" SG_ 3221225472 Auth_EncryptRespData2 0;
BA_ "GenSigTimeoutTime" SG_ 3221225472 Auth_EncryptRespData2 0;
BA_ "NetworkRequest" SG_ 3221225472 Auth_EncryptRespData2 0;
BA_ "NetworkRequestHoldingTime" SG_ 3221225472 Auth_EncryptRespData2 5000;
BA_ "Version" SG_ 3221225472 Auth_EncryptRespData2 "18.02.01";
BA_ "Description" SG_ 3221225472 SMK_Crc10Val "The CRC checking process calculates the CRC over the entire data block, including the CRC result CRC Polynomial (0x1D) ,

Initial Value : 0x00, XOR value : 0x00

The mathematical expression to 8 bit CRC polynomial is given here. G(x) = x8 + x4 + x3 + x2 ";
BA_ "GenSigSendType" SG_ 3221225472 SMK_Crc10Val 4;
BA_ "GenSigStartValue" SG_ 3221225472 SMK_Crc10Val 255;
BA_ "UserSigValidity" SG_ 3221225472 SMK_Crc10Val 0;
BA_ "GenSigTimeoutTime" SG_ 3221225472 SMK_Crc10Val 0;
BA_ "Version" SG_ 3221225472 SMK_Crc10Val "18.02.01";
BA_ "Description" SG_ 3221225472 SMK_AlvCnt10Val "For the first transmission request for a data element the counter shall be initialized with 0 and shall be incremented by 1

for every subsequent send request. When the counter reaches the maximum value(0xE), then it shall restart with ? for the next sen";
BA_ "GenSigSendType" SG_ 3221225472 SMK_AlvCnt10Val 4;
BA_ "UserSigValidity" SG_ 3221225472 SMK_AlvCnt10Val 0;
BA_ "GenSigTimeoutTime" SG_ 3221225472 SMK_AlvCnt10Val 0;
BA_ "Version" SG_ 3221225472 SMK_AlvCnt10Val "18.02.01";
BA_ "GenSigSendType" SG_ 3221225472 Auth_EncryptRespData3 4;
BA_ "UserSigValidity" SG_ 3221225472 Auth_EncryptRespData3 0;
BA_ "GenSigTimeoutTime" SG_ 3221225472 Auth_EncryptRespData3 0;
BA_ "NetworkRequest" SG_ 3221225472 Auth_EncryptRespData3 0;
BA_ "NetworkRequestHoldingTime" SG_ 3221225472 Auth_EncryptRespData3 5000;
BA_ "Version" SG_ 3221225472 Auth_EncryptRespData3 "18.02.01";
BA_ "Description" SG_ 3221225472 SMK_Crc7Val "The CRC checking process calculates the CRC over the entire data block, including the CRC result CRC Polynomial (0x1D) ,

Initial Value : 0x00, XOR value : 0x00

The mathematical expression to 8 bit CRC polynomial is given here. G(x) = x8 + x4 + x3 + x2 ";
BA_ "GenSigSendType" SG_ 3221225472 SMK_Crc7Val 4;
BA_ "GenSigStartValue" SG_ 3221225472 SMK_Crc7Val 255;
BA_ "UserSigValidity" SG_ 3221225472 SMK_Crc7Val 0;
BA_ "GenSigTimeoutTime" SG_ 3221225472 SMK_Crc7Val 0;
BA_ "Version" SG_ 3221225472 SMK_Crc7Val "18.02.01";
BA_ "Description" SG_ 3221225472 SMK_AlvCnt7Val "For the first transmission request for a data element the counter shall be initialized with 0 and shall be incremented by 1

for every subsequent send request. When the counter reaches the maximum value(0xE), then it shall restart with ? for the next sen";
BA_ "GenSigSendType" SG_ 3221225472 SMK_AlvCnt7Val 4;
BA_ "UserSigValidity" SG_ 3221225472 SMK_AlvCnt7Val 0;
BA_ "GenSigTimeoutTime" SG_ 3221225472 SMK_AlvCnt7Val 0;
BA_ "Version" SG_ 3221225472 SMK_AlvCnt7Val "18.02.01";
BA_ "GenSigSendType" SG_ 3221225472 Auth_RndNum 4;
BA_ "UserSigValidity" SG_ 3221225472 Auth_RndNum 0;
BA_ "GenSigTimeoutTime" SG_ 3221225472 Auth_RndNum 0;
BA_ "NetworkRequest" SG_ 3221225472 Auth_RndNum 0;
BA_ "NetworkRequestHoldingTime" SG_ 3221225472 Auth_RndNum 5000;
BA_ "Version" SG_ 3221225472 Auth_RndNum "18.02.01";
BA_ "Description" SG_ 3221225472 ACU_Crc1Val "The CRC checking process calculates the CRC over the entire data block, including the CRC result.

- CRC Polynomial (0x1021) , Initial Value : 0xFFFF, XOR value : 0x0000

- The mathematical expression to 16 bit CRC polynomial is given here. G(x) = x16 + ";
BA_ "GenSigStartValue" SG_ 3221225472 ACU_Crc1Val 65535;
BA_ "UserSigValidity" SG_ 3221225472 ACU_Crc1Val 3;
BA_ "GenSigTimeoutTime" SG_ 3221225472 ACU_Crc1Val 1500;
BA_ "RoutingFactor" SG_ 3221225472 ACU_Crc1Val 2;
BA_ "Version" SG_ 3221225472 ACU_Crc1Val "17.11.00";
BA_ "Description" SG_ 3221225472 ACU_AlvCnt1Val "For the first transmission request for a data element the counter shall be initialized with 0 and shall be incremented by 1

for every subsequent send request. When the counter reaches the maximum value(0xFF), then it shall restart with ? for the next se";
BA_ "UserSigValidity" SG_ 3221225472 ACU_AlvCnt1Val 3;
BA_ "GenSigTimeoutTime" SG_ 3221225472 ACU_AlvCnt1Val 1500;
BA_ "RoutingFactor" SG_ 3221225472 ACU_AlvCnt1Val 2;
BA_ "Version" SG_ 3221225472 ACU_AlvCnt1Val "17.11.00";
BA_ "Description" SG_ 3221225472 ACU_SysWrngLmpDis "This signal means information regarding ACU diagnostic information result & discrimination.



1) Default value : 0x0

2) Default value Transmit condition

    - When the input condition is not determined.

    - When the input condition is not supported";
BA_ "UserSigValidity" SG_ 3221225472 ACU_SysWrngLmpDis 3;
BA_ "GenSigTimeoutTime" SG_ 3221225472 ACU_SysWrngLmpDis 1500;
BA_ "RoutingFactor" SG_ 3221225472 ACU_SysWrngLmpDis 2;
BA_ "Version" SG_ 3221225472 ACU_SysWrngLmpDis "17.12.00";
BA_ "Description" SG_ 3221225472 ACU_TlltlLmpDis "This signal means information regarding Occupant status.



1) Default value : 0x0

2) Default value Transmit condition

    - When the input condition is not determined.

    - When the input condition is not supported.";
BA_ "UserSigValidity" SG_ 3221225472 ACU_TlltlLmpDis 3;
BA_ "GenSigTimeoutTime" SG_ 3221225472 ACU_TlltlLmpDis 1500;
BA_ "RoutingFactor" SG_ 3221225472 ACU_TlltlLmpDis 2;
BA_ "Version" SG_ 3221225472 ACU_TlltlLmpDis "17.12.00";
BA_ "Description" SG_ 3221225472 ACU_OdsIDReq "It s a Request to send ODS Identifier. If the Bit is equal to `0` the ODS-B module will transmit the ODS identifier message. ACU sets “ODS ID Received” to ‘1’ after getting the valid ODS ID two times.



1) Default value : 0x0

2) Default value Trans";
BA_ "UserSigValidity" SG_ 3221225472 ACU_OdsIDReq 3;
BA_ "GenSigTimeoutTime" SG_ 3221225472 ACU_OdsIDReq 1500;
BA_ "RoutingFactor" SG_ 3221225472 ACU_OdsIDReq 2;
BA_ "Version" SG_ 3221225472 ACU_OdsIDReq "17.12.00";
BA_ "Description" SG_ 3221225472 SeatBelt_PassBcklFltSta "Information of Passenger Seat Belt Buckle switch Fault condition.



1) Default value : 0x0

2) Default value Transmit condition

    - When the input condition is not supported.";
BA_ "UserSigValidity" SG_ 3221225472 SeatBelt_PassBcklFltSta 3;
BA_ "GenSigTimeoutTime" SG_ 3221225472 SeatBelt_PassBcklFltSta 1500;
BA_ "RoutingFactor" SG_ 3221225472 SeatBelt_PassBcklFltSta 2;
BA_ "Version" SG_ 3221225472 SeatBelt_PassBcklFltSta "17.12.00";
BA_ "Description" SG_ 3221225472 SeatBelt_DrvrBcklFltSta "Information of Driver Seat Belt Buckle switch Fault condition.



1) Default value : 0x0

2) Default value Transmit condition

    - When the input condition is not supported.";
BA_ "UserSigValidity" SG_ 3221225472 SeatBelt_DrvrBcklFltSta 3;
BA_ "GenSigTimeoutTime" SG_ 3221225472 SeatBelt_DrvrBcklFltSta 1500;
BA_ "RoutingFactor" SG_ 3221225472 SeatBelt_DrvrBcklFltSta 2;
BA_ "Version" SG_ 3221225472 SeatBelt_DrvrBcklFltSta "17.12.00";
BA_ "Description" SG_ 3221225472 SeatBelt_PassBcklSta "Information of Passenger Seat Belt Buckle switch Status, whether its Latched or Not .



1) Default value : 0x1

2) Default value Transmit condition

    - When the input condition is not determined.

    - When the input condition is not supported.";
BA_ "UserSigValidity" SG_ 3221225472 SeatBelt_PassBcklSta 3;
BA_ "GenSigTimeoutTime" SG_ 3221225472 SeatBelt_PassBcklSta 1500;
BA_ "RoutingFactor" SG_ 3221225472 SeatBelt_PassBcklSta 2;
BA_ "Version" SG_ 3221225472 SeatBelt_PassBcklSta "17.12.00";
BA_ "Description" SG_ 3221225472 SeatBelt_DrvrBcklSta "Information of Driver Seat Belt Buckle switch Status, whether its Latched or Not.



1) Default value : 0x1

2) Default value Transmit condition

    - When the input condition is not determined.

    - When the input condition is not supported.";
BA_ "UserSigValidity" SG_ 3221225472 SeatBelt_DrvrBcklSta 3;
BA_ "GenSigTimeoutTime" SG_ 3221225472 SeatBelt_DrvrBcklSta 1500;
BA_ "RoutingFactor" SG_ 3221225472 SeatBelt_DrvrBcklSta 2;
BA_ "Version" SG_ 3221225472 SeatBelt_DrvrBcklSta "17.12.00";
BA_ "Description" SG_ 3221225472 ACU_DiagTrblCodVal "This signal means information regarding a diagnostic trouble code number.



1) Default value : 0x0

2) Default value Transmit condition

    - When Fault does not exist.";
BA_ "UserSigValidity" SG_ 3221225472 ACU_DiagTrblCodVal 3;
BA_ "GenSigTimeoutTime" SG_ 3221225472 ACU_DiagTrblCodVal 1500;
BA_ "RoutingFactor" SG_ 3221225472 ACU_DiagTrblCodVal 2;
BA_ "Version" SG_ 3221225472 ACU_DiagTrblCodVal "17.12.00";
BA_ "Description" SG_ 3221225472 ACU_FltNumVal "This signal means information regarding number of fault in ACU memory, including active and historic faults.



1) Default value : 0x0

2) Default value Transmit condition

    - When Fault does not exist.";
BA_ "UserSigValidity" SG_ 3221225472 ACU_FltNumVal 3;
BA_ "GenSigTimeoutTime" SG_ 3221225472 ACU_FltNumVal 1500;
BA_ "RoutingFactor" SG_ 3221225472 ACU_FltNumVal 2;
BA_ "Version" SG_ 3221225472 ACU_FltNumVal "17.12.00";
BA_ "Description" SG_ 3221225472 SMK_Crc8Val "The CRC checking process calculates the CRC over the entire data block, including the CRC result CRC Polynomial (0x1D) ,

Initial Value : 0x00, XOR value : 0x00

The mathematical expression to 8 bit CRC polynomial is given here. G(x) = x8 + x4 + x3 + x2 ";
BA_ "GenSigSendType" SG_ 3221225472 SMK_Crc8Val 4;
BA_ "GenSigStartValue" SG_ 3221225472 SMK_Crc8Val 255;
BA_ "UserSigValidity" SG_ 3221225472 SMK_Crc8Val 0;
BA_ "GenSigTimeoutTime" SG_ 3221225472 SMK_Crc8Val 0;
BA_ "Version" SG_ 3221225472 SMK_Crc8Val "18.02.01";
BA_ "Description" SG_ 3221225472 SMK_AlvCnt8Val "For the first transmission request for a data element the counter shall be initialized with 0 and shall be incremented by 1

for every subsequent send request. When the counter reaches the maximum value(0xE), then it shall restart with ? for the next sen";
BA_ "GenSigSendType" SG_ 3221225472 SMK_AlvCnt8Val 4;
BA_ "UserSigValidity" SG_ 3221225472 SMK_AlvCnt8Val 0;
BA_ "GenSigTimeoutTime" SG_ 3221225472 SMK_AlvCnt8Val 0;
BA_ "Version" SG_ 3221225472 SMK_AlvCnt8Val "18.02.01";
BA_ "GenSigSendType" SG_ 3221225472 Auth_EncryptRespData1 4;
BA_ "UserSigValidity" SG_ 3221225472 Auth_EncryptRespData1 0;
BA_ "GenSigTimeoutTime" SG_ 3221225472 Auth_EncryptRespData1 0;
BA_ "NetworkRequest" SG_ 3221225472 Auth_EncryptRespData1 0;
BA_ "NetworkRequestHoldingTime" SG_ 3221225472 Auth_EncryptRespData1 5000;
BA_ "Version" SG_ 3221225472 Auth_EncryptRespData1 "18.02.01";
BA_ "Description" SG_ 3221225472 CLU_Crc11Val "The CRC checking process calculates the CRC over the entire data block, including the CRC result.

- CRC Polynomial (0x1021) , Initial Value : 0xFFFF, XOR value : 0x0000

- The mathematical expression to 16 bit CRC polynomial is given here. G(x) = x16 + ";
BA_ "GenSigSendType" SG_ 3221225472 CLU_Crc11Val 4;
BA_ "GenSigStartValue" SG_ 3221225472 CLU_Crc11Val 65535;
BA_ "UserSigValidity" SG_ 3221225472 CLU_Crc11Val 3;
BA_ "GenSigTimeoutTime" SG_ 3221225472 CLU_Crc11Val 0;
BA_ "Version" SG_ 3221225472 CLU_Crc11Val "17.12.03";
BA_ "Description" SG_ 3221225472 CLU_ICUDlvrModOffSetReq "This signal is used for a request to set off the delivery mode for ICU";
BA_ "GenSigSendType" SG_ 3221225472 CLU_ICUDlvrModOffSetReq 4;
BA_ "UserSigValidity" SG_ 3221225472 CLU_ICUDlvrModOffSetReq 3;
BA_ "GenSigTimeoutTime" SG_ 3221225472 CLU_ICUDlvrModOffSetReq 0;
BA_ "Version" SG_ 3221225472 CLU_ICUDlvrModOffSetReq "17.12.03";
BA_ "Description" SG_ 3221225472 CLU_SMKKeyOutWarnOffReq "This signal is used for a request to SMK warn off request";
BA_ "GenSigSendType" SG_ 3221225472 CLU_SMKKeyOutWarnOffReq 4;
BA_ "UserSigValidity" SG_ 3221225472 CLU_SMKKeyOutWarnOffReq 3;
BA_ "GenSigTimeoutTime" SG_ 3221225472 CLU_SMKKeyOutWarnOffReq 0;
BA_ "Version" SG_ 3221225472 CLU_SMKKeyOutWarnOffReq "17.12.03";
BA_ "Description" SG_ 3221225472 CLU_DrvngLampChgnSta "This signal sends driving mode lamp status when driving mode changes.";
BA_ "GenSigSendType" SG_ 3221225472 CLU_DrvngLampChgnSta 4;
BA_ "UserSigValidity" SG_ 3221225472 CLU_DrvngLampChgnSta 3;
BA_ "GenSigTimeoutTime" SG_ 3221225472 CLU_DrvngLampChgnSta 0;
BA_ "Version" SG_ 3221225472 CLU_DrvngLampChgnSta "17.12.03";
BA_ "Description" SG_ 3221225472 FR_SHVU_SeatOptSta "RH 시트에 적용된 히터/통풍 옵션 사양";
BA_ "GenSigSendType" SG_ 3221225472 FR_SHVU_SeatOptSta 4;
BA_ "UserSigValidity" SG_ 3221225472 FR_SHVU_SeatOptSta 3;
BA_ "GenSigTimeoutTime" SG_ 3221225472 FR_SHVU_SeatOptSta 1500;
BA_ "NetworkRequest" SG_ 3221225472 FR_SHVU_SeatOptSta 0;
BA_ "NetworkRequestHoldingTime" SG_ 3221225472 FR_SHVU_SeatOptSta 5000;
BA_ "Version" SG_ 3221225472 FR_SHVU_SeatOptSta "17.12.03";
BA_ "Description" SG_ 3221225472 FR_SHVU_SeatHtOperSta "RH 시트 현재 작동 중인 히터/통풍 단수 상태";
BA_ "GenSigSendType" SG_ 3221225472 FR_SHVU_SeatHtOperSta 4;
BA_ "UserSigValidity" SG_ 3221225472 FR_SHVU_SeatHtOperSta 3;
BA_ "GenSigTimeoutTime" SG_ 3221225472 FR_SHVU_SeatHtOperSta 1500;
BA_ "NetworkRequest" SG_ 3221225472 FR_SHVU_SeatHtOperSta 0;
BA_ "NetworkRequestHoldingTime" SG_ 3221225472 FR_SHVU_SeatHtOperSta 5000;
BA_ "Version" SG_ 3221225472 FR_SHVU_SeatHtOperSta "17.12.03";
BA_ "Description" SG_ 3221225472 FR_SHVU_HtSwHiIndSta "RH 시트 열선 스위치 High Indicator 정보";
BA_ "GenSigSendType" SG_ 3221225472 FR_SHVU_HtSwHiIndSta 4;
BA_ "UserSigValidity" SG_ 3221225472 FR_SHVU_HtSwHiIndSta 3;
BA_ "GenSigTimeoutTime" SG_ 3221225472 FR_SHVU_HtSwHiIndSta 1500;
BA_ "NetworkRequest" SG_ 3221225472 FR_SHVU_HtSwHiIndSta 0;
BA_ "NetworkRequestHoldingTime" SG_ 3221225472 FR_SHVU_HtSwHiIndSta 5000;
BA_ "Version" SG_ 3221225472 FR_SHVU_HtSwHiIndSta "17.12.03";
BA_ "Description" SG_ 3221225472 FR_SHVU_HtSwMidIndSta "RH 시트 열선 스위치 Mid Indicator 정보";
BA_ "GenSigSendType" SG_ 3221225472 FR_SHVU_HtSwMidIndSta 4;
BA_ "UserSigValidity" SG_ 3221225472 FR_SHVU_HtSwMidIndSta 3;
BA_ "GenSigTimeoutTime" SG_ 3221225472 FR_SHVU_HtSwMidIndSta 1500;
BA_ "NetworkRequest" SG_ 3221225472 FR_SHVU_HtSwMidIndSta 0;
BA_ "NetworkRequestHoldingTime" SG_ 3221225472 FR_SHVU_HtSwMidIndSta 5000;
BA_ "Version" SG_ 3221225472 FR_SHVU_HtSwMidIndSta "17.12.03";
BA_ "Description" SG_ 3221225472 FR_SHVU_HtSwLowIndSta "RH 시트 열선 스위치 Low Indicator 정보";
BA_ "GenSigSendType" SG_ 3221225472 FR_SHVU_HtSwLowIndSta 4;
BA_ "UserSigValidity" SG_ 3221225472 FR_SHVU_HtSwLowIndSta 3;
BA_ "GenSigTimeoutTime" SG_ 3221225472 FR_SHVU_HtSwLowIndSta 1500;
BA_ "NetworkRequest" SG_ 3221225472 FR_SHVU_HtSwLowIndSta 0;
BA_ "NetworkRequestHoldingTime" SG_ 3221225472 FR_SHVU_HtSwLowIndSta 5000;
BA_ "Version" SG_ 3221225472 FR_SHVU_HtSwLowIndSta "17.12.03";
BA_ "Description" SG_ 3221225472 FR_SHVU_VntSwHiIndSta "RH 시트 통풍 스위치 High Indicator 정보";
BA_ "GenSigSendType" SG_ 3221225472 FR_SHVU_VntSwHiIndSta 4;
BA_ "UserSigValidity" SG_ 3221225472 FR_SHVU_VntSwHiIndSta 3;
BA_ "GenSigTimeoutTime" SG_ 3221225472 FR_SHVU_VntSwHiIndSta 1500;
BA_ "NetworkRequest" SG_ 3221225472 FR_SHVU_VntSwHiIndSta 0;
BA_ "NetworkRequestHoldingTime" SG_ 3221225472 FR_SHVU_VntSwHiIndSta 5000;
BA_ "Version" SG_ 3221225472 FR_SHVU_VntSwHiIndSta "17.12.03";
BA_ "Description" SG_ 3221225472 FR_SHVU_VntSwMidIndSta "RH 시트 통풍 스위치 Mid Indicator 정보";
BA_ "GenSigSendType" SG_ 3221225472 FR_SHVU_VntSwMidIndSta 4;
BA_ "UserSigValidity" SG_ 3221225472 FR_SHVU_VntSwMidIndSta 3;
BA_ "GenSigTimeoutTime" SG_ 3221225472 FR_SHVU_VntSwMidIndSta 1500;
BA_ "NetworkRequest" SG_ 3221225472 FR_SHVU_VntSwMidIndSta 0;
BA_ "NetworkRequestHoldingTime" SG_ 3221225472 FR_SHVU_VntSwMidIndSta 5000;
BA_ "Version" SG_ 3221225472 FR_SHVU_VntSwMidIndSta "17.12.03";
BA_ "Description" SG_ 3221225472 FR_SHVU_VntSwLowIndSta "RH 시트 통풍 스위치 Low Indicator 정보";
BA_ "GenSigSendType" SG_ 3221225472 FR_SHVU_VntSwLowIndSta 4;
BA_ "UserSigValidity" SG_ 3221225472 FR_SHVU_VntSwLowIndSta 3;
BA_ "GenSigTimeoutTime" SG_ 3221225472 FR_SHVU_VntSwLowIndSta 1500;
BA_ "NetworkRequest" SG_ 3221225472 FR_SHVU_VntSwLowIndSta 0;
BA_ "NetworkRequestHoldingTime" SG_ 3221225472 FR_SHVU_VntSwLowIndSta 5000;
BA_ "Version" SG_ 3221225472 FR_SHVU_VntSwLowIndSta "17.12.03";
BA_ "Description" SG_ 3221225472 SCC_DrvOvrRidSta "This signal provides bit information whether the demand torque by the driver is higher than the torque requested by SCC system or not. This signal should be set by an engine control system only if the acceleration pedal is actuated by the driver (so that";
BA_ "UserSigValidity" SG_ 3221225472 SCC_DrvOvrRidSta 3;
BA_ "GenSigTimeoutTime" SG_ 3221225472 SCC_DrvOvrRidSta 1500;
BA_ "RoutingFactor" SG_ 3221225472 SCC_DrvOvrRidSta 2;
BA_ "Version" SG_ 3221225472 SCC_DrvOvrRidSta "17.12.00";
BA_ "Description" SG_ 3221225472 SCC_SccFlrDetSta "When it is set, the signal indicates that EMS cannot accept the engine torque request for SCC, TQI_ACC, because of a failure or failures in EMS which may be recovered within the same ignition cycle. EMS stores DTC for the failure.

In case that there is ";
BA_ "UserSigValidity" SG_ 3221225472 SCC_SccFlrDetSta 3;
BA_ "GenSigTimeoutTime" SG_ 3221225472 SCC_SccFlrDetSta 1500;
BA_ "RoutingFactor" SG_ 3221225472 SCC_SccFlrDetSta 2;
BA_ "Version" SG_ 3221225472 SCC_SccFlrDetSta "17.12.00";
BA_ "Description" SG_ 3221225472 SCC_FuncFlrDetSta "When it is set, the signal indicates that EMS cannot accept the engine torque request for SCC, TQI_ACC, because of a failure or failures in EMS which cannot be recovered within the same ignition cycle. EMS stores DTC for the failure.

In case that there ";
BA_ "UserSigValidity" SG_ 3221225472 SCC_FuncFlrDetSta 3;
BA_ "GenSigTimeoutTime" SG_ 3221225472 SCC_FuncFlrDetSta 1500;
BA_ "RoutingFactor" SG_ 3221225472 SCC_FuncFlrDetSta 2;
BA_ "Version" SG_ 3221225472 SCC_FuncFlrDetSta "17.12.00";
BA_ "Description" SG_ 3221225472 SCC_SccOffStaDetSta "When it is set, the signal indicates that EMS cannot accept the engine torque request for SCC, TQI_ACC, but it is not related any failures in EMS. Therefore, EMS does not store DTC.

In case that the condition is cleared, the signal gets reset.";
BA_ "UserSigValidity" SG_ 3221225472 SCC_SccOffStaDetSta 3;
BA_ "GenSigTimeoutTime" SG_ 3221225472 SCC_SccOffStaDetSta 1500;
BA_ "RoutingFactor" SG_ 3221225472 SCC_SccOffStaDetSta 2;
BA_ "Version" SG_ 3221225472 SCC_SccOffStaDetSta "17.12.00";
BA_ "Description" SG_ 3221225472 SCC_BrkLtSwFlrDetSta "Failure signal to SCC when a failure occurs in the brake light switch acquisition of engine control";
BA_ "UserSigValidity" SG_ 3221225472 SCC_BrkLtSwFlrDetSta 3;
BA_ "GenSigTimeoutTime" SG_ 3221225472 SCC_BrkLtSwFlrDetSta 1500;
BA_ "RoutingFactor" SG_ 3221225472 SCC_BrkLtSwFlrDetSta 2;
BA_ "Version" SG_ 3221225472 SCC_BrkLtSwFlrDetSta "17.12.00";
BA_ "Description" SG_ 3221225472 ISA_IsaFuncSta "This signal indicates that if ISA function is active or not.

If ISA function is activated then CF_Ems_IsaAct = 1. Although “ISA Main” switch is on, if the ISA function is deactivated then CF_Ems_IsaAct should be set to ‘0’.";
BA_ "UserSigValidity" SG_ 3221225472 ISA_IsaFuncSta 3;
BA_ "GenSigTimeoutTime" SG_ 3221225472 ISA_IsaFuncSta 1500;
BA_ "RoutingFactor" SG_ 3221225472 ISA_IsaFuncSta 2;
BA_ "Version" SG_ 3221225472 ISA_IsaFuncSta "17.12.00";
BA_ "Description" SG_ 3221225472 SCC_StrtLimFuncSta "This Signal is Start Limitation Function operation bit

0x0: No Start Limitation function operation

0x1: Start Limitation function operation";
BA_ "UserSigValidity" SG_ 3221225472 SCC_StrtLimFuncSta 3;
BA_ "GenSigTimeoutTime" SG_ 3221225472 SCC_StrtLimFuncSta 1500;
BA_ "RoutingFactor" SG_ 3221225472 SCC_StrtLimFuncSta 2;
BA_ "Version" SG_ 3221225472 SCC_StrtLimFuncSta "17.12.00";
BA_ "Description" SG_ 3221225472 EMS_SafetyFunctSta "This signal is Safety function operation bit.";
BA_ "UserSigValidity" SG_ 3221225472 EMS_SafetyFunctSta 3;
BA_ "GenSigTimeoutTime" SG_ 3221225472 EMS_SafetyFunctSta 1500;
BA_ "RoutingFactor" SG_ 3221225472 EMS_SafetyFunctSta 2;
BA_ "Version" SG_ 3221225472 EMS_SafetyFunctSta "18.01.01";
BA_ "Description" SG_ 3221225472 InAirTempVal "IntAirTemp indicates intake air temperature of an engine.

A TCU controls oil pressure during gear shifting and also changes an air-con load compensation factor using this signal.";
BA_ "UserSigValidity" SG_ 3221225472 InAirTempVal 3;
BA_ "GenSigTimeoutTime" SG_ 3221225472 InAirTempVal 1500;
BA_ "RoutingFactor" SG_ 3221225472 InAirTempVal 2;
BA_ "Version" SG_ 3221225472 InAirTempVal "18.01.01";
BA_ "Description" SG_ 3221225472 OBD_RbmSta "For the calculation of the denominators for Rate-Based Monitoring(RBM), CARB defined the standardized vehicle operations, which must be met to increment the denominator counter.

So, this variable is to give a status information(fulfilled or not) about a";
BA_ "UserSigValidity" SG_ 3221225472 OBD_RbmSta 3;
BA_ "GenSigTimeoutTime" SG_ 3221225472 OBD_RbmSta 1500;
BA_ "RoutingFactor" SG_ 3221225472 OBD_RbmSta 2;
BA_ "Version" SG_ 3221225472 OBD_RbmSta "17.12.00";
BA_ "Description" SG_ 3221225472 OBD_IgnCycCntVal "Number of driving cycle since first ECU power-up.

The counter is incremented each time a driving cycle with engine running for a specified time duration is detected. This value is only initialized with 0 on saved RAM lost (or reprogramming).

Signal val";
BA_ "UserSigValidity" SG_ 3221225472 OBD_IgnCycCntVal 3;
BA_ "GenSigTimeoutTime" SG_ 3221225472 OBD_IgnCycCntVal 1500;
BA_ "RoutingFactor" SG_ 3221225472 OBD_IgnCycCntVal 2;
BA_ "Version" SG_ 3221225472 OBD_IgnCycCntVal "17.12.00";
BA_ "Description" SG_ 3221225472 OBD_DnmntrCalcVal "The counter for the general denominator CTR_CDN_OBD is incremented each time a valid driving cycle with standardized vehicle operation is recognized. 

The numbers of driving cycles are counted since the first ECU power up. This value is only initialized";
BA_ "UserSigValidity" SG_ 3221225472 OBD_DnmntrCalcVal 3;
BA_ "GenSigTimeoutTime" SG_ 3221225472 OBD_DnmntrCalcVal 1500;
BA_ "RoutingFactor" SG_ 3221225472 OBD_DnmntrCalcVal 2;
BA_ "Version" SG_ 3221225472 OBD_DnmntrCalcVal "17.12.00";
BA_ "Description" SG_ 3221225472 TCU_NetrlCtrlSta "This signal indicates the status of Neutral Control.";
BA_ "UserSigValidity" SG_ 3221225472 TCU_NetrlCtrlSta 3;
BA_ "RoutingFactor" SG_ 3221225472 TCU_NetrlCtrlSta 5;
BA_ "Version" SG_ 3221225472 TCU_NetrlCtrlSta "17.11.00";
BA_ "Description" SG_ 3221225472 TCU_ShftPtrnSta "It is an ID of current shift pattern which is being used by TCU.

The ID is assigned for each TCU.";
BA_ "UserSigValidity" SG_ 3221225472 TCU_ShftPtrnSta 3;
BA_ "RoutingFactor" SG_ 3221225472 TCU_ShftPtrnSta 5;
BA_ "Version" SG_ 3221225472 TCU_ShftPtrnSta "17.11.00";
BA_ "Description" SG_ 3221225472 TCU_VgisInhbtReq "TCU requests ECU to inhibit the VGIS fuction from changing its status.";
BA_ "UserSigValidity" SG_ 3221225472 TCU_VgisInhbtReq 3;
BA_ "RoutingFactor" SG_ 3221225472 TCU_VgisInhbtReq 5;
BA_ "Version" SG_ 3221225472 TCU_VgisInhbtReq "17.11.00";
BA_ "Description" SG_ 3221225472 TCU_EngTqIncReqVal "The TCU requests the engine torque increase via this signal to the EMS.



If MSB is 1, this signal is - value.

else, this signal is +value.

0~10bit is used for absolute value.";
BA_ "RoutingFactor" SG_ 3221225472 TCU_EngTqIncReqVal 5;
BA_ "Version" SG_ 3221225472 TCU_EngTqIncReqVal "18.01.02";
BA_ "Description" SG_ 3221225472 SCR_LvlWrngLmpSta "The signal indicates the status of the 'SCR level Warning lamp'";
BA_ "UserSigValidity" SG_ 3221225472 SCR_LvlWrngLmpSta 3;
BA_ "GenSigTimeoutTime" SG_ 3221225472 SCR_LvlWrngLmpSta 1500;
BA_ "RoutingFactor" SG_ 3221225472 SCR_LvlWrngLmpSta 2;
BA_ "Version" SG_ 3221225472 SCR_LvlWrngLmpSta "17.12.00";
BA_ "Description" SG_ 3221225472 SCR_LvlWrngMsgDis "The signal indicates the status of the Message";
BA_ "UserSigValidity" SG_ 3221225472 SCR_LvlWrngMsgDis 3;
BA_ "GenSigTimeoutTime" SG_ 3221225472 SCR_LvlWrngMsgDis 1500;
BA_ "RoutingFactor" SG_ 3221225472 SCR_LvlWrngMsgDis 2;
BA_ "Version" SG_ 3221225472 SCR_LvlWrngMsgDis "17.12.00";
VAL_ 3221225472 IFS_10Ch_Stat_RH 3 "Not Used" 2 "Dimming" 1 "On" 0 "Off" ;
VAL_ 3221225472 IFS_9Ch_Stat_RH 3 "Not Used" 2 "Dimming" 1 "On" 0 "Off" ;
VAL_ 3221225472 IFS_8Ch_Stat_RH 3 "Not Used" 2 "Dimming" 1 "On" 0 "Off" ;
VAL_ 3221225472 IFS_7Ch_Stat_RH 3 "Not Used" 2 "Dimming" 1 "On" 0 "Off" ;
VAL_ 3221225472 IFS_6Ch_Stat_RH 3 "Not Used" 2 "Dimming" 1 "On" 0 "Off" ;
VAL_ 3221225472 IFS_5Ch_Stat_RH 3 "Not Used" 2 "Dimming" 1 "On" 0 "Off" ;
VAL_ 3221225472 IFS_4Ch_Stat_RH 3 "Not Used" 2 "Dimming" 1 "On" 0 "Off" ;
VAL_ 3221225472 IFS_3Ch_Stat_RH 3 "Not Used" 2 "Dimming" 1 "On" 0 "Off" ;
VAL_ 3221225472 IFS_2Ch_Stat_RH 3 "Not Used" 2 "Dimming" 1 "On" 0 "Off" ;
VAL_ 3221225472 IFS_1Ch_Stat_RH 3 "Not Used" 2 "Dimming" 1 "On" 0 "Off" ;
VAL_ 3221225472 IFS_10Ch_Stat_LH 3 "Not Used" 2 "Dimming" 1 "On" 0 "Off" ;
VAL_ 3221225472 IFS_9Ch_Stat_LH 3 "Not Used" 2 "Dimming" 1 "On" 0 "Off" ;
VAL_ 3221225472 IFS_8Ch_Stat_LH 3 "Not Used" 2 "Dimming" 1 "On" 0 "Off" ;
VAL_ 3221225472 IFS_7Ch_Stat_LH 3 "Not Used" 2 "Dimming" 1 "On" 0 "Off" ;
VAL_ 3221225472 IFS_6Ch_Stat_LH 3 "Not Used" 2 "Dimming" 1 "On" 0 "Off" ;
VAL_ 3221225472 IFS_5Ch_Stat_LH 3 "Not Used" 2 "Dimming" 1 "On" 0 "Off" ;
VAL_ 3221225472 IFS_4Ch_Stat_LH 3 "Not Used" 2 "Dimming" 1 "On" 0 "Off" ;
VAL_ 3221225472 IFS_3Ch_Stat_LH 3 "Not Used" 2 "Dimming" 1 "On" 0 "Off" ;
VAL_ 3221225472 IFS_2Ch_Stat_LH 3 "Not Used" 2 "Dimming" 1 "On" 0 "Off" ;
VAL_ 3221225472 IFS_1Ch_Stat_LH 3 "Not Used" 2 "Dimming" 1 "On" 0 "Off" ;
VAL_ 3221225472 CLU_OutTempCSta 0 "0x0~0x64:-40~60℃" 100 "0x0~0x64:-40~60℃" 101 "65~0xFE:Reserved" 254 "65~0xFE:Reserved" 255 "Invalid" ;
VAL_ 3221225472 CLU_SndTyp 0 "Cluster applied speaker" 1 "Cluster applied buzzer" 2 "Not used" 3 "Error Indicator" ;
VAL_ 3221225472 CLU_TripUnitSta 0 "Not Used" 1 "km" 2 "mile" 3 "Invailid" ;
VAL_ 3221225472 CLU_AvgFuelCnsmptnVal 1023 "Error" ;
VAL_ 3221225472 CLU_AvgFuelCnsmptnUnitSta 0 "km/L" 1 "L/100km" 2 "MPG(US)" 3 "MPG(UK)" ;
VAL_ 3221225472 CLU_LoFuelWrngSta 0 "Low fuel Warning is off" 1 "Low fuel Warning is on" 2 "Not used" 3 "Invalid" ;
VAL_ 3221225472 CLU_RefuelDetSta 0 "Non refuel detected" 1 "Refuel detected" 2 "Not used" 3 "Error Indicator" ;
VAL_ 3221225472 CLU_TerrainMainSwSta 0 "Default" 1 "On-Road" 2 "Off-Road" 3 "Reserved" ;
VAL_ 3221225472 CLU_LngSta 0 "Off" 1 "Korean" 2 "English(US)" 3 "English(UK)" 4 "Chinese(Mandarin)" 5 "Chinese(Cantonese)" 6 "French(EU)" 7 "Spanish(EU)" 8 "Arabic" 9 "Czech" 10 "Danish" 11 "German" 12 "Italian" 13 "Dutch" 14 "Polish" 15 "Portuguese" 16 "Russian" 17 "Slovak" 18 "Swedish" 19 "Turkish" 20 "French(US)" 21 "Spanish(US)" 22 "Reserved" 23 "Reserved" 24 "Reserved" 25 "Reserved" 26 "Reserved" 27 "Reserved" 28 "Reserved" 29 "Reserved" 30 "Reserved" 31 "Invalid" ;
VAL_ 3221225472 CLU_SRSWrngLmpSta 0 "Lamp OFF" 1 "Lamp On" 2 "Lamp Flashing" 3 "ACU message error" 7 "Lamp Circuit Failure" ;
VAL_ 3221225472 CLU_OdoVal 16777215 "Error" ;
VAL_ 3221225472 CLU_DawLastBrkTimeVal 0 "Value x 30min (0~6.5hr)" 1 "Value x 30min (0~6.5hr)" 2 "Value x 30min (0~6.5hr)" 3 "Value x 30min (0~6.5hr)" 4 "Value x 30min (0~6.5hr)" 5 "Value x 30min (0~6.5hr)" 6 "Value x 30min (0~6.5hr)" 7 "Value x 30min (0~6.5hr)" 8 "Value x 30min (0~6.5hr)" 9 "Value x 30min (0~6.5hr)" 10 "Value x 30min (0~6.5hr)" 11 "Value x 30min (0~6.5hr)" 12 "Value x 30min (0~6.5hr)" 13 "Value x 30min (0~6.5hr)" 14 "7hr or more" 15 "Invalid" ;
VAL_ 3221225472 CLU_RefuelWrnSta 0 "Refuel Popup is off" 1 "Refuel Popup is on" 2 "Reserved" 3 "Invalid" ;
VAL_ 3221225472 CLU_IceWrnIndSta 0 "Off" 1 "On" 2 "Not used" 3 "Error Indicator" ;
VAL_ 3221225472 CLU_DrvngModSwSta 0 "Off" 1 "Normal" 2 "Eco" 3 "Sport" 4 "Sport+" 5 "Smart" 6 "Custom" 7 "N-mode" 8 "Reserved" 9 "Reserved" 10 "Reserved" 11 "Reserved" 12 "Reserved" 13 "Reserved" 14 "Reserved" 15 "Reserved" ;
VAL_ 3221225472 CLU_FuelLvlSta 0 "0x0~0x64:0%~100%" 100 "0x0~0x64:0%~100%" 101 "Reserved" 102 "Reserved" 103 "Reserved" 104 "Reserved" 105 "Reserved" 106 "Reserved" 107 "Reserved" 108 "Reserved" 109 "Reserved" 110 "Reserved" 111 "Reserved" 112 "Reserved" 113 "Reserved" 114 "Reserved" 115 "Reserved" 116 "Reserved" 117 "Reserved" 118 "Reserved" 119 "Reserved" 120 "Reserved" 121 "Reserved" 122 "Reserved" 123 "Reserved" 124 "Reserved" 125 "Reserved" 126 "Reserved" 127 "Invalid(Error)" ;
VAL_ 3221225472 CLU_OutTempFSta 0 "0x0~0xB4:-40~140℉" 180 "0x0~0xB4:-40~140℉" 181 "Reserved" 182 "Reserved" 183 "Reserved" 184 "Reserved" 185 "Reserved" 186 "Reserved" 187 "Reserved" 188 "Reserved" 189 "Reserved" 190 "Reserved" 191 "Reserved" 192 "Reserved" 193 "Reserved" 194 "Reserved" 195 "Reserved" 196 "Reserved" 197 "Reserved" 198 "Reserved" 199 "Reserved" 200 "Reserved" 201 "Reserved" 202 "Reserved" 203 "Reserved" 204 "Reserved" 205 "Reserved" 206 "Reserved" 207 "Reserved" 208 "Reserved" 209 "Reserved" 210 "Reserved" 211 "Reserved" 212 "Reserved" 213 "Reserved" 214 "Reserved" 215 "Reserved" 216 "Reserved" 217 "Reserved" 218 "Reserved" 219 "Reserved" 220 "Reserved" 221 "Reserved" 222 "Reserved" 223 "Reserved" 224 "Reserved" 225 "Reserved" 226 "Reserved" 227 "Reserved" 228 "Reserved" 229 "Reserved" 230 "Reserved" 231 "Reserved" 232 "Reserved" 233 "Reserved" 234 "Reserved" 235 "Reserved" 236 "Reserved" 237 "Reserved" 238 "Reserved" 239 "Reserved" 240 "Reserved" 241 "Reserved" 242 "Reserved" 243 "Reserved" 244 "Reserved" 245 "Reserved" 246 "Reserved" 247 "Reserved" 248 "Reserved" 249 "Reserved" 250 "Reserved" 251 "Reserved" 252 "Reserved" 253 "Reserved" 254 "Reserved" 255 "Invalid" ;
VAL_ 3221225472 CLU_TerrainModSwSta 0 "Default" 1 "Snow" 2 "Sand" 3 "Mud" 4 "Reserved" 5 "Reserved" 6 "Reserved" 7 "Reserved" ;
VAL_ 3221225472 Audio_VcRecSwSta 0 "Off" 1 "Key On" 2 "Reserved" 3 "Invalid" ;
VAL_ 3221225472 Audio_BluetoothPhnClSwSta 0 "Off" 1 "Key On" 2 "Reserved" 3 "Invalid" ;
VAL_ 3221225472 Audio_ModSwSta 0 "Off" 1 "Key On" 2 "Reserved" 3 "Invalid" ;
VAL_ 3221225472 Audio_MutSwSta 0 "Off" 1 "Key On" 2 "Reserved" 3 "Invalid" ;
VAL_ 3221225472 Audio_SeekDnSwSta 0 "Off" 1 "Key On" 2 "Reserved" 3 "Invalid" ;
VAL_ 3221225472 Audio_SeekUpSwSta 0 "Off" 1 "Key On" 2 "Reserved" 3 "Invalid" ;
VAL_ 3221225472 Cluster_ModeSwSta 0 "Off" 1 "Key On" 2 "Reserved" 3 "Invalid" ;
VAL_ 3221225472 Cluster_ScrlOkSwSta 0 "Off" 1 "Key On" 2 "Reserved" 3 "Invalid" ;
VAL_ 3221225472 Audio_CustomSwSta 0 "Off" 1 "Key On" 2 "Reserved" 3 "Invalid" ;
VAL_ 3221225472 USM_CmdWPCSta 0 "Default" 1 "Off(Disable)" 2 "On(Enable)" 3 "Invalid" ;
VAL_ 3221225472 WPC_PhnLftWrngSta 0 "Off" 1 "Cellphone on the pad" 2 "Charging" 3 "Charging complete" 4 "Cellphone reminder" 5 "Error" 6 "Reserved" 7 "Invalid" ;
VAL_ 3221225472 WPC_NFCDeviceDetSta 0 "Off(NFC turned off)" 1 "Detected" 2 "Not Detected" 3 "Reserved" 4 "Reserved" 5 "Reserved" 6 "Reserved" 7 "Reserved" 8 "Reserved" 9 "Reserved" 10 "Reserved" 11 "Reserved" 12 "Reserved" 13 "Reserved" 14 "Reserved" 15 "Invalid" ;
VAL_ 3221225472 SSB_StrtStpBtnSw1Sta 0 "Released" 1 "Pressed" 2 "Not Used" 3 "Error Indicator" ;
VAL_ 3221225472 SSB_StrtStpBtnSw2Sta 0 "Released" 1 "Pressed" 2 "Not Used" 3 "Error Indicator" ;
VAL_ 3221225472 SMK_TrmnlCtrlSta 0 "Off" 1 "ACC" 2 "IGN" 3 "START" 4 "Reserved/" 5 "Reseved" 6 "Reseved" 7 "Reserved" 8 "Reserved" 9 "Reserved" 10 "Reserved" 11 "Reserved" 12 "Reserved" 13 "Reserved" 14 "Not Used" 15 "Error Indicator" ;
VAL_ 3221225472 SMK_TrmnlMngrSta 0 "Off" 1 "OFF_TO_START" 16 "ENGINE_RUNNING" 2 "WAIT_ESCL_UNLOCK_ACC" 3 "ACC" 4 "ACC_SEARCH" 5 "ACC_TO_START" 6 "IGN" 7 "IGN_SEARCH" 8 "WAIT_ESCL_UNLOCK_OFF_TO_START" 9 "WAIT_ESCL_UNLOCK_START" 10 "WAIT_IGN1_ACC" 11 "WAIT_IGN1_ACC_SEARCH" 12 "WAIT_IGN1_ACC_TO_START" 13 "WAIT_IGN1_UNLOCK_OFF_TO_START" 14 "WAIT_IGN1_UNLOCK_START" 15 "START" 16 "Reserved" 17 "Reserved" 18 "Reserved" 19 "Reserved" 20 "Reserved" 21 "Reserved" 22 "Reserved" 23 "Reserved" 24 "Reserved" 25 "Reserved" 26 "Reserved" 27 "Reserved" 28 "Reserved0x1D:Reserved" 30 "Not Used" 31 "Error Indicator" ;
VAL_ 3221225472 SMK_AuthSta 0 "No Auth" 1 "Preauthentication" 2 "Authentication" 3 "Fast Restart" 4 "Reserved" 5 "Reseved" 6 "Not Used" 7 "Error Indicator" ;
VAL_ 3221225472 SMK_Ign1InSta 0 "IGN1 Off" 1 "IGN1 On" 2 "Not Used" 3 "Error Indicator" ;
VAL_ 3221225472 SMK_Ign1RlySta 0 "Off" 1 "On" 2 "Not Used" 3 "Error Indicator" ;
VAL_ 3221225472 SMK_Ign2InSta 0 "IGN2 Off" 1 "IGN2 On" 2 "Not Used" 3 "Error Indicator" ;
VAL_ 3221225472 SMK_Ign2RlySta 0 "Off" 1 "On" 2 "Not Used" 3 "Error Indicator" ;
VAL_ 3221225472 SMK_StrtFdbckSta 0 "Off" 1 "On" 2 "Not Used" 3 "Error Indicator" ;
VAL_ 3221225472 SMK_StrtrRlyOutSta 0 "Starter Relay Output Off" 1 "Starter Relay Output On" 2 "Not Used" 3 "Error Indicator" ;
VAL_ 3221225472 SMK_AccInSta 0 "ACC OFF" 1 "ACC ON" 2 "Not Used" 3 "Error Indicator" ;
VAL_ 3221225472 SMK_AccRlySta 0 "Off" 1 "On" 2 "Not Used" 3 "Error Indicator" ;
VAL_ 3221225472 SMK_CLUAccIndOnReq 0 "Cluster ACC Indicator Off" 1 "Cluster ACC Indicator On" 2 "Not Used" 3 "Error Indicator" ;
VAL_ 3221225472 SMK_TlEngRunSta 0 "Off" 1 "Tele Engine Running" 2 "Not Used" 3 "Error Indicator" ;
VAL_ 3221225472 SMK_TlCrnkModSta 0 "Normal Mode" 1 "Tele Cranking Mode" 2 "Not Used" 3 "Error Indicator" ;
VAL_ 3221225472 ILCULH_HeightSnsrFront_Stat 0 "Normal" 1 "Fail" 2 "Not Used" 3 "Error Indicator" ;
VAL_ 3221225472 ILCULH_LevelActuator_Sta 0 "Normal" 1 "Fail" 2 "Not Used" 3 "Error Indicator" ;
VAL_ 3221225472 Lamp_HzrdBlnkngSta 0 "Off" 1 "Single Blinking" 2 "Double Blinking" 3 "Reserved" 4 "Reserved" 5 "Reseved" 6 "Not Used" 7 "Error Indicator" ;
VAL_ 3221225472 Lamp_SmrtWlcmLtOnReq 0 "Off" 1 "On" 2 "Not Used" 3 "Error Indicator" ;
VAL_ 3221225472 Fob_BattStaInfo 0 "Normal or No Information" 1 "Recent used FOB is in discharge warning voltage level" 2 "Not Used" 3 "Error Indicator" ;
VAL_ 3221225472 Fob_FoundDrvWlcmArea 0 "Default" 1 "Fob Found(Drv)" 2 "Not Used" 3 "Error Indicator" ;
VAL_ 3221225472 Fob_FoundAsstWlcmArea 0 "Default" 1 "Fob Found(Ast)" 2 "Not Used" 3 "Error Indicator" ;
VAL_ 3221225472 Fob_FoundExtrnlArea 0 "Default" 1 "Can't recognize" 2 "Fob recognized" 3 "Search in progress" ;
VAL_ 3221225472 Fob_FoundIntArea 0 "Default" 1 "Can't recognize" 2 "Fob recognized" 3 "Search in progress" ;
VAL_ 3221225472 Fob_LearntSta 0 "Learnt" 1 "Virgin" 2 "Not Used" 3 "Error Indicator" ;
VAL_ 3221225472 LFAnt_FltSta 0 "Normal" 1 "Fault" 2 "Not Used" 3 "Error Indicator" ;
VAL_ 3221225472 LFAnt_SrchSta 0 "Off" 1 "On (LF Searching)" 2 "Not Used" 3 "Error Indicator" ;
VAL_ 3221225472 RSPA_ModSta_SMK 0 "RSPA Off" 1 "RSPA On" 2 "Reserved" 3 "Reserved" 4 "Reserved" 5 "Reseved" 6 "Not Used" 7 "Error Indicator" ;
VAL_ 3221225472 RSPA_FobBattSta 0 "Normal" 1 "Low Battery" 2 "Reserved" 3 "Reserved" 4 "Reserved" 5 "Reseved" 6 "Not Used" 7 "Error Indicator" ;
VAL_ 3221225472 USM_SmrtTrnkTlgtModSta 0 "Default Value" 1 "HandsFree Off" 2 "HandsFree On" 3 "Invalid" 4 "Reserved" 5 "Reseved" 6 "Not Used" 7 "Error Indicator" ;
VAL_ 3221225472 USM_WALModSta 0 "Default" 1 "WAL Off" 2 "WAL On" 3 "Invalid" 4 "Reserved" 5 "Reseved" 6 "Not Used" 7 "Error Indicator" ;
VAL_ 3221225472 BCM_CntryConfgTyp 0 "Dom" 1 "Na" 2 "Eu" 3 "Aus" 4 "China" 5 "Gen,Mes" 6 "India" 7 "Reserved" 8 "Reserved" 9 "Reserved" 10 "Reserved" 11 "Reserved" 12 "Reserved" 13 "Reserved" 14 "Not Used" 15 "Error Indicator" ;
VAL_ 3221225472 BCM_SmkOptTyp 0 "Non SMK Option" 1 "SMK Option" 2 "Not Used" 3 "Error Indicator" ;
VAL_ 3221225472 Window_DrvrSdWdwSta_BCM 0 "Window Close" 1 "Window Open" 2 "Not Used" 3 "Error Indicator" ;
VAL_ 3221225472 Window_AsstSdWdwSta_BCM 0 "Window Close" 1 "Window Open" 2 "Not Used" 3 "Error Indicator" ;
VAL_ 3221225472 Window_RrLftWdwSta_BCM 0 "Window Close" 1 "Window Open" 2 "Not Used" 3 "Error Indicator" ;
VAL_ 3221225472 Window_RrRtWdwSta_BCM 0 "Window Close" 1 "Window Open" 2 "Not Used" 3 "Error Indicator" ;
VAL_ 3221225472 Window_TunlModAutoIndSta 0 "Off" 1 "On" 2 "Not Used" 3 "Error Indicator" ;
VAL_ 3221225472 ACU_CrshActvSta 0 "Crash Active time is expired (Crash is Inactive)" 1 "Crash Active time started (Crash Detected)" 2 "Not used" 3 "Error Indicator" ;
VAL_ 3221225472 APSS_SldTch 0 "Off" 1 "On" 2 "Error" 3 "Reserved" ;
VAL_ 3221225472 APSS_RclTch 0 "Off" 1 "On" 2 "Error" 3 "Reserved" ;
VAL_ 3221225472 APSS_LmbrTch 0 "Off" 1 "On" 2 "Error" 3 "Reserved" ;
VAL_ 3221225472 ALU_LumbarUpSw 0 "default" 1 "off" 2 "on" 3 "invalid" ;
VAL_ 3221225472 ALU_LumbarMidSw 0 "default" 1 "off" 2 "on" 3 "invalid" ;
VAL_ 3221225472 ALU_LumbarLowSw 0 "default" 1 "off" 2 "on" 3 "invalid" ;
VAL_ 3221225472 ALU_LumbarDefSw 0 "default" 1 "off" 2 "on" 3 "invalid" ;
VAL_ 3221225472 C_LH_Folding_State_PopUp 0 "Default" 1 "Folded (Finished)" 2 "Unfolded (Finished)" 3 "Mode-Fail (Anti-Pinch)" 4 "Mode-Fail (TGS & Break Condition)" 5 "Mode-Fail (System Error)" 6 "Unused" 7 "Invalid" ;
VAL_ 3221225472 C_RH_Folding_State_PopUp 0 "Default" 1 "Folded (Finish)" 2 "UnFolded (Finish)" 3 "Mode-Fail (Anti-Pinch)" 4 "Mode-Fail (TGS & Break Condition)" 5 "Mode-Fail (System Error)" 6 "Unused" 7 "Invalid" ;
VAL_ 3221225472 MLM_MdLmpBrgtnsVal 0 "Default value" 1 "OFF" 2 "step1" 3 "step2" 4 "step3" 5 "step4" 6 "step5" 7 "step6" 8 "step7" 9 "step8" 10 "step9" 11 "step10" 12 "Reserved" 13 "Reserved" 14 "Reserved" 15 "Reserved" 16 "Reserved" 17 "Reserved" 18 "Reserved" 19 "Reserved" 20 "Reserved" 21 "Reserved" 22 "Reserved" 23 "Reserved" 24 "Reserved" 25 "Reserved" 26 "Reserved" 27 "Reserved" 28 "Reserved" 29 "Reserved" 30 "Reserved" 31 "Invaild" ;
VAL_ 3221225472 MLM_MdLmpDrvngVal 0 "Default value" 1 "OFF" 2 "ON" 3 "Invalid" ;
VAL_ 3221225472 MLM_MdLmpRedVal 0 "0x000~0x0FF:Red Color 0~255 (User Selection)" 255 "0x000~0x0FF:Red Color 0~255 (User Selection)" 256 "100~0x1FF:Red Color 0~255 (Expert Recommendation)" 511 "100~0x1FF:Red Color 0~255 (Expert Recommendation)" 512 "Default" 1023 "Invalid" ;
VAL_ 3221225472 MLM_MdLmpGreenVal 0 "0x000~0x0FF:Green Color 0~255 (User Selection)" 255 "0x000~0x0FF:Green Color 0~255 (User Selection)" 256 "100~0x1FF:Green Color 0~255 (Expert Recommendation)" 511 "100~0x1FF:Green Color 0~255 (Expert Recommendation)" 512 "Default" 1023 "Invalid" ;
VAL_ 3221225472 MLM_MdLmpBlueVal 0 "0x000~0x0FF:Blue Color 0~255 (User Selection)" 255 "0x000~0x0FF:Blue Color 0~255 (User Selection)" 256 "100~0x1FF:Blue Color 0~255 (Expert Recommendation)" 511 "100~0x1FF:Blue Color 0~255 (Expert Recommendation)" 512 "Default" 1023 "Invalid" ;
VAL_ 3221225472 ILCURH_HeightSnsrFront_Stat 0 "Normal" 1 "Fail" 2 "Not Used" 3 "Error Indicator" ;
VAL_ 3221225472 ILCURH_LevelActuator_Sta 0 "Normal" 1 "Fail" 2 "Not Used" 3 "Error Indicator" ;
VAL_ 3221225472 ESCL_EsclMngrSta 0 "NOT_POWER_SUPPLIED" 1 "POWER_SUPPLIED_FOR_UNLOCK" 2 "POWER_SUPPLIED_FOR_LOCK" 3 "PWR_SUPPL_FOR_LEARNIGN_NEUTRAL" 4 "UNLOCK_IN_PROGRESS" 5 "LOCK_IN_PROGRESS" 6 "POWER_OFF_CONFIRMATION" 7 "ANTI_SCANNING" 8 "Reserved" 9 "Reserved" 10 "Reserved" 11 "Reserved" 12 "Reserved" 13 "Reserved" 14 "Not Used" 15 "Error Indicator" ;
VAL_ 3221225472 ESCL_EsclPwrSupSta 0 "Off" 1 "On" 2 "Not Used" 3 "Error Indicator" ;
VAL_ 3221225472 ESCL_EsclEnaSta 0 "Off" 1 "On" 2 "Not Used" 3 "Error Indicator" ;
VAL_ 3221225472 ESCL_EsclUnitSta 0 "Retry (Fault)" 1 "In progress (Busy)" 2 "Reserved" 3 "OK" 4 "Unknown" 5 "Reseved" 6 "Not Used" 7 "Error Indicator" ;
VAL_ 3221225472 ESCL_EsclBoltSta 0 "Intermediate" 1 "Locked" 2 "Unlocked" 3 "Failure" 4 "Unknown" 5 "Reseved" 6 "Not Used" 7 "Error Indicator" ;
VAL_ 3221225472 ESCL_EsclLoBattSta 0 "ESCL Low Battery Bit = 0" 1 "ESCL Low Battery Bit = 1" 2 "Unknown" 3 "Reserved" 4 "Reserved" 5 "Reseved" 6 "Not Used" 7 "Error Indicator" ;
VAL_ 3221225472 ESCL_EsclUnLkSwSta 0 "EsclNotPowerSupplied" 1 "EsclPowerSupplied&Unlocked" 2 "EsclPowerSupplied&NotUnlocked" 3 "Reserved" 4 "Reserved" 5 "Reseved" 6 "Not Used" 7 "Error Indicator" ;
VAL_ 3221225472 C_LH_Folding_Position 0 "Default" 1 "Folded" 2 "UnFolded" 3 "Folding (Moving)" 4 "UnFolding (Moving)" 5 "Unknown" 6 "Unused" 7 "Invalid" ;
VAL_ 3221225472 C_RH_Folding_Position 0 "Default" 1 "Folded" 2 "UnFolded" 3 "Folding (Moving)" 4 "UnFolding (Moving)" 5 "Unknown" 6 "Unused" 7 "Invalid" ;
VAL_ 3221225472 PFSU_RL_Folding_SW 0 "Default^0x1:OFF^0x2:ON^0x3:Invalid" ;
VAL_ 3221225472 PFSU_RR_Folding_SW 0 "Default^0x1:OFF^0x2:ON^0x3:Invalid" ;
VAL_ 3221225472 PFSU_RL_Unfolding_SW 0 "Default^0x1:OFF^0x2:ON^0x3:Invalid" ;
VAL_ 3221225472 PFSU_RR_Unfolding_SW 0 "Default^0x1:OFF^0x2:ON^0x3:Invalid" ;
VAL_ 3221225472 RR_SHVU_SeatOptSta 0 "Init" 1 "Heater only 2step" 2 "Heater only 3step" 3 "Vent only 2step" 4 "Vent only 3step" 5 "Heater and Vent 2step" 6 "Heater and Vent 3step" 7 "Invalid" ;
VAL_ 3221225472 RR_SHVU_SeatHtOperSta 0 "Init" 1 "Unused" 2 "Heater & Vent OFF" 3 "Vent Low" 4 "Vent Mid" 5 "Vent High" 6 "Heater Low" 7 "Heater Mid" 8 "Heater High" 9 "Unused" 10 "Unused" 11 "Unused" 12 "Unused" 13 "Unused" 14 "Unused" 15 "Invalid" ;
VAL_ 3221225472 APSU_AstStSldFwdDis 0 "default" 1 "off" 2 "on" 3 "invalid" ;
VAL_ 3221225472 APSU_AstStSldBckwdDis 0 "default" 1 "off" 2 "on" 3 "invalid" ;
VAL_ 3221225472 APSU_AstStReclneFwdDis 0 "default" 1 "off" 2 "on" 3 "invalid" ;
VAL_ 3221225472 APSU_AstStReclneBckwdDis 0 "default" 1 "off" 2 "on" 3 "invalid" ;
VAL_ 3221225472 APSU_AstStTiltUpDis 0 "default" 1 "off" 2 "on" 3 "invalid" ;
VAL_ 3221225472 APSU_AstStTiltDnDis 0 "default" 1 "off" 2 "on" 3 "invalid" ;
VAL_ 3221225472 APSU_AstStHghtUpDis 0 "default" 1 "off" 2 "on" 3 "invalid" ;
VAL_ 3221225472 APSU_AstStHghtDnDis 0 "default" 1 "off" 2 "on" 3 "invalid" ;
VAL_ 3221225472 APSU_AstStLmbrDefDis 0 "default" 1 "off" 2 "on" 3 "invalid" ;
VAL_ 3221225472 APSU_AstStLmbrLoDis 0 "default" 1 "off" 2 "on" 3 "invalid" ;
VAL_ 3221225472 APSU_AstStLmbrMdlDis 0 "default" 1 "off" 2 "on" 3 "invalid" ;
VAL_ 3221225472 APSU_AstStLmbrUpDis 0 "default" 1 "off" 2 "on" 3 "invalid" ;
VAL_ 3221225472 APSU_LmbrSigSrcTyp 0 "not APSU" 1 "APSU" 2 "reserved" 3 "invalid" ;
VAL_ 3221225472 DLBCU_CushInfDis 0 "default" 1 "off" 2 "on" 3 "invalid" ;
VAL_ 3221225472 DLBCU_CushDefDis 0 "default" 1 "off" 2 "on" 3 "invalid" ;
VAL_ 3221225472 DMIC_DrvModSta 0 "Individual" 1 "Snow" 2 "Comfort(Normal)" 3 "Comfort+(Comfort)" 4 "ECO" 5 "Sport" 6 "Sport+" 7 "Smart" 8 "Not used" 9 "Not used" 10 "Not used" 11 "Not used" 12 "Not used" 13 "Not used" 14 "Not used" 15 "Error Indicator" ;
VAL_ 3221225472 DMIC_SmtShftModSta 0 "OFF" 1 "ON" 2 "Not used" 3 "Error Indicator" ;
VAL_ 3221225472 DMIC_EngModSta 0 "0FF" 1 "ON" 2 "Comfort(Normal)" 3 "Comfort+(Comfort)" 4 "ECO" 5 "Sport" 6 "Sport+" 7 "Smart" 8 "Not used" 9 "Not used" 10 "Not used" 11 "Not used" 12 "Not used" 13 "Not used" 14 "Not used" 15 "Error Indicator" ;
VAL_ 3221225472 DMIC_TmModSta 0 "0FF" 1 "ON" 2 "Comfort(Normal)" 3 "Comfort+(Comfort)" 4 "ECO" 5 "Sport" 6 "Sport+" 7 "Smart" 8 "Not used" 9 "Not used" 10 "Not used" 11 "Not used" 12 "Not used" 13 "Not used" 14 "Not used" 15 "Error Indicator" ;
VAL_ 3221225472 DMIC_AwdModSta 0 "0FF" 1 "ON" 2 "Comfort(Normal)" 3 "Comfort+(Comfort)" 4 "ECO" 5 "Sport" 6 "Sport+" 7 "Smart" 8 "Not used" 9 "Not used" 10 "Not used" 11 "Not used" 12 "Not used" 13 "Not used" 14 "Not used" 15 "Error Indicator" ;
VAL_ 3221225472 APSU_AstStEsyAcsUSMSta 0 "Default Value" 1 "Off (Disable)" 2 "50mmOn (Enable)" 3 "75mmOn (Enable)" 4 "Reserved" 5 "Reserved" 6 "Reserved" 7 "Invalid" ;
VAL_ 3221225472 APSU_AutoHtrCtrlUSMSta 0 "Default" 1 "Off" 2 "On" 3 "Invalid" ;
VAL_ 3221225472 DLBCU_LumbarUpDis 0 "default" 1 "off" 2 "on" 3 "invalid" ;
VAL_ 3221225472 DLBCU_LumbarMidDis 0 "default" 1 "off" 2 "on" 3 "invalid" ;
VAL_ 3221225472 DLBCU_LumbarLowDis 0 "default" 1 "off" 2 "on" 3 "invalid" ;
VAL_ 3221225472 DLBCU_LumbarDefDis 0 "default" 1 "off" 2 "on" 3 "invalid" ;
VAL_ 3221225472 DLBCU_BolsterInfDis 0 "default" 1 "off" 2 "on" 3 "invalid" ;
VAL_ 3221225472 DLBCU_BolsterDefDis 0 "default" 1 "off" 2 "on" 3 "invalid" ;
VAL_ 3221225472 DPSS_LumbarUpSw 0 "Off" 1 "On" 2 "Error" 3 "Reserved" ;
VAL_ 3221225472 DPSS_LumbarMidSw 0 "Off" 1 "On" 2 "Error" 3 "Reserved" ;
VAL_ 3221225472 DPSS_LumbarLowSw 0 "Off" 1 "On" 2 "Error" 3 "Reserved" ;
VAL_ 3221225472 DPSS_LumbarDefSw 0 "Off" 1 "On" 2 "Error" 3 "Reserved" ;
VAL_ 3221225472 DPSS_BolsterInfSw 0 "Off" 1 "On" 2 "Error" 3 "Reserved" ;
VAL_ 3221225472 DPSS_BolsterDefSw 0 "Off" 1 "On" 2 "Error" 3 "Reserved" ;
VAL_ 3221225472 DPSS_ActiveSw 0 "Off" 1 "On" 2 "Error" 3 "Reserved" ;
VAL_ 3221225472 DPSS_SldTch 0 "Off" 1 "On" 2 "Error" 3 "Reserved" ;
VAL_ 3221225472 DPSS_RclTch 0 "Off" 1 "On" 2 "Error" 3 "Reserved" ;
VAL_ 3221225472 DPSS_ExtTch 0 "Off" 1 "On" 2 "Error" 3 "Reserved" ;
VAL_ 3221225472 DPSS_LmbrTch 0 "Off" 1 "On" 2 "Error" 3 "Reserved" ;
VAL_ 3221225472 DPSS_CushOnOffTch 0 "Off" 1 "On" 2 "Error" 3 "Reserved" ;
VAL_ 3221225472 ACU_ActvFltSta 0 "Fault status is active" 1 "Fault status is historic" 2 "Fault does not exist" 3 "Reserved" 4 "Reserved" 5 "Reserved" 6 "Not used" 7 "Error Indicator" ;
VAL_ 3221225472 ACU_SdArbgExtTyp 0 "Side(or Side/Curtain) Airbag doesn't exist." 1 "Side(or Side/Curtain) Airbag exists." 2 "ACU EOL Programming Mode" 3 "Reserved" 4 "Reserved" 5 "Reserved" 6 "Not used" 7 "Error Indicator" ;
VAL_ 3221225472 DPSS_StExtFwdMvBtn 0 "Off" 1 "On" 2 "Error" 3 "Reserved" ;
VAL_ 3221225472 DPSS_StExtBwdMvBtn 0 "Off" 1 "On" 2 "Error" 3 "Reserved" ;
VAL_ 3221225472 DPSS_StSldFwdMvBtn 0 "Off" 1 "On" 2 "Error" 3 "Reserved" ;
VAL_ 3221225472 DPSS_StSldBwdMvBtn 0 "Off" 1 "On" 2 "Error" 3 "Reserved" ;
VAL_ 3221225472 DPSS_StRclFwdMvBtn 0 "Off" 1 "On" 2 "Error" 3 "Reserved" ;
VAL_ 3221225472 DPSS_StRclBwdMvBtn 0 "Off" 1 "On" 2 "Error" 3 "Reserved" ;
VAL_ 3221225472 DPSS_StHgtUpMvBtn 0 "Off" 1 "On" 2 "Error" 3 "Reserved" ;
VAL_ 3221225472 DPSS_StHgtDnMvBtn 0 "Off" 1 "On" 2 "Error" 3 "Reserved" ;
VAL_ 3221225472 DPSS_StTltUpMvBtn 0 "Off" 1 "On" 2 "Error" 3 "Reserved" ;
VAL_ 3221225472 DPSS_StTltDnMvBtn 0 "Off" 1 "On" 2 "Error" 3 "Reserved" ;
VAL_ 3221225472 Window_RrLftWdwSwSta 0 "No Action" 1 "Manual Down" 2 "Manual Up" 3 "Stuck" 4 "Not Used" 5 "Auto Down" 6 "Auto Up" 7 "Invalid" ;
VAL_ 3221225472 Window_RrRtWdwSwSta 0 "No Action" 1 "Manual Down" 2 "Manual Up" 3 "Stuck" 4 "Not Used" 5 "Auto Down" 6 "Auto Up" 7 "Invalid" ;
VAL_ 3221225472 ACU_SysWrngLmpDis 0 "Warning Lamp off" 1 "Warning Lamp on" 2 "Warning Lamp flash" 3 "Reserved" 4 "Reserved" 5 "Reserved" 6 "Not used" 7 "Error Indicator" ;
VAL_ 3221225472 ACU_TlltlLmpDis 0 "Telltale Lamp off" 1 "Telltale Lamp on" 2 "Telltale Lamp flash" 3 "Reserved" 4 "Reserved" 5 "Reserved" 6 "Not used" 7 "Error Indicator" ;
VAL_ 3221225472 ACU_OdsIDReq 0 "Request to send ODS Identifier" 1 "Acknowledgement for the Correct ODS Identifier Received" 2 "Not used" 3 "Error Indicator" ;
VAL_ 3221225472 SeatBelt_PassBcklFltSta 0 "No Fault" 1 "Fault condition exists" 2 "Not used" 3 "Error Indicator" ;
VAL_ 3221225472 SeatBelt_DrvrBcklFltSta 0 "No Fault" 1 "Fault condition exists" 2 "Not used" 3 "Error Indicator" ;
VAL_ 3221225472 SeatBelt_PassBcklSta 0 "Passenger Seat Belt Not Latched" 1 "Passenger Seat Belt Latched" 2 "Not used" 3 "Error Indicator" ;
VAL_ 3221225472 SeatBelt_DrvrBcklSta 0 "Driver Seat Belt Not Latched" 1 "Driver Seat Belt Latched" 2 "Not used" 3 "Error Indicator" ;
VAL_ 3221225472 CLU_ICUDlvrModOffSetReq 0 "Default" 1 "OFF Request" 2 "Reserved" 3 "Invalid" ;
VAL_ 3221225472 CLU_SMKKeyOutWarnOffReq 0 "Default" 1 "OFF Request" 2 "Reserved" 3 "Invalid" ;
VAL_ 3221225472 CLU_DrvngLampChgnSta 0 "Reserved" 1 "Normal" 2 "Eco" 3 "Sport" 4 "Sport+" 5 "Smart" 6 "Custom" 7 "N-mode" 8 "Reserved" 9 "Reserved" 10 "Reserved" 11 "Reserved" 12 "Reserved" 13 "Reserved" 14 "Reserved" 15 "Reserved" ;
VAL_ 3221225472 FR_SHVU_SeatOptSta 0 "Init" 1 "Heater only 2step" 2 "Heater only 3step" 3 "Vent only 2step" 4 "Vent only 3step" 5 "Heater and Vent 2step" 6 "Heater and Vent 3step" 7 "Invalid" ;
VAL_ 3221225472 FR_SHVU_SeatHtOperSta 0 "Init" 1 "Unused" 2 "Heater & Vent OFF" 3 "Vent Low" 4 "Vent Mid" 5 "Vent High" 6 "Heater Low" 7 "Heater Mid" 8 "Heater High" 9 "Unused" 10 "Unused" 11 "Unused" 12 "Unused" 13 "Unused" 14 "Unused" 15 "Invalid" ;
VAL_ 3221225472 FR_SHVU_HtSwHiIndSta 0 "Off(Initial Value)" 1 "On" 2 "Not Used" 3 "Error Indicator" ;
VAL_ 3221225472 FR_SHVU_HtSwMidIndSta 0 "Off(Initial Value)" 1 "On" 2 "Not Used" 3 "Error Indicator" ;
VAL_ 3221225472 FR_SHVU_HtSwLowIndSta 0 "Off(Initial Value)" 1 "On" 2 "Not Used" 3 "Error Indicator" ;
VAL_ 3221225472 FR_SHVU_VntSwHiIndSta 0 "Off(Initial Value)" 1 "On" 2 "Not Used" 3 "Error Indicator" ;
VAL_ 3221225472 FR_SHVU_VntSwMidIndSta 0 "Off(Initial Value)" 1 "On" 2 "Not Used" 3 "Error Indicator" ;
VAL_ 3221225472 FR_SHVU_VntSwLowIndSta 0 "Off(Initial Value)" 1 "On" 2 "Not Used" 3 "Error Indicator" ;
VAL_ 3221225472 SCC_DrvOvrRidSta 0 "No Driver Override" 1 "Driver Override" ;
VAL_ 3221225472 SCC_SccFlrDetSta 0 "No Failure detected" 1 "Failure detected" ;
VAL_ 3221225472 SCC_FuncFlrDetSta 0 "No Failure detected" 1 "Failure detected" ;
VAL_ 3221225472 SCC_SccOffStaDetSta 0 "No switch off condition detected" 1 "Switch off condition detected" ;
VAL_ 3221225472 SCC_BrkLtSwFlrDetSta 0 "No Failure detected" 1 "Failure detected" ;
VAL_ 3221225472 ISA_IsaFuncSta 0 "ISA function is not active" 1 "ISA function is active" ;
VAL_ 3221225472 SCC_StrtLimFuncSta 0 "No Start Limition Function Operation" 1 "Start Limition Function Operation" ;
VAL_ 3221225472 EMS_SafetyFunctSta 0 "No Safety Function operation" 1 "Safety Function operation" ;
VAL_ 3221225472 InAirTempVal 255 "Error indicator" ;
VAL_ 3221225472 TCU_NetrlCtrlSta 0 "No NC" 1 "NC Entry" 2 "NC Applied" 3 "NC Exit" ;
VAL_ 3221225472 TCU_ShftPtrnSta 0 "Normal (ECO)" 1 "Uphill 1 (Optional)" 2 "Uphill 2 (Optional)" 3 "Reserved" 4 "Downhill 1 (Optional)" 5 "Cruise (Optional)" 6 "Cruise_Uphill 1 (Optional)" 7 "Cruise_Uphill 2 (Optional)" 8 "Active ECO (Optional)" 9 "Sport Drive (Optional)" 15 "None of the above" ;
VAL_ 3221225472 TCU_VgisInhbtReq 0 "There’s no request from TCU" 1 "TCU inhibits ECU from changing VGIS status" 2 "Not used" 3 "Error Indicator" ;
VAL_ 3221225472 TCU_EngTqIncReqVal 0 "No request" 2047 "Max. Increase" ;
VAL_ 3221225472 SCR_LvlWrngLmpSta 0 "Lamp Off" 1 "Lamp ON (UREA EMPTY):Amber" ;
VAL_ 3221225472 SCR_LvlWrngMsgDis 0 "No display" 1 "'urea level low' or 'AdBlue low' or 'reagent low'" 2 "‘fill up urea’ or ‘fill up AdBlue’ or ‘fill up reagent' (Buzzer Optional)" 3 "‘fill up urea’ or ‘fill up AdBlue’ or ‘fill up reagent' AND No Restart In %Mileage% (Buzzer Optional)" 4 "‘Urea Level Empty'" ;
