VERSION ""

NS_ :

BS_:

BU_: MLM IBU_HS ILCU_RH MFSW DPSU ILCU_LH PSB APSU DPSS SWRC CGW PTGM DLBCU SCM DAU WPC IAU eCall PFSU RDC PSM

BO_ 3221225472 VECTOR__INDEPENDENT_SIG_MSG: 0 Vector__XXX
 SG_ SCR_SysErrMsgDis : 0|3@1+ (1,0) [0|0] "" Vector__XXX
 SG_ SCR_SysWrngLmpReq : 0|2@1+ (1,0) [0|0] "" Vector__XXX
 SG_ SCR_IndcmtExitStaDis : 0|2@1+ (1,0) [0|0] "" Vector__XXX
 SG_ SCR_UreaLvlSta : 0|8@1+ (0.5,0) [0|0] "%" Vector__XXX
 SG_ SCR_RmnRstrtDis : 0|8@1+ (1,0) [0|0] "" Vector__XXX
 SG_ SCR_RmnDstDis : 0|16@1+ (1,0) [0|0] "km" Vector__XXX
 SG_ ENG_TransmsnTyp : 0|6@1+ (1,0) [0|0] "" Vector__XXX
 SG_ ENG_EngDsplceTyp : 0|8@1+ (0.1,0) [0|0] "liter" Vector__XXX
 SG_ EMS_Crc5Val : 0|16@1+ (1,0) [0|0] "" Vector__XXX
 SG_ EMS_AlvCnt5Val : 0|8@1+ (1,0) [0|0] "" Vector__XXX
 SG_ ENG_ImmoLmpSta : 0|2@1+ (1,0) [0|0] "" Vector__XXX
 SG_ ENG_MilSta : 0|2@1+ (1,0) [0|0] "" Vector__XXX
 SG_ ENG_ImmoSta : 0|2@1+ (1,0) [0|0] "" Vector__XXX
 SG_ OBD_RbmInhbtSta : 0|2@1+ (1,0) [0|0] "" Vector__XXX
 SG_ ENG_AtmsphPrsrVal : 0|5@1+ (10.731613,458.98) [0|0] "mmHg" Vector__XXX
 SG_ ENG_AltFdbckLoadVal : 0|8@1+ (0.4,0) [0|0] "%" Vector__XXX
 SG_ ENG_BattVoltVal : 0|8@1+ (0.1015625,0) [0|0] "V" Vector__XXX
 SG_ ENG_FuelTempVal : 0|8@1+ (0.75,-48) [0|0] "℃" Vector__XXX
 SG_ TCU_Crc1Val : 0|16@1+ (1,0) [0|0] "" Vector__XXX
 SG_ TCU_AlvCnt1Val : 0|8@1+ (1,0) [0|0] "" Vector__XXX
 SG_ TCU_GearSlctDis : 0|4@1+ (1,0) [0|0] "" Vector__XXX
 SG_ TCU_Typ : 0|4@1+ (1,0) [0|0] "" Vector__XXX
 SG_ TCU_TqRdctnVal : 0|12@1- (1,0) [0|0] "Nm" Vector__XXX
 SG_ TCU_GearStepTyp : 0|4@1+ (1,0) [0|0] "" Vector__XXX
 SG_ TCU_GearShftSta : 0|2@1+ (1,0) [0|0] "" Vector__XXX
 SG_ TCU_TqCnvrtrSta : 0|2@1+ (1,0) [0|0] "" Vector__XXX
 SG_ ENG_EngTyp4 : 0|2@1+ (1,0) [0|0] "" Vector__XXX
 SG_ ENG_EngTyp3 : 0|2@1+ (1,0) [0|0] "" Vector__XXX
 SG_ ENG_EngTyp2 : 0|4@1+ (1,0) [0|0] "" Vector__XXX
 SG_ ENG_EngTyp1 : 0|4@1+ (1,0) [0|0] "" Vector__XXX
 SG_ ENG_S_F : 0|2@1+ (1,0) [0|0] "" Vector__XXX
 SG_ ENG_S_F_GEN : 0|3@1+ (1,0) [0|0] "" Vector__XXX
 SG_ ENG_TqStndValExt : 0|8@1+ (10,0) [0|0] "" Vector__XXX
 SG_ TCU_CurrGearSta : 0|4@1+ (1,0) [0|0] "" Vector__XXX
 SG_ TCU_TrgtGearSta : 0|4@1+ (1,0) [0|0] "" Vector__XXX
 SG_ TCU_CluTrgtGearSta : 0|4@1+ (1,0) [0|0] "" Vector__XXX
 SG_ TCH_EngTrgtGearSta : 0|4@1+ (1,0) [0|0] "" Vector__XXX
 SG_ TCU_EngTqLimVal : 0|12@1- (1,0) [0|0] "Nm" Vector__XXX
 SG_ TCU_VehSpdKphVal : 0|8@1+ (1,0) [0|0] "km/h" Vector__XXX
 SG_ TCU_DcmlVehSpdKphVal : 0|8@1+ (0.0078125,0) [0|0] "km/h" Vector__XXX
 SG_ TCU_SprkRtrdReq : 0|8@1+ (0.375,-23.625) [0|0] "˚" Vector__XXX
 SG_ TCU_EngRpmDisSta : 0|2@1+ (1,0) [0|0] "" Vector__XXX
 SG_ TCU_GearLmpBlnkngReq : 0|2@1+ (1,0) [0|0] "" Vector__XXX
 SG_ TCU_FuelCutInhbtReq : 0|2@1+ (1,0) [0|0] "" Vector__XXX
 SG_ TCU_IdleUpReq : 0|2@1+ (1,0) [0|0] "" Vector__XXX
 SG_ TCU_EngRpmDis : 0|16@1+ (0.25,0) [0|0] "rpm" Vector__XXX
 SG_ TCU_SlpVal : 0|6@1+ (0.5,-16) [0|0] "%" Vector__XXX
 SG_ TCU_EngSpdIncReq : 0|2@1+ (1,0) [0|0] "" Vector__XXX
 SG_ TCU_ObdSta : 0|3@1+ (1,0) [0|0] "" Vector__XXX
 SG_ TCU_SprtyIndxSta : 0|5@1+ (1,0) [0|0] "" Vector__XXX
 SG_ TCU_DrvngModDis : 0|3@1+ (1,0) [0|0] "" Vector__XXX
 SG_ TCU_DrvngModReq : 0|3@1+ (1,0) [0|0] "" Vector__XXX
 SG_ TCU_SmrtShftSta : 0|2@1+ (1,0) [0|0] "" Vector__XXX
 SG_ TCU_LupTrgtEngSpdVal : 0|8@1+ (10,500) [0|0] "rpm" Vector__XXX
 SG_ TCU_FrtStcShftSta : 0|2@1+ (1,0) [0|0] "" Vector__XXX
 SG_ TCU_IsgInhbtReq : 0|2@1+ (1,0) [0|0] "" Vector__XXX
 SG_ TCU_CdaInhbtReq : 0|2@1+ (1,0) [0|0] "" Vector__XXX
 SG_ TCU_BrkOnReq : 0|2@1+ (1,0) [0|0] "" Vector__XXX
 SG_ TCU_TqGrdntLimVal : 0|8@1+ (10,0) [0|0] "Nm/s" Vector__XXX
 SG_ YRS_YawRtVal : 0|16@1+ (0.005,-163.84) [0|0] "˚/s" Vector__XXX
 SG_ YRS_LatAccelVal : 0|16@1+ (0.000127465,-4.17677312) [0|0] "g" Vector__XXX
 SG_ YRS_LongAccelVal : 0|16@1+ (0.000127465,-4.17677312) [0|0] "g" Vector__XXX
 SG_ YRS_SnsrTempVal : 0|8@1+ (1,-68) [0|0] "℃" Vector__XXX
 SG_ YRS_ImuSeralNumVal : 0|48@1+ (1,0) [0|0] "" Vector__XXX
 SG_ DAU_Crc2Val : 0|8@1+ (1,0) [0|0] "" Vector__XXX
 SG_ DAU_AlvCnt2Val : 0|4@1+ (1,0) [0|0] "" Vector__XXX
 SG_ Mirror_OSMirFldOpt : 0|2@1+ (1,0) [0|0] "" Vector__XXX
 SG_ Mirror_OSMirFldSta : 0|2@1+ (1,0) [0|0] "" Vector__XXX
 SG_ Mirror_OSMirManualFldSta : 0|2@1+ (1,0) [0|0] "" Vector__XXX
 SG_ Mirror_OSMirFldCtrlSta : 0|2@1+ (1,0) [0|0] "" Vector__XXX
 SG_ Mirror_OSMirUnFldCtrlSta : 0|2@1+ (1,0) [0|0] "" Vector__XXX
 SG_ Mirror_LHOMUOSMirFldCtrlSta : 0|2@1+ (1,0) [0|0] "" Vector__XXX
 SG_ Mirror_RHOMUOSMirFldCtrlSta : 0|2@1+ (1,0) [0|0] "" Vector__XXX
 SG_ Mirror_LHOutDrTempSnsrVal : 0|8@1+ (1,0) [0|0] "" Vector__XXX
 SG_ DAU_Crc3Val : 0|8@1+ (1,0) [0|0] "" Vector__XXX
 SG_ DAU_AlvCnt3Val : 0|4@1+ (1,0) [0|0] "" Vector__XXX
 SG_ IMS_DrvrImsSwSetSta : 0|2@1+ (1,0) [0|0] "" Vector__XXX
 SG_ IMS_DrvrImsSw1Sta : 0|2@1+ (1,0) [0|0] "" Vector__XXX
 SG_ IMS_DrvrImsSw2Sta : 0|2@1+ (1,0) [0|0] "" Vector__XXX
 SG_ IMS_DrvrImsSwSmrtSta : 0|2@1+ (1,0) [0|0] "" Vector__XXX
 SG_ IMS_LHOSMirPlyBckSta : 0|3@1+ (1,0) [0|0] "" Vector__XXX
 SG_ DAU_Crc4Val : 0|8@1+ (1,0) [0|0] "" Vector__XXX
 SG_ DAU_AlvCnt4Val : 0|4@1+ (1,0) [0|0] "" Vector__XXX
 SG_ Window_AsstPwrWdwAutoSwSta : 0|2@1+ (1,0) [0|0] "" Vector__XXX
 SG_ Window_AsstPwrWdwUpSwSta : 0|2@1+ (1,0) [0|0] "" Vector__XXX
 SG_ Window_AsstPwrWdwDnSwSta : 0|2@1+ (1,0) [0|0] "" Vector__XXX
 SG_ Window_RrLftPwrWdwAutoSwSta : 0|2@1+ (1,0) [0|0] "" Vector__XXX
 SG_ Window_RrLftPwrWdwUpSwSta : 0|2@1+ (1,0) [0|0] "" Vector__XXX
 SG_ Window_RrLftPwrWdwDnSwSta : 0|2@1+ (1,0) [0|0] "" Vector__XXX
 SG_ Window_RrRtPwrWdwAutoSwSta : 0|2@1+ (1,0) [0|0] "" Vector__XXX
 SG_ Window_RrRtPwrWdwUpSwSta : 0|2@1+ (1,0) [0|0] "" Vector__XXX
 SG_ Window_RrRtPwrWdwDnSwSta : 0|2@1+ (1,0) [0|0] "" Vector__XXX
 SG_ Window_PwrWdwMaintainSta : 0|2@1+ (1,0) [0|0] "" Vector__XXX
 SG_ Window_PwrWdwMvInhbtSta : 0|2@1+ (1,0) [0|0] "" Vector__XXX
 SG_ YRS_Crc1Val : 0|16@1+ (1,0) [0|0] "" Vector__XXX
 SG_ YRS_AlvCnt1Val : 0|8@1+ (1,0) [0|0] "" Vector__XXX
 SG_ YRS_YawSigSta : 0|4@1+ (1,0) [0|0] "" Vector__XXX
 SG_ YRS_LatAccelSigSta : 0|4@1+ (1,0) [0|0] "" Vector__XXX
 SG_ YRS_LongAccelSigSta : 0|4@1+ (1,0) [0|0] "" Vector__XXX
 SG_ YRS_McuVoltSta : 0|4@1+ (1,0) [0|0] "" Vector__XXX
 SG_ YRS_AcuRstSta : 0|4@1+ (1,0) [0|0] "" Vector__XXX
 SG_ YRS_SnsrTyp : 0|4@1+ (1,0) [0|0] "" Vector__XXX
 SG_ HSWS_SysWrngSta_ICU : 0|2@1+ (1,0) [0|0] "" Vector__XXX
 SG_ HeatedSteerWheel_StrWhlHtrSwSta : 0|2@1+ (1,0) [0|0] "" Vector__XXX
 SG_ DriveTypeOption : 0|2@1+ (1,0) [0|0] "" Vector__XXX
 SG_ Warn_RrLftSBRMATSwSta : 0|2@1+ (1,0) [0|0] "" Vector__XXX
 SG_ Warn_RrRhtSBRMATSwSta : 0|2@1+ (1,0) [0|0] "" Vector__XXX
 SG_ StrWheelAutoHeatSta : 0|2@1+ (1,0) [0|0] "" Vector__XXX
 SG_ StrWheelHeatIndSta : 0|2@1+ (1,0) [0|0] "" Vector__XXX
 SG_ Warn_LftSEA : 0|2@1+ (1,0) [0|0] "" Vector__XXX
 SG_ Warn_RhtSEA : 0|2@1+ (1,0) [0|0] "" Vector__XXX
 SG_ Lamp_FootLampOnReq : 0|2@1+ (1,0) [0|0] "" Vector__XXX
 SG_ Lamp_MoodLampOnReq : 0|3@1+ (1,0) [0|0] "" Vector__XXX
 SG_ ICU_PowerAutoCutModSta : 0|2@1+ (1,0) [0|0] "" Vector__XXX
 SG_ ICU_SoCBattStaMsgReq : 0|2@1+ (1,0) [0|0] "" Vector__XXX
 SG_ DrvDrLockIND : 0|2@1+ (1,0) [0|0] "" Vector__XXX
 SG_ Brake_SwSta_ICU : 0|2@1+ (1,0) [0|0] "" Vector__XXX
 SG_ C_3rdRRSBRMatSw : 0|1@1+ (1,0) [0|0] "" Vector__XXX
 SG_ C_3rdRLSBRMatSw : 0|1@1+ (1,0) [0|0] "" Vector__XXX
 SG_ C_3rdRRSeatBeltSW : 0|1@1+ (1,0) [0|0] "" Vector__XXX
 SG_ C_3rdRLSeatBeltSW : 0|1@1+ (1,0) [0|0] "" Vector__XXX
 SG_ BCM_Crc9Val : 0|8@1+ (1,0) [0|0] "" Vector__XXX
 SG_ BCM_AlvCnt9Val : 0|4@1+ (1,0) [0|0] "" Vector__XXX
 SG_ Lamp_AutoLtSnsrNightSta : 0|2@1+ (1,0) [0|0] "" Vector__XXX
 SG_ Lamp_AutoLtSnsrHorVal : 0|10@1+ (1,0) [0|0] "" Vector__XXX
 SG_ ICU_Crc2Val : 0|8@1+ (1,0) [0|0] "" Vector__XXX
 SG_ ICU_AlvCnt2Val : 0|4@1+ (1,0) [0|0] "" Vector__XXX
 SG_ Autocut_DlvryModSta : 0|2@1+ (1,0) [0|0] "" Vector__XXX
 SG_ DoorLock_AsstDrUnLkSta : 0|2@1+ (1,0) [0|0] "" Vector__XXX
 SG_ Warn_DrvDrSwSta : 0|2@1+ (1,0) [0|0] "" Vector__XXX
 SG_ DoorLock_RrLftDrUnLkSta : 0|2@1+ (1,0) [0|0] "" Vector__XXX
 SG_ DoorLock_RrRtDrUnLkSta : 0|2@1+ (1,0) [0|0] "" Vector__XXX
 SG_ Warn_AsstDrSwSta : 0|2@1+ (1,0) [0|0] "" Vector__XXX
 SG_ Warn_AsstStBltSwSta : 0|2@1+ (1,0) [0|0] "" Vector__XXX
 SG_ Warn_BrkFldSwSta : 0|2@1+ (1,0) [0|0] "" Vector__XXX
 SG_ Warn_DrvStBltSwSta : 0|2@1+ (1,0) [0|0] "" Vector__XXX
 SG_ Warn_HoodSwSta : 0|2@1+ (1,0) [0|0] "" Vector__XXX
 SG_ Warn_PassStOccSta : 0|2@1+ (1,0) [0|0] "" Vector__XXX
 SG_ Warn_PrkngBrkSwSta : 0|2@1+ (1,0) [0|0] "" Vector__XXX
 SG_ Warn_RrCtrStBltSwSta : 0|2@1+ (1,0) [0|0] "" Vector__XXX
 SG_ Warn_RrLftDrSwSta : 0|2@1+ (1,0) [0|0] "" Vector__XXX
 SG_ Warn_RrLftStBltSwSta : 0|2@1+ (1,0) [0|0] "" Vector__XXX
 SG_ Warn_RrRtDrSwSta : 0|2@1+ (1,0) [0|0] "" Vector__XXX
 SG_ Warn_RrRtStBltSwSta : 0|2@1+ (1,0) [0|0] "" Vector__XXX
 SG_ Warn_HoodSwMemorySta : 0|2@1+ (1,0) [0|0] "" Vector__XXX
 SG_ Warn_WshrFldSwSta : 0|2@1+ (1,0) [0|0] "" Vector__XXX
 SG_ ICU_Crc5Val : 0|8@1+ (1,0) [0|0] "" Vector__XXX
 SG_ ICU_AlvCnt5Val : 0|4@1+ (1,0) [0|0] "" Vector__XXX
 SG_ Trunk_TrnkInReleaseSwSta : 0|2@1+ (1,0) [0|0] "" Vector__XXX
 SG_ Trunk_TrnkTlgtOutReleaseSwSta : 0|2@1+ (1,0) [0|0] "" Vector__XXX
 SG_ Trunk_TrnkTlgtSwSta : 0|2@1+ (1,0) [0|0] "" Vector__XXX
 SG_ Trunk_GlvBxTrnkLkSwSta : 0|2@1+ (1,0) [0|0] "" Vector__XXX
 SG_ Trunk_TlgtFullOpnSwSta : 0|2@1+ (1,0) [0|0] "" Vector__XXX
 SG_ Trunk_OpnDiagSetSta : 0|2@1+ (1,0) [0|0] "" Vector__XXX
 SG_ USM_OneTouchTrnSigFuncSta : 0|3@1+ (1,0) [0|0] "" Vector__XXX
 SG_ DoorLock_DrvDrUnLkSta : 0|2@1+ (1,0) [0|0] "" Vector__XXX
 SG_ DoorLock_LkOutSta : 0|2@1+ (1,0) [0|0] "" Vector__XXX
 SG_ Trunk_TrnkTlgtOpenOutput : 0|2@1+ (1,0) [0|0] "" Vector__XXX
 SG_ TwoTrnUnLkOptTyp : 0|2@1+ (1,0) [0|0] "" Vector__XXX
 SG_ Defog_DfgrRlySta : 0|2@1+ (1,0) [0|0] "" Vector__XXX
 SG_ SEA_ActvSta : 0|2@1+ (1,0) [0|0] "" Vector__XXX
 SG_ ChildLock_ActnFlSta : 0|2@1+ (1,0) [0|0] "" Vector__XXX
 SG_ USM_AutoDrLkReq : 0|3@1+ (1,0) [0|0] "" Vector__XXX
 SG_ USM_AutoDrUnLkReq : 0|3@1+ (1,0) [0|0] "" Vector__XXX
 SG_ USM_TwoTrnUnLkCurrentSta : 0|2@1+ (1,0) [0|0] "" Vector__XXX
 SG_ HWSW_SysSta : 0|2@1+ (1,0) [0|0] "" Vector__XXX
 SG_ SCM_PlyBckSta : 0|3@1+ (1,0) [0|0] "" Vector__XXX
 SG_ USM_CmdSta : 0|2@1+ (1,0) [0|0] "" Vector__XXX
 SG_ SCM_HptWrngUSMSta : 0|3@1+ (1,0) [0|0] "" Vector__XXX
 SG_ AVH_Sta : 0|2@1+ (1,0) [0|0] "" Vector__XXX
 SG_ LDM_Sta : 0|2@1+ (1,0) [0|0] "" Vector__XXX
 SG_ EPB_ActvReq : 0|2@1+ (1,0) [0|0] "" Vector__XXX
 SG_ EPB_StaReq : 0|2@1+ (1,0) [0|0] "" Vector__XXX
 SG_ ECD_ActvSta : 0|2@1+ (1,0) [0|0] "" Vector__XXX
 SG_ AVH_CluDis : 0|8@1+ (1,0) [0|0] "" Vector__XXX
 SG_ AVH_AlrmReq : 0|2@1+ (1,0) [0|0] "" Vector__XXX
 SG_ AVH_ActvStaLmpDis : 0|2@1+ (1,0) [0|0] "" Vector__XXX
 SG_ AVH_LmpDis : 0|3@1+ (1,0) [0|0] "" Vector__XXX
 SG_ AWD_CrdnShftTqLimVal : 0|16@1+ (1,0) [0|0] "Nm" Vector__XXX
 SG_ AWD_CltchDtyLimVal : 0|8@1+ (0.390625,0) [0|0] "%" Vector__XXX
 SG_ AWD_TransmsnTqLimModSta : 0|2@1+ (1,0) [0|0] "" Vector__XXX
 SG_ AWD_RrWhlDtyLimReq : 0|2@1+ (1,0) [0|0] "" Vector__XXX
 SG_ AWD_FastOpnCrdnShftCltchReq : 0|2@1+ (1,0) [0|0] "" Vector__XXX
 SG_ DATC_Crc12Val : 0|16@1+ (1,0) [0|0] "" Vector__XXX
 SG_ DATC_AlvCnt12Val : 0|8@1+ (1,0) [0|0] "" Vector__XXX
 SG_ DATC_StrWhlHtrSwReq : 0|2@1+ (1,0) [0|0] "" Vector__XXX
 SG_ DATC_FRStHtrSwReq : 0|2@1+ (1,0) [0|0] "" Vector__XXX
 SG_ DATC_FRStVentSwReq : 0|2@1+ (1,0) [0|0] "" Vector__XXX
 SG_ DATC_FLStOpReq : 0|4@1+ (1,0) [0|0] "" Vector__XXX
 SG_ DATC_FLStHtrSwReq : 0|2@1+ (1,0) [0|0] "" Vector__XXX
 SG_ DATC_FLStVentSwReq : 0|2@1+ (1,0) [0|0] "" Vector__XXX
 SG_ DATC_RRStHtrSwReq : 0|2@1+ (1,0) [0|0] "" Vector__XXX
 SG_ DATC_RRStVentSwReq : 0|2@1+ (1,0) [0|0] "" Vector__XXX
 SG_ DATC_RLStHtrSwReq : 0|2@1+ (1,0) [0|0] "" Vector__XXX
 SG_ DATC_RLStVentSwReq : 0|2@1+ (1,0) [0|0] "" Vector__XXX
 SG_ TCS_DisableSta : 0|2@1+ (1,0) [0|0] "" Vector__XXX
 SG_ TCS_DfctvSta : 0|2@1+ (1,0) [0|0] "" Vector__XXX
 SG_ TCS_CtrlSta : 0|2@1+ (1,0) [0|0] "" Vector__XXX
 SG_ ESC_DisableSta : 0|2@1+ (1,0) [0|0] "" Vector__XXX
 SG_ ESC_DfctvSta : 0|2@1+ (1,0) [0|0] "" Vector__XXX
 SG_ ESC_CtrlSta : 0|2@1+ (1,0) [0|0] "" Vector__XXX
 SG_ TCS_PreActvSta : 0|2@1+ (1,0) [0|0] "" Vector__XXX
 SG_ DBC_StdbySta : 0|2@1+ (1,0) [0|0] "" Vector__XXX
 SG_ DBC_DfctvSta : 0|2@1+ (1,0) [0|0] "" Vector__XXX
 SG_ DBC_CtrlSta : 0|2@1+ (1,0) [0|0] "" Vector__XXX
 SG_ HAC_StdbySta : 0|2@1+ (1,0) [0|0] "" Vector__XXX
 SG_ HAC_DfctvSta : 0|2@1+ (1,0) [0|0] "" Vector__XXX
 SG_ HAC_CtrlSta : 0|2@1+ (1,0) [0|0] "" Vector__XXX
 SG_ TCS_Req : 0|2@1+ (1,0) [0|0] "" Vector__XXX
 SG_ MSR_FuncReq : 0|2@1+ (1,0) [0|0] "" Vector__XXX
 SG_ TCS_GearShftCharacteristicVal : 0|2@1+ (1,0) [0|0] "" Vector__XXX
 SG_ TCS_ManufacturerVal : 0|2@1+ (1,0) [0|0] "" Vector__XXX
 SG_ TCS_TqIntrvntnVal : 0|8@1+ (0.390625,0) [0|0] "%" Vector__XXX
 SG_ MSR_TqIntrvntnVal : 0|8@1+ (0.390625,0) [0|0] "%" Vector__XXX
 SG_ TCS_SlwTqIntrvntnVal : 0|8@1+ (0.390625,0) [0|0] "%" Vector__XXX
 SG_ RL_SHVU_HtSwHiIndSta : 0|2@1+ (1,0) [0|0] "" Vector__XXX
 SG_ RL_SHVU_HtSwMidIndSta : 0|2@1+ (1,0) [0|0] "" Vector__XXX
 SG_ RL_SHVU_HtSwLowIndSta : 0|2@1+ (1,0) [0|0] "" Vector__XXX
 SG_ RL_SHVU_VntSwHiIndSta : 0|2@1+ (1,0) [0|0] "" Vector__XXX
 SG_ RL_SHVU_VntSwMidIndSta : 0|2@1+ (1,0) [0|0] "" Vector__XXX
 SG_ RL_SHVU_VntSwLowIndSta : 0|2@1+ (1,0) [0|0] "" Vector__XXX
 SG_ ESC_CylPrsrVal : 0|12@1+ (0.1,0) [0|0] "Bar" Vector__XXX
 SG_ ESC_CylPrsrSta : 0|2@1+ (1,0) [0|0] "" Vector__XXX
 SG_ ESC_CylPrsrDiagSta : 0|2@1+ (1,0) [0|0] "" Vector__XXX
 SG_ ESC_CylPrsrFlagSta : 0|2@1+ (1,0) [0|0] "" Vector__XXX
 SG_ ESC_VsmActvSta : 0|2@1+ (1,0) [0|0] "" Vector__XXX
 SG_ ESC_VsmDfctvSta : 0|2@1+ (1,0) [0|0] "" Vector__XXX
 SG_ ESC_VsmCtrlModSta : 0|3@1+ (1,0) [0|0] "" Vector__XXX
 SG_ ESC_StrTqReq : 0|12@1+ (0.01,-20.48) [0|0] "Nm" Vector__XXX
 SG_ ESC_LongAccelOffstCalibPrmtr : 0|9@1+ (0.001,-0.255) [0|0] "g" Vector__XXX
 SG_ RR_SHVU_HtSwHiIndSta : 0|2@1+ (1,0) [0|0] "" Vector__XXX
 SG_ RR_SHVU_HtSwMidIndSta : 0|2@1+ (1,0) [0|0] "" Vector__XXX
 SG_ RR_SHVU_HtSwLowIndSta : 0|2@1+ (1,0) [0|0] "" Vector__XXX
 SG_ RR_SHVU_VntSwHiIndSta : 0|2@1+ (1,0) [0|0] "" Vector__XXX
 SG_ RR_SHVU_VntSwMidIndSta : 0|2@1+ (1,0) [0|0] "" Vector__XXX
 SG_ RR_SHVU_VntSwLowIndSta : 0|2@1+ (1,0) [0|0] "" Vector__XXX
 SG_ RLPSU_ReclMtrPos : 0|3@1+ (1,0) [0|0] "" Vector__XXX
 SG_ ESC_Crc1Val : 0|16@1+ (1,0) [0|0] "" Vector__XXX
 SG_ ESC_AlvCnt1Val : 0|8@1+ (1,0) [0|0] "" Vector__XXX
 SG_ ABS_WrngLmpSta : 0|2@1+ (1,0) [0|0] "" Vector__XXX
 SG_ ABS_DfctvSta : 0|2@1+ (1,0) [0|0] "" Vector__XXX
 SG_ ABS_ActvSta : 0|2@1+ (1,0) [0|0] "" Vector__XXX
 SG_ ABS_DiagSta : 0|2@1+ (1,0) [0|0] "" Vector__XXX
 SG_ EBD_WrngLmpSta : 0|2@1+ (1,0) [0|0] "" Vector__XXX
 SG_ EBD_DfctvSta : 0|2@1+ (1,0) [0|0] "" Vector__XXX
 SG_ ESC_BrkLtActvSta : 0|2@1+ (1,0) [0|0] "" Vector__XXX
 SG_ ESS_Sta : 0|2@1+ (1,0) [0|0] "" Vector__XXX
 SG_ TCS_LmpSta : 0|2@1+ (1,0) [0|0] "" Vector__XXX
 SG_ TCS_OffLmpSta : 0|2@1+ (1,0) [0|0] "" Vector__XXX
 SG_ ESC_OffTempSta : 0|2@1+ (1,0) [0|0] "" Vector__XXX
 SG_ DBC_WrngLmpSta : 0|2@1+ (1,0) [0|0] "" Vector__XXX
 SG_ DBC_FuncLmpSta : 0|2@1+ (1,0) [0|0] "" Vector__XXX
 SG_ ESC_BrkCtrlSta : 0|2@1+ (1,0) [0|0] "" Vector__XXX
 SG_ RRPSU_ReclMtrPos : 0|3@1+ (1,0) [0|0] "" Vector__XXX
 SG_ BCM_Crc10Val : 0|8@1+ (1,0) [0|0] "" Vector__XXX
 SG_ BCM_AlvCnt10Val : 0|4@1+ (1,0) [0|0] "" Vector__XXX
 SG_ Wiper_PrkngPosSta : 0|2@1+ (1,0) [0|0] "" Vector__XXX
 SG_ Wiper_RainSnsrOptionTyp : 0|2@1+ (1,0) [0|0] "" Vector__XXX
 SG_ Wiper_RainSnsrSta : 0|4@1+ (1,0) [0|0] "" Vector__XXX
 SG_ BCM_SolSnsrRtOutVoltVal : 0|8@1+ (1,0) [0|0] "" Vector__XXX

CM_ SG_ 3221225472 SCR_SysErrMsgDis "SCR_SystemErrorMessageDisplay ##2G##EMS - EMS21 - SCR_SYS_ERROR_WARN";
CM_ SG_ 3221225472 SCR_SysWrngLmpReq "SCR_SystemWarningLampRequest ##2G##EMS - EMS21 - SCR_SYSTEM_WARN_LAMP";
CM_ SG_ 3221225472 SCR_IndcmtExitStaDis "SCR_InducementExitConditionDisplay ##2G##EMS - EMS21 - SCR_INDUCEMENT_EXIT_COND";
CM_ SG_ 3221225472 SCR_UreaLvlSta "SCR_UreaLevelStatus ##2G##EMS - EMS21 - SCR_UREA_LEVEL";
CM_ SG_ 3221225472 SCR_RmnRstrtDis "SCR_RemainingRestartsDisplay ##2G##EMS - EMS21 - SCR_NO_REMAINING_RESTARTS";
CM_ SG_ 3221225472 SCR_RmnDstDis "SCR_RemainingDistanceDisplay ##2G##EMS - EMS21 - SCR_REMAINING_DISTANCE";
CM_ SG_ 3221225472 ENG_TransmsnTyp "ENG_TransmissionType";
CM_ SG_ 3221225472 ENG_EngDsplceTyp "ENG_EngineDisplacementType ##2G##EMS - EMS12 - ENG_VOL";
CM_ SG_ 3221225472 EMS_Crc5Val "EMS_CyclicRedundancyCheck5Value";
CM_ SG_ 3221225472 EMS_AlvCnt5Val "EMS_AliveCounter5Value";
CM_ SG_ 3221225472 ENG_ImmoLmpSta "ENG_ImmobilizerLampStatus ##2G##EMS - EMS14 - IMMO_LAMP_STAT";
CM_ SG_ 3221225472 ENG_MilSta "ENG_MalfunctionIndicationLampStatus ##2G##EMS - EMS14 - L_MIL";
CM_ SG_ 3221225472 ENG_ImmoSta "ENG_ImmobilizerStatus ##2G##EMS - EMS14 - IM_STAT";
CM_ SG_ 3221225472 OBD_RbmInhbtSta "OBD_RateBasedMonitoringInhibitionStatus ##2G##EMS - EMS15 - INH_DC_OBD";
CM_ SG_ 3221225472 ENG_AtmsphPrsrVal "ENG_AtmosphericPressureValue ##2G##EMS - EMS14 - AMP_CAN";
CM_ SG_ 3221225472 ENG_AltFdbckLoadVal "ENG_AlternatorFeedbackLoadValue ##2G##EMS - EMS14 - BAT_Alt_FR_Duty";
CM_ SG_ 3221225472 ENG_BattVoltVal "ENG_BatteryVoltageValue ##2G##EMS - EMS14 - VB";
CM_ SG_ 3221225472 ENG_FuelTempVal "ENG_FuelTemperatureValue ##2G##EMS - EMS14 - TEMP_FUEL";
CM_ SG_ 3221225472 TCU_Crc1Val "TCU_CyclicRedundancyCheck1Value";
CM_ SG_ 3221225472 TCU_AlvCnt1Val "TCU_AliveCounter1Value";
CM_ SG_ 3221225472 TCU_GearSlctDis "TCU_GearSelectDisplay";
CM_ SG_ 3221225472 TCU_Typ "TCU_Type";
CM_ SG_ 3221225472 TCU_TqRdctnVal "TCU_TorqueReductionValue";
CM_ SG_ 3221225472 TCU_GearStepTyp "TCU_GearStepType";
CM_ SG_ 3221225472 TCU_GearShftSta "TCU_GearShiftStatus";
CM_ SG_ 3221225472 TCU_TqCnvrtrSta "TCU_TorqueConverterStatus";
CM_ SG_ 3221225472 ENG_EngTyp4 "ENG_EngineType4";
CM_ SG_ 3221225472 ENG_EngTyp3 "ENG_EngineType3";
CM_ SG_ 3221225472 ENG_EngTyp2 "ENG_EngineType2 ##2G##EMS - EMS23 - ENG_TYPE";
CM_ SG_ 3221225472 ENG_EngTyp1 "ENG_EngineType1 ##2G##EMS - EMS12 - ENG_CHR";
CM_ SG_ 3221225472 ENG_S_F "AMS/ISG system type indicator";
CM_ SG_ 3221225472 ENG_S_F_GEN "system generation type indicator";
CM_ SG_ 3221225472 ENG_TqStndValExt "ENG_TorqueStandardValue (Extended signal) ##2G##EMS - EMS12 - TQ_STND";
CM_ SG_ 3221225472 TCU_CurrGearSta "TCU_CurrentGearStatus";
CM_ SG_ 3221225472 TCU_TrgtGearSta "TCU_TargetGearStatus";
CM_ SG_ 3221225472 TCU_CluTrgtGearSta "TCU_ClusterTargetGear";
CM_ SG_ 3221225472 TCH_EngTrgtGearSta "TCU_EngineTargetGear";
CM_ SG_ 3221225472 TCU_EngTqLimVal "TCU_EngineTorqueLimitValue";
CM_ SG_ 3221225472 TCU_VehSpdKphVal "TCU_VehicleSpeedKphValue";
CM_ SG_ 3221225472 TCU_DcmlVehSpdKphVal "TCU_VehicleSpeedDecimalKphValue";
CM_ SG_ 3221225472 TCU_SprkRtrdReq "TCU_SparkRetardAngleValue";
CM_ SG_ 3221225472 TCU_EngRpmDisSta "TCU_EngineRpmDisplayStatus";
CM_ SG_ 3221225472 TCU_GearLmpBlnkngReq "TCU_GearLampBlinkingRequest";
CM_ SG_ 3221225472 TCU_FuelCutInhbtReq "TCU_FuelCutInhibitionRequest";
CM_ SG_ 3221225472 TCU_IdleUpReq "TCU_IdleUpRequest";
CM_ SG_ 3221225472 TCU_EngRpmDis "TCU_EngineRpmDisplay";
CM_ SG_ 3221225472 TCU_SlpVal "TCU_SlopeValue";
CM_ SG_ 3221225472 TCU_EngSpdIncReq "TCU_EngineSpeedIncreaseRequest";
CM_ SG_ 3221225472 TCU_ObdSta "TCU_ObdStatus";
CM_ SG_ 3221225472 TCU_SprtyIndxSta "TCU_SportyIndexStatus";
CM_ SG_ 3221225472 TCU_DrvngModDis "TCU_DrivingModeDisplay";
CM_ SG_ 3221225472 TCU_DrvngModReq "TCU_DrivingModeRequest";
CM_ SG_ 3221225472 TCU_SmrtShftSta "TCU_SmartShiftStatus";
CM_ SG_ 3221225472 TCU_LupTrgtEngSpdVal "TCU_LupTargetEngineSpeedValue";
CM_ SG_ 3221225472 TCU_FrtStcShftSta "TCU_FirstStaticShiftStatus";
CM_ SG_ 3221225472 TCU_IsgInhbtReq "TCU_IsgInhibitRequest";
CM_ SG_ 3221225472 TCU_CdaInhbtReq "TCU_CdaInhibitRequest";
CM_ SG_ 3221225472 TCU_BrkOnReq "TCU_BrakeOnRequest";
CM_ SG_ 3221225472 TCU_TqGrdntLimVal "TCU_TorqueGradientLimitationValue";
CM_ SG_ 3221225472 YRS_YawRtVal "YRS_YawRateValue ##2G##YRS - YRS11 - CR_Yrs_Yr";
CM_ SG_ 3221225472 YRS_LatAccelVal "YRS_LateralAccelerationValue ##2G##YRS - YRS11 - CR_Yrs_LatAc";
CM_ SG_ 3221225472 YRS_LongAccelVal "YRS_LongitudinalAccelerationValue ##2G##YRS - YRS12 - CR_Yrs_LongAc";
CM_ SG_ 3221225472 YRS_SnsrTempVal "YRS_SensorTemperatureValue ##2G##YRS - YRS12 - YRS_Temp";
CM_ SG_ 3221225472 YRS_ImuSeralNumVal "YRS_ImuSerialNumberValue ##2G##YRS - YRS13 - YRS_SeralNo";
CM_ SG_ 3221225472 DAU_Crc2Val "DAU_CyclicRedundancyCheck2Value";
CM_ SG_ 3221225472 DAU_AlvCnt2Val "DAU_AliveCounter2Value";
CM_ SG_ 3221225472 Mirror_OSMirFldOpt "Mirror_OutSideMirrorFoldOption ##2G##DDM -  - C_OSMirrFoldOption";
CM_ SG_ 3221225472 Mirror_OSMirFldSta "Mirror_OutSideMirrorFoldStatus ##2G##DDM -  - C_OSMirrorFoldState";
CM_ SG_ 3221225472 Mirror_OSMirManualFldSta "Mirror_OutSideMirrorManualFoldStatus ##2G##DDM -  - C_OSMirrFoldSwStateDDM";
CM_ SG_ 3221225472 Mirror_OSMirFldCtrlSta "Mirror_OutSideMirrorFoldControlStatus";
CM_ SG_ 3221225472 Mirror_OSMirUnFldCtrlSta "Mirror_OutSideMirrorUnfoldControlStatus";
CM_ SG_ 3221225472 Mirror_LHOMUOSMirFldCtrlSta "Mirror_OutSideMirrorFoldControlStatus_LHOMU";
CM_ SG_ 3221225472 Mirror_RHOMUOSMirFldCtrlSta "Mirror_OutSideMirrorFoldControlStatus_RHOMU";
CM_ SG_ 3221225472 Mirror_LHOutDrTempSnsrVal "Mirror_DriverOutDoorTemperatureSensorValue ##2G##DDM -  - C_MirrOutTempSnsDrv";
CM_ SG_ 3221225472 DAU_Crc3Val "DAU_CyclicRedundancyCheck3Value";
CM_ SG_ 3221225472 DAU_AlvCnt3Val "DAU_AliveCounter3Value";
CM_ SG_ 3221225472 IMS_DrvrImsSwSetSta "IMS_DrvrImsSwSetStatus ##2G##DDM -  - C_DrvIMSSWSet";
CM_ SG_ 3221225472 IMS_DrvrImsSw1Sta "IMS_DrvrImsSw1Status ##2G##DDM -  - C_DrvIMSSW1";
CM_ SG_ 3221225472 IMS_DrvrImsSw2Sta "IMS_DrvrImsSw2Status ##2G##DDM -  - C_DrvIMSSW2";
CM_ SG_ 3221225472 IMS_DrvrImsSwSmrtSta "IMS_DrvrImsSwSmartStatus ##2G##DDM -  - C_HCIMSSW";
CM_ SG_ 3221225472 IMS_LHOSMirPlyBckSta "IMS_DriverOutSideMirrorPlayBackStatus ##2G##DDM -  - C_DDMPBACKState";
CM_ SG_ 3221225472 DAU_Crc4Val "DAU_CyclicRedundancyCheck4Value";
CM_ SG_ 3221225472 DAU_AlvCnt4Val "DAU_AliveCounter4Value";
CM_ SG_ 3221225472 Window_AsstPwrWdwAutoSwSta "Window_AssistPowerWindowAutoSwitchStatus ##2G##DDM -  - C_AstPwdwAutoSwDDM";
CM_ SG_ 3221225472 Window_AsstPwrWdwUpSwSta "Window_AssistantPowerWindowUpSwitchStatus ##2G##DDM -  - C_AstPwdwUpSwDDM";
CM_ SG_ 3221225472 Window_AsstPwrWdwDnSwSta "Window_AssistantPowerWindowDownSwitchStatus ##2G##DDM -  - C_AstPwdwDnSwDDM";
CM_ SG_ 3221225472 Window_RrLftPwrWdwAutoSwSta "Window_RearLeftPowerWindowAutoSwitchStatus ##2G##DDM -  - C_RLPwdwAutoSwDDM";
CM_ SG_ 3221225472 Window_RrLftPwrWdwUpSwSta "Window_RearLeftPowerWindowUpSwitchStatus ##2G##DDM -  - C_RLPwdwUpSwDDM";
CM_ SG_ 3221225472 Window_RrLftPwrWdwDnSwSta "Window_RearLeftPowerWindowDownSwitchStatus ##2G##DDM -  - C_RLPwdwDnSwDDM";
CM_ SG_ 3221225472 Window_RrRtPwrWdwAutoSwSta "Window_RearRightPowerWindowAutoSwitchStatus ##2G##DDM -  - C_RRPwdwAutoSwDDM";
CM_ SG_ 3221225472 Window_RrRtPwrWdwUpSwSta "Window_RearRightPowerWindowUpSwitchStatus ##2G##DDM -  - C_RRPwdwUpSwDDM";
CM_ SG_ 3221225472 Window_RrRtPwrWdwDnSwSta "Window_RearRightPowerWindowDownSwitchStatus ##2G##DDM -  - C_RRPwdwDnSwDDM";
CM_ SG_ 3221225472 Window_PwrWdwMaintainSta "Window_DriverPowerWindowMaintainStatus ##2G##DDM -  - C_PwdwMaintain";
CM_ SG_ 3221225472 Window_PwrWdwMvInhbtSta "Window_PowerWindowMoveInhibitStatus ##2G##DDM -  - C_PwdwInhibit";
CM_ SG_ 3221225472 YRS_Crc1Val "YRS_CyclicRedundancyCheck1Value";
CM_ SG_ 3221225472 YRS_AlvCnt1Val "YRS_AliveCounter1Value";
CM_ SG_ 3221225472 YRS_YawSigSta "YRS_YawSignalStatus ##2G##YRS - YRS11 - CF_Yrs_YrStat";
CM_ SG_ 3221225472 YRS_LatAccelSigSta "YRS_LateralAccelerationSignalStatus ##2G##YRS - YRS11 - CF_Yrs_LatAcStat";
CM_ SG_ 3221225472 YRS_LongAccelSigSta "YRS_LongitudinalAccelerationSignalStatus ##2G##YRS - YRS12 - CF_Yrs_LongAcStat";
CM_ SG_ 3221225472 YRS_McuVoltSta "YRS_McuVoltageStatus ##2G##YRS - YRS11 - CF_Yrs_MCUStat";
CM_ SG_ 3221225472 YRS_AcuRstSta "YRS_AcuResetStatus ##2G##YRS - YRS12 - CF_IMU_ResetStat";
CM_ SG_ 3221225472 YRS_SnsrTyp "YRS_SensorType ##2G##YRS - YRS12 - CF_Yrs_Type";
CM_ SG_ 3221225472 HSWS_SysWrngSta_ICU "HSWS Status ##2G## -  - C_HSWSSysStat";
CM_ SG_ 3221225472 HeatedSteerWheel_StrWhlHtrSwSta "Use for Telematics Remote Heating Control ##2G## -  - C_StrgWhlHeatedState";
CM_ SG_ 3221225472 DriveTypeOption "##2G## -  - C_DriveTypeOption,CF_Gway_DriveTypeOption";
CM_ SG_ 3221225472 Warn_RrLftSBRMATSwSta "##2G## -  - C_RLSBRMatSw";
CM_ SG_ 3221225472 Warn_RrRhtSBRMATSwSta "##2G## -  - C_RRSBRMatSw";
CM_ SG_ 3221225472 StrWheelAutoHeatSta "##2G## -  - C_StrWheelAutoHeatRValue";
CM_ SG_ 3221225472 StrWheelHeatIndSta "##2G## -  - C_StrgWhlHeatedInd";
CM_ SG_ 3221225472 Warn_LftSEA "##2G## -  - CF_ICU_SeaWarn_Lh";
CM_ SG_ 3221225472 Warn_RhtSEA "##2G## -  - CF_ICU_SeaWarn_Rh";
CM_ SG_ 3221225472 Lamp_FootLampOnReq "##2G## -  - C_FootLpOn";
CM_ SG_ 3221225472 Lamp_MoodLampOnReq "##2G## -  - C_MoodLpOn";
CM_ SG_ 3221225472 ICU_PowerAutoCutModSta "##2G## -  - CF_Gway_ICUPowerAutoCutMode";
CM_ SG_ 3221225472 ICU_SoCBattStaMsgReq "##2G## -  - Batt_SoCWarningAlertMsgReq";
CM_ SG_ 3221225472 DrvDrLockIND "Driver door lock indicator on/off signal";
CM_ SG_ 3221225472 Brake_SwSta_ICU "Brake Switch Status ##2G## -  - C_BrakeSw";
CM_ SG_ 3221225472 C_3rdRRSeatBeltSW "3rd Rear Right Seat Belt Switch Status";
CM_ SG_ 3221225472 C_3rdRLSeatBeltSW "3rd Rear Left Seat Belt Switch Status";
CM_ SG_ 3221225472 BCM_Crc9Val "BCM_CyclicRedundancyCheck9Value";
CM_ SG_ 3221225472 BCM_AlvCnt9Val "BCM_AliveCounter9Value";
CM_ SG_ 3221225472 Lamp_AutoLtSnsrNightSta "Lamp_AutoLightSensorNightStatus ##2G##BCM - BCMmsg24 - C_AutolightValue";
CM_ SG_ 3221225472 Lamp_AutoLtSnsrHorVal "Lamp_AutoLightSensorHorValue ##2G##BCM - BCMmsg24 - C_AutolightSensorHorState";
CM_ SG_ 3221225472 ICU_Crc2Val "ICU_CyclicRedundancyCheck2Value";
CM_ SG_ 3221225472 ICU_AlvCnt2Val "ICU_AliveCounter2Value";
CM_ SG_ 3221225472 Autocut_DlvryModSta "Autocut_DeliveryModeStatus ##2G## -  - C_SJBDeliveryMode,CF_Gway_SJBDeliveryMode";
CM_ SG_ 3221225472 DoorLock_AsstDrUnLkSta "DoorLock_AssistDoorUnLockStatus ##2G## -  - C_AstUnlockState,DoorLock_AsstDrUnLkSta";
CM_ SG_ 3221225472 Warn_DrvDrSwSta "DoorLock_DriverDoorSwitchStatus ##2G## -  - C_DrvDrSw,CF_Gway_DrvDrSw,Warn_DrvDrSwSta";
CM_ SG_ 3221225472 DoorLock_RrLftDrUnLkSta "DoorLock_RearLeftDoorUnLockStatus ##2G## -  - C_RLUnlockState,DoorLock_RrLftDrUnLkSta";
CM_ SG_ 3221225472 DoorLock_RrRtDrUnLkSta "DoorLock_RearRightDoorUnLockStatus ##2G## -  - C_RRUnlockState,DoorLock_RrRtDrUnLkSta";
CM_ SG_ 3221225472 Warn_AsstDrSwSta "Warn_AssistDoorSwitchStatus ##2G## -  - C_AstDrSw,CF_Gway_AstDrSw,Warn_AsstDrSwSta";
CM_ SG_ 3221225472 Warn_AsstStBltSwSta "Warn_AssistSeatBeltSwitchStatus ##2G## -  - C_AstSeatBeltSw,CF_Gway_AstSeatBeltSw";
CM_ SG_ 3221225472 Warn_BrkFldSwSta "Warn_BrakeFluidSwitchStatus ##2G## -  - C_BrakeFluidSw,CF_Gway_BrakeFluidSw";
CM_ SG_ 3221225472 Warn_DrvStBltSwSta "Warn_DriverSeatbeltSwitchStatus ##2G## -  - C_DrvSeatBeltSw,CF_Gway_DrvSeatBeltSw";
CM_ SG_ 3221225472 Warn_HoodSwSta "Warn_HoodSwitchStatus ##2G## -  - C_HoodSw,CF_Gway_HoodSw";
CM_ SG_ 3221225472 Warn_PassStOccSta "Warn_PassengerSeatOccupyStatus ##2G## -  - C_SBRMatSw";
CM_ SG_ 3221225472 Warn_PrkngBrkSwSta "Warn_ParkingBrakeSwitchStatus ##2G## -  - C_ParkBrakeSw";
CM_ SG_ 3221225472 Warn_RrCtrStBltSwSta "Warn_RearCenterSeatBeltSwitchStatus ##2G## -  - C_RCSeatBeltSw";
CM_ SG_ 3221225472 Warn_RrLftDrSwSta "Warn_RearLeftDoorSwitchStatus ##2G## -  - C_RLDrSw,CF_Gway_RLDrSw,Warn_RrLftDrSwSta";
CM_ SG_ 3221225472 Warn_RrLftStBltSwSta "Warn_RearLeftSeatBeltSwitchStatus ##2G## -  - C_RLSeatBeltSw";
CM_ SG_ 3221225472 Warn_RrRtDrSwSta "Warn_RearRightDoorSwitchStatus ##2G## -  - C_RRDrSw,CF_Gway_RRDrSw,Warn_RrRtDrSwSta";
CM_ SG_ 3221225472 Warn_RrRtStBltSwSta "Warn_RearRightSeatBeltSwitchStatus ##2G## -  - C_RRSeatBeltSw";
CM_ SG_ 3221225472 Warn_HoodSwMemorySta "Warn_HoodSwitchMemoryStatus ##2G## -  - CF_Hoodsw_memory,C_HoodSwMemory";
CM_ SG_ 3221225472 Warn_WshrFldSwSta "Washer Fluid Switch Signal ##2G## -  - CF_Gway_WasherFluidSw";
CM_ SG_ 3221225472 ICU_Crc5Val "ICU_CyclicRedundancyCheck5Value";
CM_ SG_ 3221225472 ICU_AlvCnt5Val "ICU_AliveCounter5Value";
CM_ SG_ 3221225472 Trunk_TrnkInReleaseSwSta "Trunk_TrunkInnerReleaseSwitchStatus ##2G## -  - C_TrunkInnerReleaseSw";
CM_ SG_ 3221225472 Trunk_TrnkTlgtOutReleaseSwSta "Trunk_TrunkTailgateOutReleaseSwitchStatus ##2G## -  - C_TrunkTgOtrReleaseSW";
CM_ SG_ 3221225472 Trunk_TrnkTlgtSwSta "Trunk_TrunkTailgateSwitchStatus ##2G## -  - C_TrunkTgSw,CF_Gway_TrunkTgSw,Trunk_TrnkTlgtSwSta";
CM_ SG_ 3221225472 Trunk_GlvBxTrnkLkSwSta "Trunk_GloveBoxTrunkLockSwitchStatus ##2G## -  - C_GloveBoxTrunkLockSw";
CM_ SG_ 3221225472 Trunk_TlgtFullOpnSwSta "Trunk_TailGateFullOpenSwitchStatus ##2G## -  - C_TgFullOpenSW";
CM_ SG_ 3221225472 Trunk_OpnDiagSetSta "Trunk_OpenDiagnosticSettingStatus ##2G## -  - C_TrunkOpenDiagSet";
CM_ SG_ 3221225472 USM_OneTouchTrnSigFuncSta "USM_OneTouchTurnSignalFunctionStatus ##2G## -  - CF_Gway_OTTurnRValue,C_OTTurnRValue";
CM_ SG_ 3221225472 DoorLock_DrvDrUnLkSta "DoorLock_DriverDoorUnLockStatus ##2G## -  - C_DrvUnlockState,CF_Gway_DrvUnlockState";
CM_ SG_ 3221225472 DoorLock_LkOutSta "DoorLock_LockOutputStatus ##2G## -  - C_LockUnlockOutState";
CM_ SG_ 3221225472 Trunk_TrnkTlgtOpenOutput "Trunk_TrunkTailgateOpenOutput";
CM_ SG_ 3221225472 TwoTrnUnLkOptTyp "USM_TwoTurnUnlockOptionType ##2G## -  - C_TTUnlockOption";
CM_ SG_ 3221225472 Defog_DfgrRlySta "Defog_DefoggerRelayStatus ##2G## -  - C_DefoggerRly,CF_Gway_DefoggerRly";
CM_ SG_ 3221225472 SEA_ActvSta "SEA_ActivationStatus ##2G## -  - C_SEAActivated";
CM_ SG_ 3221225472 ChildLock_ActnFlSta "ChildLock_ActuationFailedStatus ##2G## -  - C_ChildLockFail";
CM_ SG_ 3221225472 USM_AutoDrLkReq "USM_AutoDoorLockRequest ##2G## -  - CF_Gway_ADrLRValue";
CM_ SG_ 3221225472 USM_AutoDrUnLkReq "USM_AutoDoorUnLockRequest ##2G## -  - CF_Gway_ADrURValue";
CM_ SG_ 3221225472 USM_TwoTrnUnLkCurrentSta "USM_TwoTurnUnlockCurrentStatus ##2G## -  - CF_Gway_TTUnlockRValue";
CM_ SG_ 3221225472 HWSW_SysSta "HWSW_SystemStatus";
CM_ SG_ 3221225472 SCM_PlyBckSta "SCM_PlayBackStatus";
CM_ SG_ 3221225472 USM_CmdSta "USM_CommandStatus";
CM_ SG_ 3221225472 SCM_HptWrngUSMSta "USM function for selecting HAPTIC WARNING strength";
CM_ SG_ 3221225472 AVH_Sta "AVH_Status ##2G##ESC - ESP11 - AVH_STAT";
CM_ SG_ 3221225472 LDM_Sta "LDM_Status ##2G##ESC - ESP11 - LDM_STAT";
CM_ SG_ 3221225472 EPB_ActvReq "EPB_ActiveRequest ##2G##ESC - ESP11 - REQ_EPB_ACT";
CM_ SG_ 3221225472 EPB_StaReq "EPB_StatusRequest ##2G##ESC - ESP11 - REQ_EPB_STAT";
CM_ SG_ 3221225472 ECD_ActvSta "ECD_ActiveStatus ##2G##ESC - ESP11 - ECD_ACT";
CM_ SG_ 3221225472 AVH_CluDis "AVH_ClusterDisplay ##2G##ESC - TCS15 - AVH_CLU";
CM_ SG_ 3221225472 AVH_AlrmReq "AVH_AlarmRequest ##2G##ESC - TCS15 - AVH_ALARM";
CM_ SG_ 3221225472 AVH_ActvStaLmpDis "AVH_ActiveStatusLampDisplay ##2G##ESC - TCS15 - AVH_I_LAMP";
CM_ SG_ 3221225472 AVH_LmpDis "AVH_LampDisplay ##2G##ESC - TCS15 - AVH_LAMP";
CM_ SG_ 3221225472 AWD_CrdnShftTqLimVal "AWD_CardanShaftTorqueLimitValue ##2G##ESC - ESP11 - 4WD_TQC_LIM";
CM_ SG_ 3221225472 AWD_CltchDtyLimVal "AWD_ClutchDutyLimitValue ##2G##ESC - ESP11 - 4WD_CLU_LIM";
CM_ SG_ 3221225472 AWD_TransmsnTqLimModSta "AWD_TransmissionTorqueLimitModeStatus ##2G##ESC - ESP11 - 4WD_LIM_MODE";
CM_ SG_ 3221225472 AWD_RrWhlDtyLimReq "AWD_RearWheelDutyLimitRequest ##2G##ESC - ESP11 - 4WD_LIM_REQ";
CM_ SG_ 3221225472 AWD_FastOpnCrdnShftCltchReq "AWD_FastOpenCardanShaftClutchRequest ##2G##ESC - ESP11 - 4WD_OPEN";
CM_ SG_ 3221225472 DATC_Crc12Val "DATC_CyclicRedundancyCheck12Value";
CM_ SG_ 3221225472 DATC_AlvCnt12Val "DATC_AliveCounter12Value";
CM_ SG_ 3221225472 DATC_StrWhlHtrSwReq "DATC_SteeringWheelHeaterSwitchRequest";
CM_ SG_ 3221225472 DATC_FRStHtrSwReq "DATC_FrontRightSeatHeaterSwitchRequest";
CM_ SG_ 3221225472 DATC_FRStVentSwReq "DATC_FrontRightSeatVentilationSwitchRequest";
CM_ SG_ 3221225472 DATC_FLStOpReq "DATC_FrontLeftSeatOperationRequest";
CM_ SG_ 3221225472 DATC_FLStHtrSwReq "DATC_FrontLeftSeatHeaterSwitchRequest";
CM_ SG_ 3221225472 DATC_FLStVentSwReq "DATC_FrontLefttSeatVentilationSwitchRequest";
CM_ SG_ 3221225472 DATC_RRStHtrSwReq "DATC_RearRightSeatHeaterSwitchRequest";
CM_ SG_ 3221225472 DATC_RRStVentSwReq "DATC_RearRightSeatVentilationSwitchRequest";
CM_ SG_ 3221225472 DATC_RLStHtrSwReq "DATC_RearLeftSeatHeaterSwitchRequest";
CM_ SG_ 3221225472 DATC_RLStVentSwReq "DATC_RearLefttSeatVentilationSwitchRequest";
CM_ SG_ 3221225472 TCS_DisableSta "TCS_DisabledStatus ##2G##ESC - TCS11 - TCS_PAS";
CM_ SG_ 3221225472 TCS_DfctvSta "TCS_DefectiveStatus ##2G##ESC - TCS11 - TCS_DEF";
CM_ SG_ 3221225472 TCS_CtrlSta "TCS_ControlStatus ##2G##ESC - TCS11 - TCS_CTL";
CM_ SG_ 3221225472 ESC_DisableSta "ESC_DisabledStatus ##2G##ESC - TCS11 - ESP_PAS";
CM_ SG_ 3221225472 ESC_DfctvSta "ESC_DefectiveStatus ##2G##ESC - TCS11 - ESP_DEF";
CM_ SG_ 3221225472 ESC_CtrlSta "ESC_ControlStatus ##2G##ESC - TCS11 - ESP_CTL";
CM_ SG_ 3221225472 TCS_PreActvSta "TCS_PreActiveStatus ##2G##ESC - TCS13 - Pre_TCS_CTL";
CM_ SG_ 3221225472 DBC_StdbySta "DBC_StandbyStatus ##2G##ESC - TCS11 - DBC_PAS";
CM_ SG_ 3221225472 DBC_DfctvSta "DBC_DefectiveStatus ##2G##ESC - TCS11 - DBC_DEF";
CM_ SG_ 3221225472 DBC_CtrlSta "DBC_ControlStatus ##2G##ESC - TCS11 - DBC_CTL";
CM_ SG_ 3221225472 HAC_StdbySta "HAC_StandbyStatus ##2G##ESC - TCS11 - HAC_PAS";
CM_ SG_ 3221225472 HAC_DfctvSta "HAC_DefectiveStatus ##2G##ESC - TCS11 - HAC_DEF";
CM_ SG_ 3221225472 HAC_CtrlSta "HAC_ControlStatus ##2G##ESC - TCS11 - HAC_CTL";
CM_ SG_ 3221225472 TCS_Req "TCS_Request ##2G##ESC - TCS11 - TCS_REQ";
CM_ SG_ 3221225472 MSR_FuncReq "MSR_FunctionRequest ##2G##ESC - TCS11 - MSR_C_REQ";
CM_ SG_ 3221225472 TCS_GearShftCharacteristicVal "TCS_GearShiftCharacteristicValue ##2G##ESC - TCS11 - TCS_GSC";
CM_ SG_ 3221225472 TCS_ManufacturerVal "TCS_ManufacturerInformationValue ##2G##ESC - TCS11 - TCS_MFRN";
CM_ SG_ 3221225472 TCS_TqIntrvntnVal "TCS_TorqueInterventionValue ##2G##ESC - TCS11 - TQI_TCS";
CM_ SG_ 3221225472 MSR_TqIntrvntnVal "MSR_TorqueInterventionValue ##2G##ESC - TCS11 - TQI_MSR";
CM_ SG_ 3221225472 TCS_SlwTqIntrvntnVal "TCS_SlowTorqueInterventionValue ##2G##ESC - TCS11 - TQI_SLW_TCS";
CM_ SG_ 3221225472 RL_SHVU_HtSwHiIndSta "Rear Left_Seat Heater Switch High Indicator Status";
CM_ SG_ 3221225472 RL_SHVU_HtSwMidIndSta "Rear Left_Seat Heater Switch Mid Indicator Status";
CM_ SG_ 3221225472 RL_SHVU_HtSwLowIndSta "Rear Left_Seat Heater Switch Low Indicator Status";
CM_ SG_ 3221225472 RL_SHVU_VntSwHiIndSta "Rear Left Seat Vent Switch High Indicator Status";
CM_ SG_ 3221225472 RL_SHVU_VntSwMidIndSta "Rear Left Seat Vent Switch Mid Indicator Status";
CM_ SG_ 3221225472 RL_SHVU_VntSwLowIndSta "Rear Left Seat Vent Switch Low Indicator Status";
CM_ SG_ 3221225472 ESC_CylPrsrVal "ESC_CylinderPressureValue ##2G##ESC - ESP12 - CYL_PRES";
CM_ SG_ 3221225472 ESC_CylPrsrSta "ESC_CylinderPressureStatus ##2G##ESC - ESP12 - CYL_PRES_STAT";
CM_ SG_ 3221225472 ESC_CylPrsrDiagSta "ESC_CylinderPressureDiagnosisStatus ##2G##ESC - ESP12 - CYL_PRESS_DIAG";
CM_ SG_ 3221225472 ESC_CylPrsrFlagSta "ESC_CylinderPressureFlagStatus ##2G##ESC - ESP12 - CYL_PRES_FLAG";
CM_ SG_ 3221225472 ESC_VsmActvSta "ESC_VsmActiveStatus ##2G##ESC - VSM11 - CF_Esc_Act";
CM_ SG_ 3221225472 ESC_VsmDfctvSta "ESC_VsmDefectiveStatus ##2G##ESC - VSM11 - CF_Esc_Def";
CM_ SG_ 3221225472 ESC_VsmCtrlModSta "ESC_VsmControlModeStatus ##2G##ESC - VSM11 - CF_Esc_CtrMode";
CM_ SG_ 3221225472 ESC_StrTqReq "ESC_SteeringTorqueReqeust ##2G##ESC - VSM11 - CR_Esc_StrTqReq";
CM_ SG_ 3221225472 ESC_LongAccelOffstCalibPrmtr "Longitudinal Acceleration Offset Calibration Parameter";
CM_ SG_ 3221225472 RR_SHVU_HtSwHiIndSta "Rear Right_Seat Heater Switch High Indicator Status";
CM_ SG_ 3221225472 RR_SHVU_HtSwMidIndSta "Rear Left_Seat Heater Switch Mid Indicator Status";
CM_ SG_ 3221225472 RR_SHVU_HtSwLowIndSta "Rear Right_Seat Heater Switch Low Indicator Status";
CM_ SG_ 3221225472 RR_SHVU_VntSwHiIndSta "Rear Right Seat Vent Switch High Indicator Status";
CM_ SG_ 3221225472 RR_SHVU_VntSwMidIndSta "Rear Right Seat Vent Switch Mid Indicator Status";
CM_ SG_ 3221225472 RR_SHVU_VntSwLowIndSta "Rear Right Seat Vent Switch Low Indicator Status";
CM_ SG_ 3221225472 RLPSU_ReclMtrPos "RLPSU Recline Motor Position";
CM_ SG_ 3221225472 ESC_Crc1Val "ESC_CyclicRedundancyCheck1Value";
CM_ SG_ 3221225472 ESC_AlvCnt1Val "ESC_AliveCounter1Value";
CM_ SG_ 3221225472 ABS_WrngLmpSta "ABS_WarningLampStatus ##2G##ESC - TCS15 - ABS_W_LAMP";
CM_ SG_ 3221225472 ABS_DfctvSta "ABS_DefectiveStatus ##2G##ESC - TCS11 - ABS_DEF";
CM_ SG_ 3221225472 ABS_ActvSta "ABS_ActiveStatus ##2G##ESC - TCS11 - ABS_ACT";
CM_ SG_ 3221225472 ABS_DiagSta "ABS_DiagnosticStatus ##2G##ESC - TCS11 - ABS_DIAG";
CM_ SG_ 3221225472 EBD_WrngLmpSta "EBD_WarningLampStatus ##2G##ESC - TCS15 - EBD_W_LAMP";
CM_ SG_ 3221225472 EBD_DfctvSta "EBD_DefectiveStatus ##2G##ESC - TCS11 - EBD_DEF";
CM_ SG_ 3221225472 ESC_BrkLtActvSta "ESC_BrakeLightActiveStatus ##2G##ESC - TCS11 - BLA_CTL";
CM_ SG_ 3221225472 ESS_Sta "ESS_Status ##2G##ESC - TCS11 - ESS_STAT";
CM_ SG_ 3221225472 TCS_LmpSta "TCS_LampStatus ##2G##ESC - TCS15 - TCS_LAMP";
CM_ SG_ 3221225472 TCS_OffLmpSta "TCS_OffLampStatus ##2G##ESC - TCS15 - TCS_OFF_LAMP";
CM_ SG_ 3221225472 ESC_OffTempSta "ESC_OffStepStatus ##2G##ESC - TCS15 - ESC_Off_Step";
CM_ SG_ 3221225472 DBC_WrngLmpSta "DBC_WarningLampStatus ##2G##ESC - TCS15 - DBC_W_LAMP";
CM_ SG_ 3221225472 DBC_FuncLmpSta "DBC_FuncitonLampStatus ##2G##ESC - TCS15 - DBC_F_LAMP";
CM_ SG_ 3221225472 ESC_BrkCtrlSta "ESC_BrakeControlStatus ##2G##ESC - TCS11 - CF_Esc_BrkCtl";
CM_ SG_ 3221225472 RRPSU_ReclMtrPos "RRPSU Recline Motor Position";
CM_ SG_ 3221225472 BCM_Crc10Val "BCM_CyclicRedundancyCheck10Value";
CM_ SG_ 3221225472 BCM_AlvCnt10Val "BCM_AliveCounter10Value";
CM_ SG_ 3221225472 Wiper_PrkngPosSta "Wiper_ParkingPositionStatus ##2G##BCM - BCMmsg22 - C_WiperParkPosition";
CM_ SG_ 3221225472 Wiper_RainSnsrOptionTyp "Wiper_RainSensorOptionType ##2G##BCM - BCMmsg24 - C_RainSnsOption";
CM_ SG_ 3221225472 Wiper_RainSnsrSta "Wiper_RainSensorStatus ##2G##BCM - BCMmsg24 - C_RainSnsState";
CM_ SG_ 3221225472 BCM_SolSnsrRtOutVoltVal "BCM_SolarSensorRightOutputVoltageValue ##2G##BCM - BCMmsg24 - C_PhotosensorRH";
BA_DEF_ BO_  "UsrMsgIDSforwardDeviation" INT 0 100;
BA_DEF_ BO_  "UsrMsgIDSbackwardDeviation" INT 50 1000;
BA_DEF_ BO_  "GenMsgCycleTime" INT 0 2000;
BA_DEF_ BO_  "GenMsgStartDelayTime" INT 0 2000;
BA_DEF_ BO_  "GenMsgSendType" ENUM  "Cyclic ","NotUsed ","NotUsed ","NotUsed ","NotUsed ","NotUsed ","NotUsed ","IfActive ","NoMsgSendType ","NotUsed","vector_leerstring";
BA_DEF_ BO_  "GenMsgCycleTimeFast" INT 0 500;
BA_DEF_ BO_  "GenMsgILSupport" ENUM  "No","Yes";
BA_DEF_ BO_  "GenMsgNrOfRepetition" INT 0 3;
BA_DEF_ BO_  "VFrameFormat" ENUM  "StandardCAN","ExtendedCAN","reserved","reserved","reserved","reserved","reserved","reserved","reserved","reserved","reserved","reserved","reserved","reserved","StandardCAN_FD","ExtendedCAN_FD";
BA_DEF_ SG_  "UserSigValidity" ENUM  "B+","ACC","IG","IG1","IG2","IG3","IG1 or IG2","IG1 or IG3","Undef";
BA_DEF_ SG_  "GenSigTimeoutTime" INT 0 7000;
BA_DEF_ SG_  "UsrSigTimeoutValue" STRING ;
BA_DEF_ SG_  "UsrSigPurpose" ENUM  "Undef","FN","DIAG","DEV","NM";
BA_DEF_ SG_  "GenSigStartValue" INT 0 1215752192;
BA_DEF_ SG_  "NetworkRequest" ENUM  "Yes","No";
BA_DEF_ SG_  "NetworkRequestHoldingTime" INT 0 65535;
BA_DEF_ SG_  "Description" STRING ;
BA_DEF_ SG_  "Version" STRING ;
BA_DEF_ SG_  "GenSigEnvVarType" ENUM  "Int","Float","Undef";
BA_DEF_ SG_  "GenSigSendType" ENUM  "Cyclic			","OnWrite			","OnWriteWithRepetition			","OnChange			","OnChangeWithRepetition			","IfActive			","IfActiveWithRepetition			","NoSigSendType			","OnChangeAndIfActive			","OnChangeAndIfActiveWithRepetition";
BA_DEF_ SG_  "GwSigLatencyTime" INT 0 65536;
BA_DEF_ SG_  "GwSigMissingSourceType" ENUM  "Undef","OldValue","DefaultValue","InitialValue";
BA_DEF_ SG_  "NWM-WakeupAllowed" ENUM  "<n.a.>";
BA_DEF_ SG_  "RoutingFactor" INT 1 1215752192;
BA_DEF_DEF_  "UsrMsgIDSforwardDeviation" 10;
BA_DEF_DEF_  "UsrMsgIDSbackwardDeviation" 100;
BA_DEF_DEF_  "GenMsgCycleTime" 200;
BA_DEF_DEF_  "GenMsgStartDelayTime" 0;
BA_DEF_DEF_  "GenMsgSendType" "NoMsgSendType ";
BA_DEF_DEF_  "GenMsgCycleTimeFast" 40;
BA_DEF_DEF_  "GenMsgILSupport" "Yes";
BA_DEF_DEF_  "GenMsgNrOfRepetition" 3;
BA_DEF_DEF_  "VFrameFormat" "StandardCAN";
BA_DEF_DEF_  "UserSigValidity" "IG";
BA_DEF_DEF_  "GenSigTimeoutTime" 500;
BA_DEF_DEF_  "UsrSigTimeoutValue" "Undef";
BA_DEF_DEF_  "UsrSigPurpose" "FN";
BA_DEF_DEF_  "GenSigStartValue" 0;
BA_DEF_DEF_  "NetworkRequest" "No";
BA_DEF_DEF_  "NetworkRequestHoldingTime" 0;
BA_DEF_DEF_  "Description" "";
BA_DEF_DEF_  "Version" "";
BA_DEF_DEF_  "GenSigEnvVarType" "Undef";
BA_DEF_DEF_  "GenSigSendType" "NoSigSendType			";
BA_DEF_DEF_  "GwSigLatencyTime" 40;
BA_DEF_DEF_  "GwSigMissingSourceType" "Undef";
BA_DEF_DEF_  "NWM-WakeupAllowed" "<n.a.>";
BA_DEF_DEF_  "RoutingFactor" 1;
BA_ "Description" SG_ 3221225472 SCR_SysErrMsgDis "The signal indicates warning message information which shall be displayed accroding to corresponding SCR error cases";
BA_ "UserSigValidity" SG_ 3221225472 SCR_SysErrMsgDis 3;
BA_ "GenSigTimeoutTime" SG_ 3221225472 SCR_SysErrMsgDis 1500;
BA_ "RoutingFactor" SG_ 3221225472 SCR_SysErrMsgDis 2;
BA_ "Version" SG_ 3221225472 SCR_SysErrMsgDis "17.12.00";
BA_ "Description" SG_ 3221225472 SCR_SysWrngLmpReq "The signal indicates the status of the 'SCR System Warning lamp'";
BA_ "UserSigValidity" SG_ 3221225472 SCR_SysWrngLmpReq 3;
BA_ "GenSigTimeoutTime" SG_ 3221225472 SCR_SysWrngLmpReq 1500;
BA_ "RoutingFactor" SG_ 3221225472 SCR_SysWrngLmpReq 2;
BA_ "Version" SG_ 3221225472 SCR_SysWrngLmpReq "17.12.00";
BA_ "Description" SG_ 3221225472 SCR_IndcmtExitStaDis "Send information to CLU(or message center) about Inudcement exit condition";
BA_ "UserSigValidity" SG_ 3221225472 SCR_IndcmtExitStaDis 3;
BA_ "GenSigTimeoutTime" SG_ 3221225472 SCR_IndcmtExitStaDis 1500;
BA_ "RoutingFactor" SG_ 3221225472 SCR_IndcmtExitStaDis 2;
BA_ "Version" SG_ 3221225472 SCR_IndcmtExitStaDis "17.12.00";
BA_ "Description" SG_ 3221225472 SCR_UreaLvlSta "The signal indicates UREA Level";
BA_ "UserSigValidity" SG_ 3221225472 SCR_UreaLvlSta 3;
BA_ "GenSigTimeoutTime" SG_ 3221225472 SCR_UreaLvlSta 1500;
BA_ "RoutingFactor" SG_ 3221225472 SCR_UreaLvlSta 2;
BA_ "Version" SG_ 3221225472 SCR_UreaLvlSta "17.12.00";
BA_ "Description" SG_ 3221225472 SCR_RmnRstrtDis "This signal indicates the number of remaining restarts";
BA_ "UserSigValidity" SG_ 3221225472 SCR_RmnRstrtDis 3;
BA_ "GenSigTimeoutTime" SG_ 3221225472 SCR_RmnRstrtDis 1500;
BA_ "RoutingFactor" SG_ 3221225472 SCR_RmnRstrtDis 2;
BA_ "Version" SG_ 3221225472 SCR_RmnRstrtDis "17.12.00";
BA_ "Description" SG_ 3221225472 SCR_RmnDstDis "This signal indicates the remaining distance before engine can not be started";
BA_ "UserSigValidity" SG_ 3221225472 SCR_RmnDstDis 3;
BA_ "GenSigTimeoutTime" SG_ 3221225472 SCR_RmnDstDis 1500;
BA_ "RoutingFactor" SG_ 3221225472 SCR_RmnDstDis 2;
BA_ "Version" SG_ 3221225472 SCR_RmnDstDis "17.12.00";
BA_ "Description" SG_ 3221225472 ENG_TransmsnTyp "A/T or M/T information generated by automatic variant coding.

A/T information is got from the “TCU_TYPE” signal of TCU1 message. (See TCU1 message information)";
BA_ "UserSigValidity" SG_ 3221225472 ENG_TransmsnTyp 3;
BA_ "GenSigTimeoutTime" SG_ 3221225472 ENG_TransmsnTyp 1500;
BA_ "RoutingFactor" SG_ 3221225472 ENG_TransmsnTyp 2;
BA_ "Version" SG_ 3221225472 ENG_TransmsnTyp "17.11.00";
BA_ "Description" SG_ 3221225472 ENG_EngDsplceTyp "This signal indicates the engine displacement (volume).";
BA_ "UserSigValidity" SG_ 3221225472 ENG_EngDsplceTyp 3;
BA_ "GenSigTimeoutTime" SG_ 3221225472 ENG_EngDsplceTyp 1500;
BA_ "RoutingFactor" SG_ 3221225472 ENG_EngDsplceTyp 2;
BA_ "Version" SG_ 3221225472 ENG_EngDsplceTyp "17.12.00";
BA_ "Description" SG_ 3221225472 EMS_Crc5Val "The CRC checking process calculates the CRC over the entire data block, including the CRC result.

- CRC Polynomial (0x1021) , Initial Value : 0xFFFF, XOR value : 0x0000

- The mathematical expression to 16 bit CRC polynomial is given here. G(x) = x16 + ";
BA_ "GenSigStartValue" SG_ 3221225472 EMS_Crc5Val 65535;
BA_ "UserSigValidity" SG_ 3221225472 EMS_Crc5Val 3;
BA_ "GenSigTimeoutTime" SG_ 3221225472 EMS_Crc5Val 1500;
BA_ "RoutingFactor" SG_ 3221225472 EMS_Crc5Val 2;
BA_ "Version" SG_ 3221225472 EMS_Crc5Val "17.11.00";
BA_ "Description" SG_ 3221225472 EMS_AlvCnt5Val "For the first transmission request for a data element the counter shall be initialized with 0 and shall be incremented by 1

for every subsequent send request. When the counter reaches the maximum value(0xFF), then it shall restart with ? for the next se";
BA_ "UserSigValidity" SG_ 3221225472 EMS_AlvCnt5Val 3;
BA_ "GenSigTimeoutTime" SG_ 3221225472 EMS_AlvCnt5Val 1500;
BA_ "RoutingFactor" SG_ 3221225472 EMS_AlvCnt5Val 2;
BA_ "Version" SG_ 3221225472 EMS_AlvCnt5Val "17.12.03";
BA_ "Description" SG_ 3221225472 ENG_ImmoLmpSta "This signals indicates that a status of Immobilizer lamp.";
BA_ "UserSigValidity" SG_ 3221225472 ENG_ImmoLmpSta 3;
BA_ "GenSigTimeoutTime" SG_ 3221225472 ENG_ImmoLmpSta 1500;
BA_ "RoutingFactor" SG_ 3221225472 ENG_ImmoLmpSta 2;
BA_ "Version" SG_ 3221225472 ENG_ImmoLmpSta "17.12.00";
BA_ "Description" SG_ 3221225472 ENG_MilSta "The signal indicates the status of the 'Check Engine' light. Lamp activation is either effected statically or clocked (500 ms cycle, code sequence).

An evaluation within 10 ms is required to map the activation process as precisely as possible.

In case ";
BA_ "UserSigValidity" SG_ 3221225472 ENG_MilSta 3;
BA_ "GenSigTimeoutTime" SG_ 3221225472 ENG_MilSta 1500;
BA_ "RoutingFactor" SG_ 3221225472 ENG_MilSta 2;
BA_ "Version" SG_ 3221225472 ENG_MilSta "17.12.00";
BA_ "Description" SG_ 3221225472 ENG_ImmoSta "Status of immobilizer.";
BA_ "UserSigValidity" SG_ 3221225472 ENG_ImmoSta 3;
BA_ "GenSigTimeoutTime" SG_ 3221225472 ENG_ImmoSta 1500;
BA_ "RoutingFactor" SG_ 3221225472 ENG_ImmoSta 2;
BA_ "Version" SG_ 3221225472 ENG_ImmoSta "17.12.00";
BA_ "Description" SG_ 3221225472 OBD_RbmInhbtSta "This variable is set to 1 if there is a malfunction of any component used to determine the standardized vehicle operations (i.e. vehicle speed, ambient temperature, elevation, idle operation, engine cold start, time of operation, etc.)

Calculations shal";
BA_ "UserSigValidity" SG_ 3221225472 OBD_RbmInhbtSta 3;
BA_ "GenSigTimeoutTime" SG_ 3221225472 OBD_RbmInhbtSta 1500;
BA_ "RoutingFactor" SG_ 3221225472 OBD_RbmInhbtSta 2;
BA_ "Version" SG_ 3221225472 OBD_RbmInhbtSta "17.12.00";
BA_ "Description" SG_ 3221225472 ENG_AtmsphPrsrVal "The value AMP_CAN specifies the atmospheric pressure in the unit [mmHg]. It is calculated from the altitude correction factor MAF_FAC_ALTI_MMV. (Modeling Value)

However, when AMP sensor is equipped, the value AMP_CAN is calculated from the sensor output";
BA_ "GenSigStartValue" SG_ 3221225472 ENG_AtmsphPrsrVal 28;
BA_ "UserSigValidity" SG_ 3221225472 ENG_AtmsphPrsrVal 3;
BA_ "GenSigTimeoutTime" SG_ 3221225472 ENG_AtmsphPrsrVal 1500;
BA_ "RoutingFactor" SG_ 3221225472 ENG_AtmsphPrsrVal 2;
BA_ "Version" SG_ 3221225472 ENG_AtmsphPrsrVal "17.12.00";
BA_ "Description" SG_ 3221225472 ENG_AltFdbckLoadVal "This signal is Filtered electrical load PWM signal from Alternator.

The FR signal duty cycle is an indication of the generator load. It can be used to increase the engine idle speed or calculate the torque consumption of the alternator.";
BA_ "GenSigStartValue" SG_ 3221225472 ENG_AltFdbckLoadVal 255;
BA_ "UserSigValidity" SG_ 3221225472 ENG_AltFdbckLoadVal 3;
BA_ "GenSigTimeoutTime" SG_ 3221225472 ENG_AltFdbckLoadVal 1500;
BA_ "RoutingFactor" SG_ 3221225472 ENG_AltFdbckLoadVal 2;
BA_ "Version" SG_ 3221225472 ENG_AltFdbckLoadVal "17.12.00";
BA_ "Description" SG_ 3221225472 ENG_BattVoltVal "The battery voltage after main relay is transferred.";
BA_ "UserSigValidity" SG_ 3221225472 ENG_BattVoltVal 3;
BA_ "GenSigTimeoutTime" SG_ 3221225472 ENG_BattVoltVal 1500;
BA_ "RoutingFactor" SG_ 3221225472 ENG_BattVoltVal 2;
BA_ "Version" SG_ 3221225472 ENG_BattVoltVal "17.12.00";
BA_ "Description" SG_ 3221225472 ENG_FuelTempVal "Fuel temperature in EMS sensed via an A/D converter; converted into degrees centigrade (°C).";
BA_ "GenSigStartValue" SG_ 3221225472 ENG_FuelTempVal 255;
BA_ "UserSigValidity" SG_ 3221225472 ENG_FuelTempVal 3;
BA_ "GenSigTimeoutTime" SG_ 3221225472 ENG_FuelTempVal 1500;
BA_ "RoutingFactor" SG_ 3221225472 ENG_FuelTempVal 2;
BA_ "Version" SG_ 3221225472 ENG_FuelTempVal "17.12.00";
BA_ "Description" SG_ 3221225472 TCU_Crc1Val "The CRC checking process calculates the CRC over the entire data block, including the CRC result.

- CRC Polynomial (0x1021) , Initial Value : 0xFFFF, XOR value : 0x0000

- The mathematical expression to 16 bit CRC polynomial is given here. G(x) = x16 + ";
BA_ "GenSigStartValue" SG_ 3221225472 TCU_Crc1Val 65535;
BA_ "UserSigValidity" SG_ 3221225472 TCU_Crc1Val 3;
BA_ "RoutingFactor" SG_ 3221225472 TCU_Crc1Val 5;
BA_ "Version" SG_ 3221225472 TCU_Crc1Val "17.11.00";
BA_ "Description" SG_ 3221225472 TCU_AlvCnt1Val "For the first transmission request for a data element the counter shall be initialized with 0 and shall be incremented by 1

for every subsequent send request. When the counter reaches the maximum value(0xFF), then it shall restart with ? for the next se";
BA_ "UserSigValidity" SG_ 3221225472 TCU_AlvCnt1Val 3;
BA_ "RoutingFactor" SG_ 3221225472 TCU_AlvCnt1Val 5;
BA_ "Version" SG_ 3221225472 TCU_AlvCnt1Val "17.11.00";
BA_ "Description" SG_ 3221225472 TCU_GearSlctDis "Position (P, R, N..), which was identified by the gear selector.

In case the gear selector is in a intermediate position, the last clear recognized position is used.

There is no specific phase relationship between the output and any other signal.";
BA_ "GenSigStartValue" SG_ 3221225472 TCU_GearSlctDis 9;
BA_ "UserSigValidity" SG_ 3221225472 TCU_GearSlctDis 3;
BA_ "RoutingFactor" SG_ 3221225472 TCU_GearSlctDis 5;
BA_ "Version" SG_ 3221225472 TCU_GearSlctDis "17.11.00";
BA_ "Description" SG_ 3221225472 TCU_Typ "Information regarding the type of transmission - Step A/T or CVT or DCT.";
BA_ "UserSigValidity" SG_ 3221225472 TCU_Typ 3;
BA_ "RoutingFactor" SG_ 3221225472 TCU_Typ 5;
BA_ "Version" SG_ 3221225472 TCU_Typ "17.12.03";
BA_ "Description" SG_ 3221225472 TCU_TqRdctnVal "The TCU requests a torque reduction via this signal to the EMS. 



If MSB is 1, this signal is - value.

else, this signal is +value.

0~10bit is used for absolute value.";
BA_ "GenSigStartValue" SG_ 3221225472 TCU_TqRdctnVal 2047;
BA_ "UserSigValidity" SG_ 3221225472 TCU_TqRdctnVal 3;
BA_ "RoutingFactor" SG_ 3221225472 TCU_TqRdctnVal 5;
BA_ "Version" SG_ 3221225472 TCU_TqRdctnVal "18.01.02";
BA_ "Description" SG_ 3221225472 TCU_GearStepTyp "This signal indicates number of gear steps of step type automatic transmission(A/T) or Dual Clutch Transmission(DCT). A vehicle can have A/T or DCT variant according to its option, for example 4-speed A/T or 5-speed A/T can be equipped in the same kind o";
BA_ "UserSigValidity" SG_ 3221225472 TCU_GearStepTyp 3;
BA_ "RoutingFactor" SG_ 3221225472 TCU_GearStepTyp 5;
BA_ "Version" SG_ 3221225472 TCU_GearStepTyp "17.11.00";
BA_ "Description" SG_ 3221225472 TCU_GearShftSta "SWI_GS indicates whether a gear change is being executed in the gearbox.



Note : Gear change means a gear shift at D-range and Garage shift(PRND).";
BA_ "UserSigValidity" SG_ 3221225472 TCU_GearShftSta 3;
BA_ "RoutingFactor" SG_ 3221225472 TCU_GearShftSta 5;
BA_ "Version" SG_ 3221225472 TCU_GearShftSta "17.11.00";
BA_ "Description" SG_ 3221225472 TCU_TqCnvrtrSta "Status converter clutch



There is no specific phase relationship between the output and any other signal.";
BA_ "UserSigValidity" SG_ 3221225472 TCU_TqCnvrtrSta 3;
BA_ "RoutingFactor" SG_ 3221225472 TCU_TqCnvrtrSta 5;
BA_ "Version" SG_ 3221225472 TCU_TqCnvrtrSta "17.11.00";
BA_ "UserSigValidity" SG_ 3221225472 ENG_EngTyp4 3;
BA_ "GenSigTimeoutTime" SG_ 3221225472 ENG_EngTyp4 1500;
BA_ "RoutingFactor" SG_ 3221225472 ENG_EngTyp4 2;
BA_ "Version" SG_ 3221225472 ENG_EngTyp4 "17.11.00";
BA_ "UserSigValidity" SG_ 3221225472 ENG_EngTyp3 3;
BA_ "GenSigTimeoutTime" SG_ 3221225472 ENG_EngTyp3 1500;
BA_ "RoutingFactor" SG_ 3221225472 ENG_EngTyp3 2;
BA_ "Version" SG_ 3221225472 ENG_EngTyp3 "17.11.00";
BA_ "UserSigValidity" SG_ 3221225472 ENG_EngTyp2 3;
BA_ "GenSigTimeoutTime" SG_ 3221225472 ENG_EngTyp2 1500;
BA_ "RoutingFactor" SG_ 3221225472 ENG_EngTyp2 2;
BA_ "Version" SG_ 3221225472 ENG_EngTyp2 "17.12.00";
BA_ "UserSigValidity" SG_ 3221225472 ENG_EngTyp1 3;
BA_ "GenSigTimeoutTime" SG_ 3221225472 ENG_EngTyp1 1500;
BA_ "RoutingFactor" SG_ 3221225472 ENG_EngTyp1 2;
BA_ "Version" SG_ 3221225472 ENG_EngTyp1 "17.12.00";
BA_ "Description" SG_ 3221225472 ENG_S_F "AMS/ISG system type indicator";
BA_ "UserSigValidity" SG_ 3221225472 ENG_S_F 3;
BA_ "GenSigTimeoutTime" SG_ 3221225472 ENG_S_F 1500;
BA_ "RoutingFactor" SG_ 3221225472 ENG_S_F 2;
BA_ "Version" SG_ 3221225472 ENG_S_F "18.03.05";
BA_ "Description" SG_ 3221225472 ENG_S_F_GEN "system generation type indicator";
BA_ "UserSigValidity" SG_ 3221225472 ENG_S_F_GEN 3;
BA_ "GenSigTimeoutTime" SG_ 3221225472 ENG_S_F_GEN 1500;
BA_ "RoutingFactor" SG_ 3221225472 ENG_S_F_GEN 2;
BA_ "Version" SG_ 3221225472 ENG_S_F_GEN "18.03.05";
BA_ "Description" SG_ 3221225472 ENG_TqStndValExt "The value TQ_STND specifies the torque to which the other torque quantities are referred. The conversion into a physical quantity provides a displayable range of 0...99.6094% of TQ_STND for the appropriate

signals.



※ Start Value : Appropriate value";
BA_ "UserSigValidity" SG_ 3221225472 ENG_TqStndValExt 3;
BA_ "GenSigTimeoutTime" SG_ 3221225472 ENG_TqStndValExt 1500;
BA_ "RoutingFactor" SG_ 3221225472 ENG_TqStndValExt 2;
BA_ "Version" SG_ 3221225472 ENG_TqStndValExt "18.01.03";
BA_ "Description" SG_ 3221225472 TCU_CurrGearSta "CUR_GR indicates the gear speed which is currently engaged in the gearbox.";
BA_ "UserSigValidity" SG_ 3221225472 TCU_CurrGearSta 3;
BA_ "RoutingFactor" SG_ 3221225472 TCU_CurrGearSta 5;
BA_ "Version" SG_ 3221225472 TCU_CurrGearSta "17.11.00";
BA_ "Description" SG_ 3221225472 TCU_TrgtGearSta "CF_Tcu_TarGr informs about the speed, which is currently engaged in the gearbox, or, in case of a gear change (SWI_GS), which speed is reached.



Note: Gear changes covering more than one speed are also possible.

In the P and N positions, the frictiona";
BA_ "UserSigValidity" SG_ 3221225472 TCU_TrgtGearSta 3;
BA_ "RoutingFactor" SG_ 3221225472 TCU_TrgtGearSta 5;
BA_ "Version" SG_ 3221225472 TCU_TrgtGearSta "17.11.00";
BA_ "Description" SG_ 3221225472 TCU_CluTrgtGearSta "TCH_CluTrgtGearSta informs about target gear of SS timing 

(For indicating Paddle shift or Manual mode on cluster)";
BA_ "UserSigValidity" SG_ 3221225472 TCU_CluTrgtGearSta 3;
BA_ "RoutingFactor" SG_ 3221225472 TCU_CluTrgtGearSta 5;
BA_ "Version" SG_ 3221225472 TCU_CluTrgtGearSta "17.11.00";
BA_ "Description" SG_ 3221225472 TCH_EngTrgtGearSta "TCH_EngTrgtGearSta informs about target gear of SS timing 

(For indicating Paddle shift or Manual mode on cluster)";
BA_ "UserSigValidity" SG_ 3221225472 TCH_EngTrgtGearSta 3;
BA_ "RoutingFactor" SG_ 3221225472 TCH_EngTrgtGearSta 5;
BA_ "Version" SG_ 3221225472 TCH_EngTrgtGearSta "17.11.00";
BA_ "Description" SG_ 3221225472 TCU_EngTqLimVal "The TCU requests a engine torque limit(ETL) from the EMS. 

There is no time limitation of the intervention.

TCU requests engine torque limit below the TCU requesting torque.

The engine torque request signal means the absolute torque limitation.

TCU s";
BA_ "GenSigStartValue" SG_ 3221225472 TCU_EngTqLimVal 2047;
BA_ "UserSigValidity" SG_ 3221225472 TCU_EngTqLimVal 3;
BA_ "RoutingFactor" SG_ 3221225472 TCU_EngTqLimVal 5;
BA_ "Version" SG_ 3221225472 TCU_EngTqLimVal "18.01.02";
BA_ "Description" SG_ 3221225472 TCU_VehSpdKphVal "The vehicle speed calculated by TCU is transferred. 

If a vehicle has no vehicle speed sensor, no wheel speed sensor and no ABS(TCS/ESC) then it is impossible for an EMS to calculate veficle speed. In this case a TCU should calculate vehicle speed and s";
BA_ "UserSigValidity" SG_ 3221225472 TCU_VehSpdKphVal 3;
BA_ "RoutingFactor" SG_ 3221225472 TCU_VehSpdKphVal 5;
BA_ "Version" SG_ 3221225472 TCU_VehSpdKphVal "17.11.00";
BA_ "Description" SG_ 3221225472 TCU_DcmlVehSpdKphVal "The signal VS_TCU_DECIAMAL means the value which is below decimal point of the vehicle speed.

For instance, if a vehicle speed is 13.75Km/h, VS_TCU means 13Km/h and VS_TCU_DECIMAL means 0.75Km/h.



Example)   VS_TCU = 13,  VS_TCU_DECIAMAL  = 96

Vehicl";
BA_ "UserSigValidity" SG_ 3221225472 TCU_DcmlVehSpdKphVal 3;
BA_ "RoutingFactor" SG_ 3221225472 TCU_DcmlVehSpdKphVal 5;
BA_ "Version" SG_ 3221225472 TCU_DcmlVehSpdKphVal "17.11.00";
BA_ "Description" SG_ 3221225472 TCU_SprkRtrdReq "The TCU requests a spark angle retard via the signal SPK_RTD_TCU to the EMS for torque reduction during the gear engage condition.



(PH) = ((HEX) - 3FH) * 0.375 (Advance) (PH) = (3FH - (HEX)) * (-0.375) (Retard)

-15˚  ... 0˚= 17H .. 3FH (Retard)

0.";
BA_ "GenSigStartValue" SG_ 3221225472 TCU_SprkRtrdReq 255;
BA_ "UserSigValidity" SG_ 3221225472 TCU_SprkRtrdReq 3;
BA_ "RoutingFactor" SG_ 3221225472 TCU_SprkRtrdReq 5;
BA_ "Version" SG_ 3221225472 TCU_SprkRtrdReq "17.11.00";
BA_ "Description" SG_ 3221225472 TCU_EngRpmDisSta "Flag for Engine RPM(from TCU) Display on Cluster, Only when this flag is set to 1, Cluster shall display the Engine RPM from TCU";
BA_ "UserSigValidity" SG_ 3221225472 TCU_EngRpmDisSta 3;
BA_ "RoutingFactor" SG_ 3221225472 TCU_EngRpmDisSta 5;
BA_ "Version" SG_ 3221225472 TCU_EngRpmDisSta "17.11.00";
BA_ "Description" SG_ 3221225472 TCU_GearLmpBlnkngReq "Cluster controls blinking of Gear lamp receiving the request signal from TCU.";
BA_ "UserSigValidity" SG_ 3221225472 TCU_GearLmpBlnkngReq 3;
BA_ "RoutingFactor" SG_ 3221225472 TCU_GearLmpBlnkngReq 5;
BA_ "Version" SG_ 3221225472 TCU_GearLmpBlnkngReq "17.11.00";
BA_ "Description" SG_ 3221225472 TCU_FuelCutInhbtReq "During coast down shifting, EMS may cut off fuel injection and as a result, a driver can feel bad shift feeling. In this case, to enhance shift quality, TCU needs inhibition of fuel cut off control.

This signal indicates inhibition of engine fuel cut of";
BA_ "UserSigValidity" SG_ 3221225472 TCU_FuelCutInhbtReq 3;
BA_ "RoutingFactor" SG_ 3221225472 TCU_FuelCutInhbtReq 5;
BA_ "Version" SG_ 3221225472 TCU_FuelCutInhbtReq "17.11.00";
BA_ "Description" SG_ 3221225472 TCU_IdleUpReq "When ATF(Automatic Transmission Fluid) rises in high temperauture, the TCU requests engine idle RPM up via the signal IDLE_UP_TCU to the EMS for reduction of gearshift time form Neutral to Reverse.



THIS SIGNAL IS FOR “LAMBDA ENGINE” SYSTEM ONLY.";
BA_ "UserSigValidity" SG_ 3221225472 TCU_IdleUpReq 3;
BA_ "RoutingFactor" SG_ 3221225472 TCU_IdleUpReq 5;
BA_ "Version" SG_ 3221225472 TCU_IdleUpReq "17.11.00";
BA_ "Description" SG_ 3221225472 TCU_EngRpmDis "Engine RPM from TCU (Only for the display on Cluster)";
BA_ "UserSigValidity" SG_ 3221225472 TCU_EngRpmDis 3;
BA_ "RoutingFactor" SG_ 3221225472 TCU_EngRpmDis 5;
BA_ "Version" SG_ 3221225472 TCU_EngRpmDis "17.11.00";
BA_ "Description" SG_ 3221225472 TCU_SlpVal "This signal is used to avoid busy shifting during uphill driving.

It is calculated using engine torque, turbine torque and gearbox torque so on.

It has some restrictions like the following sentences

- No slope calculation during shifting, braking, 1st";
BA_ "GenSigStartValue" SG_ 3221225472 TCU_SlpVal 32;
BA_ "UserSigValidity" SG_ 3221225472 TCU_SlpVal 3;
BA_ "RoutingFactor" SG_ 3221225472 TCU_SlpVal 5;
BA_ "Version" SG_ 3221225472 TCU_SlpVal "17.11.00";
BA_ "Description" SG_ 3221225472 TCU_EngSpdIncReq "This signal is a target engine speed requirement start flag signal by TCU, 

which is sent to ECU. It is synchronized to the signal engine speed increasing target speed value.";
BA_ "UserSigValidity" SG_ 3221225472 TCU_EngSpdIncReq 3;
BA_ "RoutingFactor" SG_ 3221225472 TCU_EngSpdIncReq 5;
BA_ "Version" SG_ 3221225472 TCU_EngSpdIncReq "17.11.00";
BA_ "Description" SG_ 3221225472 TCU_ObdSta "The signal TCU_OBD is used to inform the OBD master (EMS-ECU) in case a OBD relevant fault is detected. According to the OBD regulations the TCU could request MIL on. If a freeze frame request by the TCU has not been acknowledged (OBD_FRF_ACK) within 2 s";
BA_ "UserSigValidity" SG_ 3221225472 TCU_ObdSta 3;
BA_ "RoutingFactor" SG_ 3221225472 TCU_ObdSta 5;
BA_ "Version" SG_ 3221225472 TCU_ObdSta "17.11.00";
BA_ "Description" SG_ 3221225472 TCU_SprtyIndxSta "Sporty index based on the driver's driving behaviour";
BA_ "UserSigValidity" SG_ 3221225472 TCU_SprtyIndxSta 3;
BA_ "RoutingFactor" SG_ 3221225472 TCU_SprtyIndxSta 5;
BA_ "Version" SG_ 3221225472 TCU_SprtyIndxSta "17.11.00";
BA_ "Description" SG_ 3221225472 TCU_DrvngModDis "Driving mode display by TCU";
BA_ "UserSigValidity" SG_ 3221225472 TCU_DrvngModDis 3;
BA_ "RoutingFactor" SG_ 3221225472 TCU_DrvngModDis 5;
BA_ "Version" SG_ 3221225472 TCU_DrvngModDis "17.11.00";
BA_ "Description" SG_ 3221225472 TCU_DrvngModReq "Driving mode request with Normal, Eco, Eco+, Sport, Sport+

and Snow only TCU automode is on, otherwise, inactive";
BA_ "UserSigValidity" SG_ 3221225472 TCU_DrvngModReq 3;
BA_ "RoutingFactor" SG_ 3221225472 TCU_DrvngModReq 5;
BA_ "Version" SG_ 3221225472 TCU_DrvngModReq "17.11.00";
BA_ "Description" SG_ 3221225472 TCU_SmrtShftSta "Information of SmartShift";
BA_ "UserSigValidity" SG_ 3221225472 TCU_SmrtShftSta 3;
BA_ "RoutingFactor" SG_ 3221225472 TCU_SmrtShftSta 5;
BA_ "Version" SG_ 3221225472 TCU_SmrtShftSta "17.11.00";
BA_ "Description" SG_ 3221225472 TCU_LupTrgtEngSpdVal "This signal is a target engine speed requested by TCU, which is sent to ECU. 

It is intended for OFF-SLIP to be more successful in triggering fuel cut-off under more various driving conditions.";
BA_ "GenSigStartValue" SG_ 3221225472 TCU_LupTrgtEngSpdVal 255;
BA_ "UserSigValidity" SG_ 3221225472 TCU_LupTrgtEngSpdVal 3;
BA_ "RoutingFactor" SG_ 3221225472 TCU_LupTrgtEngSpdVal 5;
BA_ "Version" SG_ 3221225472 TCU_LupTrgtEngSpdVal "17.11.00";
BA_ "Description" SG_ 3221225472 TCU_FrtStcShftSta "Status of fisrt static shift";
BA_ "UserSigValidity" SG_ 3221225472 TCU_FrtStcShftSta 3;
BA_ "RoutingFactor" SG_ 3221225472 TCU_FrtStcShftSta 5;
BA_ "Version" SG_ 3221225472 TCU_FrtStcShftSta "17.11.00";
BA_ "Description" SG_ 3221225472 TCU_IsgInhbtReq "TCU requests ECU to inhibit the ISG function when ISG start condition of AT is not met (oil temp is too low , AT ISG system malfunction, etc … )";
BA_ "UserSigValidity" SG_ 3221225472 TCU_IsgInhbtReq 3;
BA_ "RoutingFactor" SG_ 3221225472 TCU_IsgInhbtReq 5;
BA_ "Version" SG_ 3221225472 TCU_IsgInhbtReq "17.11.00";
BA_ "Description" SG_ 3221225472 TCU_CdaInhbtReq "TCU requests ECU to prohibit the CDA transition during gear shifting or lock-up clutch operation in the automatic transmission in order to prevent a shock on the vehicle. Without gear shifting and lock-up clutch operation, CDA transition can be performed";
BA_ "UserSigValidity" SG_ 3221225472 TCU_CdaInhbtReq 3;
BA_ "RoutingFactor" SG_ 3221225472 TCU_CdaInhbtReq 5;
BA_ "Version" SG_ 3221225472 TCU_CdaInhbtReq "17.11.00";
BA_ "Description" SG_ 3221225472 TCU_BrkOnReq "The TCU request the ESC to activate the Brake.

The ESC holds the Brake ON during the TCU’s Brake ON Request.";
BA_ "UserSigValidity" SG_ 3221225472 TCU_BrkOnReq 3;
BA_ "RoutingFactor" SG_ 3221225472 TCU_BrkOnReq 5;
BA_ "Version" SG_ 3221225472 TCU_BrkOnReq "17.11.00";
BA_ "Description" SG_ 3221225472 TCU_TqGrdntLimVal "TCU requests EMS to perform the engine torque gradient limitation control with a rate of Nm per second(Nm/sec).



Downshift : The engine torque gradient limitation for downshift will be a function of pedal and shift-time. 

Upshift : The engine torque g";
BA_ "UserSigValidity" SG_ 3221225472 TCU_TqGrdntLimVal 3;
BA_ "RoutingFactor" SG_ 3221225472 TCU_TqGrdntLimVal 5;
BA_ "Version" SG_ 3221225472 TCU_TqGrdntLimVal "17.11.00";
BA_ "Description" SG_ 3221225472 YRS_YawRtVal "This signal indicates Information regarding yaw rate.



physical range : -163.84..163.83 ˚/s = 0000H..FFFEh



Conversion : (PH) = ((HEX)-8000H)*0.005[˚/s/digit]



                            = (HEX)*0.005[˚/s/digit] - 163.84[˚/s]



              ";
BA_ "GenSigStartValue" SG_ 3221225472 YRS_YawRtVal 32768;
BA_ "UserSigValidity" SG_ 3221225472 YRS_YawRtVal 3;
BA_ "RoutingFactor" SG_ 3221225472 YRS_YawRtVal 5;
BA_ "Version" SG_ 3221225472 YRS_YawRtVal "18.02.01";
BA_ "Description" SG_ 3221225472 YRS_LatAccelVal "This signal indicates Information regarding lateral acceleration.



physical range : -4.1768g..4.1765g = 0000H..FFFEh



Conversion : (PH) = ((HEX)-8000H)*0.000127465[g/digit]



                            = (HEX)*0.000127465[g/digit] - 4.17677312[g]

";
BA_ "GenSigStartValue" SG_ 3221225472 YRS_LatAccelVal 32768;
BA_ "UserSigValidity" SG_ 3221225472 YRS_LatAccelVal 3;
BA_ "RoutingFactor" SG_ 3221225472 YRS_LatAccelVal 5;
BA_ "Version" SG_ 3221225472 YRS_LatAccelVal "18.02.01";
BA_ "Description" SG_ 3221225472 YRS_LongAccelVal "This signal indicates information regarding longitudinal acceleration.



physical range : -4.1768g..4.1765g = 0000H..FFFEh



Conversion : (PH) = ((HEX)-8000H)*0.000127465[g/digit]



                            = (HEX)*0.000127465[g/digit] - 4.17677312";
BA_ "GenSigStartValue" SG_ 3221225472 YRS_LongAccelVal 32768;
BA_ "UserSigValidity" SG_ 3221225472 YRS_LongAccelVal 3;
BA_ "RoutingFactor" SG_ 3221225472 YRS_LongAccelVal 5;
BA_ "Version" SG_ 3221225472 YRS_LongAccelVal "18.02.01";
BA_ "Description" SG_ 3221225472 YRS_SnsrTempVal "The temperature is measured on sensing element chip in ACU, so it may be different from the display indicator temperature of the vehicle.



Physical range: -68°C = 00h, +60 °C = 80h, +187°C = FFh



Quantization LSB: 1[°C/digit]



Temperature [°C]";
BA_ "GenSigStartValue" SG_ 3221225472 YRS_SnsrTempVal 68;
BA_ "UserSigValidity" SG_ 3221225472 YRS_SnsrTempVal 3;
BA_ "RoutingFactor" SG_ 3221225472 YRS_SnsrTempVal 5;
BA_ "Version" SG_ 3221225472 YRS_SnsrTempVal "18.02.01";
BA_ "Description" SG_ 3221225472 YRS_ImuSeralNumVal "IMU serial number in range of 



0x000000000000 = 0......0xFFFFFFFFFFFF



※ Start Value : Actual Value";
BA_ "UserSigValidity" SG_ 3221225472 YRS_ImuSeralNumVal 3;
BA_ "RoutingFactor" SG_ 3221225472 YRS_ImuSeralNumVal 5;
BA_ "Version" SG_ 3221225472 YRS_ImuSeralNumVal "17.12.00";
BA_ "Description" SG_ 3221225472 DAU_Crc2Val "The CRC checking process calculates the CRC over the entire data block, including the CRC result CRC Polynomial (0x1D) ,

Initial Value : 0x00, XOR value : 0x00

The mathematical expression to 8 bit CRC polynomial is given here. G(x) = x8 + x4 + x3 + x2 ";
BA_ "GenSigSendType" SG_ 3221225472 DAU_Crc2Val 4;
BA_ "GenSigStartValue" SG_ 3221225472 DAU_Crc2Val 255;
BA_ "UserSigValidity" SG_ 3221225472 DAU_Crc2Val 0;
BA_ "GenSigTimeoutTime" SG_ 3221225472 DAU_Crc2Val 1500;
BA_ "NetworkRequest" SG_ 3221225472 DAU_Crc2Val 0;
BA_ "NetworkRequestHoldingTime" SG_ 3221225472 DAU_Crc2Val 5000;
BA_ "Version" SG_ 3221225472 DAU_Crc2Val "17.11.00";
BA_ "Description" SG_ 3221225472 DAU_AlvCnt2Val "For the first transmission request for a data element the counter shall be initialized with 0 and shall be incremented by 1

for every subsequent send request. When the counter reaches the maximum value(0xE), then it shall restart with ? for the next sen";
BA_ "GenSigSendType" SG_ 3221225472 DAU_AlvCnt2Val 4;
BA_ "UserSigValidity" SG_ 3221225472 DAU_AlvCnt2Val 0;
BA_ "GenSigTimeoutTime" SG_ 3221225472 DAU_AlvCnt2Val 1500;
BA_ "NetworkRequest" SG_ 3221225472 DAU_AlvCnt2Val 0;
BA_ "NetworkRequestHoldingTime" SG_ 3221225472 DAU_AlvCnt2Val 5000;
BA_ "Version" SG_ 3221225472 DAU_AlvCnt2Val "17.11.00";
BA_ "Description" SG_ 3221225472 Mirror_OSMirFldOpt "-(Old)C_OSMirrFoldOption";
BA_ "GenSigSendType" SG_ 3221225472 Mirror_OSMirFldOpt 4;
BA_ "UserSigValidity" SG_ 3221225472 Mirror_OSMirFldOpt 0;
BA_ "GenSigTimeoutTime" SG_ 3221225472 Mirror_OSMirFldOpt 1500;
BA_ "NetworkRequest" SG_ 3221225472 Mirror_OSMirFldOpt 0;
BA_ "NetworkRequestHoldingTime" SG_ 3221225472 Mirror_OSMirFldOpt 5000;
BA_ "Version" SG_ 3221225472 Mirror_OSMirFldOpt "17.12.00";
BA_ "Description" SG_ 3221225472 Mirror_OSMirFldSta "- AVM Warning Indicator signal, PUDDLE LAMP 점/소등 구분 신호";
BA_ "GenSigSendType" SG_ 3221225472 Mirror_OSMirFldSta 4;
BA_ "UserSigValidity" SG_ 3221225472 Mirror_OSMirFldSta 0;
BA_ "GenSigTimeoutTime" SG_ 3221225472 Mirror_OSMirFldSta 1500;
BA_ "NetworkRequest" SG_ 3221225472 Mirror_OSMirFldSta 0;
BA_ "NetworkRequestHoldingTime" SG_ 3221225472 Mirror_OSMirFldSta 5000;
BA_ "Version" SG_ 3221225472 Mirror_OSMirFldSta "17.12.00";
BA_ "Description" SG_ 3221225472 Mirror_OSMirManualFldSta "PUDDLE LAMP 점/소등 구분 신호";
BA_ "GenSigSendType" SG_ 3221225472 Mirror_OSMirManualFldSta 4;
BA_ "UserSigValidity" SG_ 3221225472 Mirror_OSMirManualFldSta 0;
BA_ "GenSigTimeoutTime" SG_ 3221225472 Mirror_OSMirManualFldSta 1500;
BA_ "NetworkRequest" SG_ 3221225472 Mirror_OSMirManualFldSta 0;
BA_ "NetworkRequestHoldingTime" SG_ 3221225472 Mirror_OSMirManualFldSta 5000;
BA_ "Version" SG_ 3221225472 Mirror_OSMirManualFldSta "17.12.00";
BA_ "Description" SG_ 3221225472 Mirror_OSMirFldCtrlSta "PUDDLE LAMP 점/소등 구분 신호";
BA_ "GenSigSendType" SG_ 3221225472 Mirror_OSMirFldCtrlSta 4;
BA_ "UserSigValidity" SG_ 3221225472 Mirror_OSMirFldCtrlSta 0;
BA_ "GenSigTimeoutTime" SG_ 3221225472 Mirror_OSMirFldCtrlSta 1500;
BA_ "NetworkRequest" SG_ 3221225472 Mirror_OSMirFldCtrlSta 0;
BA_ "NetworkRequestHoldingTime" SG_ 3221225472 Mirror_OSMirFldCtrlSta 5000;
BA_ "Version" SG_ 3221225472 Mirror_OSMirFldCtrlSta "17.11.00";
BA_ "Description" SG_ 3221225472 Mirror_OSMirUnFldCtrlSta "PUDDLE LAMP 점/소등 구분 신호";
BA_ "GenSigSendType" SG_ 3221225472 Mirror_OSMirUnFldCtrlSta 4;
BA_ "UserSigValidity" SG_ 3221225472 Mirror_OSMirUnFldCtrlSta 0;
BA_ "GenSigTimeoutTime" SG_ 3221225472 Mirror_OSMirUnFldCtrlSta 1500;
BA_ "NetworkRequest" SG_ 3221225472 Mirror_OSMirUnFldCtrlSta 0;
BA_ "NetworkRequestHoldingTime" SG_ 3221225472 Mirror_OSMirUnFldCtrlSta 5000;
BA_ "Version" SG_ 3221225472 Mirror_OSMirUnFldCtrlSta "17.11.00";
BA_ "Description" SG_ 3221225472 Mirror_LHOMUOSMirFldCtrlSta "아웃사이드 미러 폴딩/언폴딩 상태 신호 (From LH OMU)";
BA_ "GenSigSendType" SG_ 3221225472 Mirror_LHOMUOSMirFldCtrlSta 4;
BA_ "UserSigValidity" SG_ 3221225472 Mirror_LHOMUOSMirFldCtrlSta 0;
BA_ "GenSigTimeoutTime" SG_ 3221225472 Mirror_LHOMUOSMirFldCtrlSta 1500;
BA_ "Version" SG_ 3221225472 Mirror_LHOMUOSMirFldCtrlSta "18.02.00";
BA_ "Description" SG_ 3221225472 Mirror_RHOMUOSMirFldCtrlSta "아웃사이드 미러 폴딩/언폴딩 상태 신호 (From RH OMU)";
BA_ "GenSigSendType" SG_ 3221225472 Mirror_RHOMUOSMirFldCtrlSta 4;
BA_ "UserSigValidity" SG_ 3221225472 Mirror_RHOMUOSMirFldCtrlSta 0;
BA_ "GenSigTimeoutTime" SG_ 3221225472 Mirror_RHOMUOSMirFldCtrlSta 1500;
BA_ "Version" SG_ 3221225472 Mirror_RHOMUOSMirFldCtrlSta "18.02.00";
BA_ "Description" SG_ 3221225472 Mirror_LHOutDrTempSnsrVal "Outdoor Temperature";
BA_ "GenSigSendType" SG_ 3221225472 Mirror_LHOutDrTempSnsrVal 4;
BA_ "UserSigValidity" SG_ 3221225472 Mirror_LHOutDrTempSnsrVal 0;
BA_ "GenSigTimeoutTime" SG_ 3221225472 Mirror_LHOutDrTempSnsrVal 1500;
BA_ "NetworkRequest" SG_ 3221225472 Mirror_LHOutDrTempSnsrVal 0;
BA_ "NetworkRequestHoldingTime" SG_ 3221225472 Mirror_LHOutDrTempSnsrVal 5000;
BA_ "Version" SG_ 3221225472 Mirror_LHOutDrTempSnsrVal "17.12.00";
BA_ "Description" SG_ 3221225472 DAU_Crc3Val "The CRC checking process calculates the CRC over the entire data block, including the CRC result CRC Polynomial (0x1D) ,

Initial Value : 0x00, XOR value : 0x00

The mathematical expression to 8 bit CRC polynomial is given here. G(x) = x8 + x4 + x3 + x2 ";
BA_ "GenSigSendType" SG_ 3221225472 DAU_Crc3Val 4;
BA_ "GenSigStartValue" SG_ 3221225472 DAU_Crc3Val 255;
BA_ "UserSigValidity" SG_ 3221225472 DAU_Crc3Val 0;
BA_ "GenSigTimeoutTime" SG_ 3221225472 DAU_Crc3Val 1500;
BA_ "NetworkRequest" SG_ 3221225472 DAU_Crc3Val 0;
BA_ "NetworkRequestHoldingTime" SG_ 3221225472 DAU_Crc3Val 5000;
BA_ "Version" SG_ 3221225472 DAU_Crc3Val "17.11.00";
BA_ "Description" SG_ 3221225472 DAU_AlvCnt3Val "For the first transmission request for a data element the counter shall be initialized with 0 and shall be incremented by 1

for every subsequent send request. When the counter reaches the maximum value(0xE), then it shall restart with ? for the next sen";
BA_ "GenSigSendType" SG_ 3221225472 DAU_AlvCnt3Val 4;
BA_ "UserSigValidity" SG_ 3221225472 DAU_AlvCnt3Val 0;
BA_ "GenSigTimeoutTime" SG_ 3221225472 DAU_AlvCnt3Val 1500;
BA_ "NetworkRequest" SG_ 3221225472 DAU_AlvCnt3Val 0;
BA_ "NetworkRequestHoldingTime" SG_ 3221225472 DAU_AlvCnt3Val 5000;
BA_ "Version" SG_ 3221225472 DAU_AlvCnt3Val "17.11.00";
BA_ "Description" SG_ 3221225472 IMS_DrvrImsSwSetSta "IMS Set switch on the driver side";
BA_ "GenSigSendType" SG_ 3221225472 IMS_DrvrImsSwSetSta 4;
BA_ "UserSigValidity" SG_ 3221225472 IMS_DrvrImsSwSetSta 0;
BA_ "GenSigTimeoutTime" SG_ 3221225472 IMS_DrvrImsSwSetSta 1500;
BA_ "NetworkRequest" SG_ 3221225472 IMS_DrvrImsSwSetSta 0;
BA_ "NetworkRequestHoldingTime" SG_ 3221225472 IMS_DrvrImsSwSetSta 5000;
BA_ "Version" SG_ 3221225472 IMS_DrvrImsSwSetSta "17.12.00";
BA_ "Description" SG_ 3221225472 IMS_DrvrImsSw1Sta "IMS 1 switch on the driver side";
BA_ "GenSigSendType" SG_ 3221225472 IMS_DrvrImsSw1Sta 4;
BA_ "UserSigValidity" SG_ 3221225472 IMS_DrvrImsSw1Sta 0;
BA_ "GenSigTimeoutTime" SG_ 3221225472 IMS_DrvrImsSw1Sta 1500;
BA_ "NetworkRequest" SG_ 3221225472 IMS_DrvrImsSw1Sta 0;
BA_ "NetworkRequestHoldingTime" SG_ 3221225472 IMS_DrvrImsSw1Sta 5000;
BA_ "Version" SG_ 3221225472 IMS_DrvrImsSw1Sta "17.12.00";
BA_ "Description" SG_ 3221225472 IMS_DrvrImsSw2Sta "IMS 2 switch on the driver side";
BA_ "GenSigSendType" SG_ 3221225472 IMS_DrvrImsSw2Sta 4;
BA_ "UserSigValidity" SG_ 3221225472 IMS_DrvrImsSw2Sta 0;
BA_ "GenSigTimeoutTime" SG_ 3221225472 IMS_DrvrImsSw2Sta 1500;
BA_ "NetworkRequest" SG_ 3221225472 IMS_DrvrImsSw2Sta 0;
BA_ "NetworkRequestHoldingTime" SG_ 3221225472 IMS_DrvrImsSw2Sta 5000;
BA_ "Version" SG_ 3221225472 IMS_DrvrImsSw2Sta "17.12.00";
BA_ "Description" SG_ 3221225472 IMS_DrvrImsSwSmrtSta "IMS Smart (or IMS 3) switch on the driver side";
BA_ "GenSigSendType" SG_ 3221225472 IMS_DrvrImsSwSmrtSta 4;
BA_ "UserSigValidity" SG_ 3221225472 IMS_DrvrImsSwSmrtSta 0;
BA_ "GenSigTimeoutTime" SG_ 3221225472 IMS_DrvrImsSwSmrtSta 1500;
BA_ "NetworkRequest" SG_ 3221225472 IMS_DrvrImsSwSmrtSta 0;
BA_ "NetworkRequestHoldingTime" SG_ 3221225472 IMS_DrvrImsSwSmrtSta 5000;
BA_ "Version" SG_ 3221225472 IMS_DrvrImsSwSmrtSta "17.12.00";
BA_ "Description" SG_ 3221225472 IMS_LHOSMirPlyBckSta "This siganl indicates O/S Mirror moving state for IMS.";
BA_ "GenSigSendType" SG_ 3221225472 IMS_LHOSMirPlyBckSta 4;
BA_ "UserSigValidity" SG_ 3221225472 IMS_LHOSMirPlyBckSta 0;
BA_ "GenSigTimeoutTime" SG_ 3221225472 IMS_LHOSMirPlyBckSta 1500;
BA_ "NetworkRequest" SG_ 3221225472 IMS_LHOSMirPlyBckSta 0;
BA_ "NetworkRequestHoldingTime" SG_ 3221225472 IMS_LHOSMirPlyBckSta 5000;
BA_ "Version" SG_ 3221225472 IMS_LHOSMirPlyBckSta "17.12.00";
BA_ "Description" SG_ 3221225472 DAU_Crc4Val "The CRC checking process calculates the CRC over the entire data block, including the CRC result CRC Polynomial (0x1D) ,

Initial Value : 0x00, XOR value : 0x00

The mathematical expression to 8 bit CRC polynomial is given here. G(x) = x8 + x4 + x3 + x2 ";
BA_ "GenSigSendType" SG_ 3221225472 DAU_Crc4Val 4;
BA_ "GenSigStartValue" SG_ 3221225472 DAU_Crc4Val 255;
BA_ "UserSigValidity" SG_ 3221225472 DAU_Crc4Val 0;
BA_ "GenSigTimeoutTime" SG_ 3221225472 DAU_Crc4Val 1500;
BA_ "NetworkRequest" SG_ 3221225472 DAU_Crc4Val 0;
BA_ "NetworkRequestHoldingTime" SG_ 3221225472 DAU_Crc4Val 5000;
BA_ "Version" SG_ 3221225472 DAU_Crc4Val "17.11.00";
BA_ "Description" SG_ 3221225472 DAU_AlvCnt4Val "For the first transmission request for a data element the counter shall be initialized with 0 and shall be incremented by 1

for every subsequent send request. When the counter reaches the maximum value(0xE), then it shall restart with ? for the next sen";
BA_ "GenSigSendType" SG_ 3221225472 DAU_AlvCnt4Val 4;
BA_ "UserSigValidity" SG_ 3221225472 DAU_AlvCnt4Val 0;
BA_ "GenSigTimeoutTime" SG_ 3221225472 DAU_AlvCnt4Val 1500;
BA_ "NetworkRequest" SG_ 3221225472 DAU_AlvCnt4Val 0;
BA_ "NetworkRequestHoldingTime" SG_ 3221225472 DAU_AlvCnt4Val 5000;
BA_ "Version" SG_ 3221225472 DAU_AlvCnt4Val "17.11.00";
BA_ "GenSigSendType" SG_ 3221225472 Window_AsstPwrWdwAutoSwSta 4;
BA_ "UserSigValidity" SG_ 3221225472 Window_AsstPwrWdwAutoSwSta 0;
BA_ "GenSigTimeoutTime" SG_ 3221225472 Window_AsstPwrWdwAutoSwSta 1500;
BA_ "NetworkRequest" SG_ 3221225472 Window_AsstPwrWdwAutoSwSta 0;
BA_ "NetworkRequestHoldingTime" SG_ 3221225472 Window_AsstPwrWdwAutoSwSta 5000;
BA_ "Version" SG_ 3221225472 Window_AsstPwrWdwAutoSwSta "17.12.00";
BA_ "Description" SG_ 3221225472 Window_AsstPwrWdwUpSwSta "-(Old)C_ASTPwdwMUpSWDAU";
BA_ "GenSigSendType" SG_ 3221225472 Window_AsstPwrWdwUpSwSta 4;
BA_ "UserSigValidity" SG_ 3221225472 Window_AsstPwrWdwUpSwSta 0;
BA_ "GenSigTimeoutTime" SG_ 3221225472 Window_AsstPwrWdwUpSwSta 1500;
BA_ "NetworkRequest" SG_ 3221225472 Window_AsstPwrWdwUpSwSta 0;
BA_ "NetworkRequestHoldingTime" SG_ 3221225472 Window_AsstPwrWdwUpSwSta 5000;
BA_ "Version" SG_ 3221225472 Window_AsstPwrWdwUpSwSta "17.12.00";
BA_ "Description" SG_ 3221225472 Window_AsstPwrWdwDnSwSta "-(Old)C_ASTPwdwAutoDownSWDAU";
BA_ "GenSigSendType" SG_ 3221225472 Window_AsstPwrWdwDnSwSta 4;
BA_ "UserSigValidity" SG_ 3221225472 Window_AsstPwrWdwDnSwSta 0;
BA_ "GenSigTimeoutTime" SG_ 3221225472 Window_AsstPwrWdwDnSwSta 1500;
BA_ "NetworkRequest" SG_ 3221225472 Window_AsstPwrWdwDnSwSta 0;
BA_ "NetworkRequestHoldingTime" SG_ 3221225472 Window_AsstPwrWdwDnSwSta 5000;
BA_ "Version" SG_ 3221225472 Window_AsstPwrWdwDnSwSta "17.12.00";
BA_ "GenSigSendType" SG_ 3221225472 Window_RrLftPwrWdwAutoSwSta 4;
BA_ "UserSigValidity" SG_ 3221225472 Window_RrLftPwrWdwAutoSwSta 0;
BA_ "GenSigTimeoutTime" SG_ 3221225472 Window_RrLftPwrWdwAutoSwSta 1500;
BA_ "NetworkRequest" SG_ 3221225472 Window_RrLftPwrWdwAutoSwSta 0;
BA_ "NetworkRequestHoldingTime" SG_ 3221225472 Window_RrLftPwrWdwAutoSwSta 5000;
BA_ "Version" SG_ 3221225472 Window_RrLftPwrWdwAutoSwSta "17.12.00";
BA_ "Description" SG_ 3221225472 Window_RrLftPwrWdwUpSwSta "-(Old)C_RLPwdwMUpSWDAU";
BA_ "GenSigSendType" SG_ 3221225472 Window_RrLftPwrWdwUpSwSta 4;
BA_ "UserSigValidity" SG_ 3221225472 Window_RrLftPwrWdwUpSwSta 0;
BA_ "GenSigTimeoutTime" SG_ 3221225472 Window_RrLftPwrWdwUpSwSta 1500;
BA_ "NetworkRequest" SG_ 3221225472 Window_RrLftPwrWdwUpSwSta 0;
BA_ "NetworkRequestHoldingTime" SG_ 3221225472 Window_RrLftPwrWdwUpSwSta 5000;
BA_ "Version" SG_ 3221225472 Window_RrLftPwrWdwUpSwSta "17.12.00";
BA_ "Description" SG_ 3221225472 Window_RrLftPwrWdwDnSwSta "-(Old)C_RLPwdwMDnSWDAU";
BA_ "GenSigSendType" SG_ 3221225472 Window_RrLftPwrWdwDnSwSta 4;
BA_ "UserSigValidity" SG_ 3221225472 Window_RrLftPwrWdwDnSwSta 0;
BA_ "GenSigTimeoutTime" SG_ 3221225472 Window_RrLftPwrWdwDnSwSta 1500;
BA_ "Version" SG_ 3221225472 Window_RrLftPwrWdwDnSwSta "17.12.00";
BA_ "GenSigSendType" SG_ 3221225472 Window_RrRtPwrWdwAutoSwSta 4;
BA_ "UserSigValidity" SG_ 3221225472 Window_RrRtPwrWdwAutoSwSta 0;
BA_ "GenSigTimeoutTime" SG_ 3221225472 Window_RrRtPwrWdwAutoSwSta 1500;
BA_ "Version" SG_ 3221225472 Window_RrRtPwrWdwAutoSwSta "17.12.00";
BA_ "Description" SG_ 3221225472 Window_RrRtPwrWdwUpSwSta "-(Old)C_RRPwdwMUpSWDAU";
BA_ "GenSigSendType" SG_ 3221225472 Window_RrRtPwrWdwUpSwSta 4;
BA_ "UserSigValidity" SG_ 3221225472 Window_RrRtPwrWdwUpSwSta 0;
BA_ "GenSigTimeoutTime" SG_ 3221225472 Window_RrRtPwrWdwUpSwSta 1500;
BA_ "NetworkRequest" SG_ 3221225472 Window_RrRtPwrWdwUpSwSta 0;
BA_ "NetworkRequestHoldingTime" SG_ 3221225472 Window_RrRtPwrWdwUpSwSta 5000;
BA_ "Version" SG_ 3221225472 Window_RrRtPwrWdwUpSwSta "17.12.00";
BA_ "Description" SG_ 3221225472 Window_RrRtPwrWdwDnSwSta "-(Old)C_RRPwdwMDownSWDAU";
BA_ "GenSigSendType" SG_ 3221225472 Window_RrRtPwrWdwDnSwSta 4;
BA_ "UserSigValidity" SG_ 3221225472 Window_RrRtPwrWdwDnSwSta 0;
BA_ "GenSigTimeoutTime" SG_ 3221225472 Window_RrRtPwrWdwDnSwSta 1500;
BA_ "NetworkRequest" SG_ 3221225472 Window_RrRtPwrWdwDnSwSta 0;
BA_ "NetworkRequestHoldingTime" SG_ 3221225472 Window_RrRtPwrWdwDnSwSta 5000;
BA_ "Version" SG_ 3221225472 Window_RrRtPwrWdwDnSwSta "17.12.00";
BA_ "Description" SG_ 3221225472 Window_PwrWdwMaintainSta "-C_PwdwMain";
BA_ "GenSigSendType" SG_ 3221225472 Window_PwrWdwMaintainSta 4;
BA_ "UserSigValidity" SG_ 3221225472 Window_PwrWdwMaintainSta 0;
BA_ "GenSigTimeoutTime" SG_ 3221225472 Window_PwrWdwMaintainSta 1500;
BA_ "NetworkRequest" SG_ 3221225472 Window_PwrWdwMaintainSta 0;
BA_ "NetworkRequestHoldingTime" SG_ 3221225472 Window_PwrWdwMaintainSta 5000;
BA_ "Version" SG_ 3221225472 Window_PwrWdwMaintainSta "17.12.00";
BA_ "GenSigSendType" SG_ 3221225472 Window_PwrWdwMvInhbtSta 4;
BA_ "UserSigValidity" SG_ 3221225472 Window_PwrWdwMvInhbtSta 0;
BA_ "GenSigTimeoutTime" SG_ 3221225472 Window_PwrWdwMvInhbtSta 1500;
BA_ "NetworkRequest" SG_ 3221225472 Window_PwrWdwMvInhbtSta 0;
BA_ "NetworkRequestHoldingTime" SG_ 3221225472 Window_PwrWdwMvInhbtSta 5000;
BA_ "Version" SG_ 3221225472 Window_PwrWdwMvInhbtSta "17.12.00";
BA_ "Description" SG_ 3221225472 YRS_Crc1Val "The CRC checking process calculates the CRC over the entire data block, including the CRC result.

- CRC Polynomial (0x1021) , Initial Value : 0xFFFF, XOR value : 0x0000

- The mathematical expression to 16 bit CRC polynomial is given here. G(x) = x16 + ";
BA_ "GenSigStartValue" SG_ 3221225472 YRS_Crc1Val 65535;
BA_ "UserSigValidity" SG_ 3221225472 YRS_Crc1Val 3;
BA_ "RoutingFactor" SG_ 3221225472 YRS_Crc1Val 5;
BA_ "Version" SG_ 3221225472 YRS_Crc1Val "17.12.03";
BA_ "Description" SG_ 3221225472 YRS_AlvCnt1Val "For the first transmission request for a data element the counter shall be initialized with 0 and shall be incremented by 1

for every subsequent send request. When the counter reaches the maximum value(0xFF), then it shall restart with ? for the next se";
BA_ "UserSigValidity" SG_ 3221225472 YRS_AlvCnt1Val 3;
BA_ "RoutingFactor" SG_ 3221225472 YRS_AlvCnt1Val 5;
BA_ "Version" SG_ 3221225472 YRS_AlvCnt1Val "17.12.03";
BA_ "Description" SG_ 3221225472 YRS_YawSigSta "This signal indicates failure status of yaw rate signal and yaw rate sensing element.



0000B : No failure 



xxx1B : Yrs_Yr failure



xx1xB : Initialization is running



x1xxB : Reserved



1xxxB : Reserved



This signal represents the physical err";
BA_ "GenSigStartValue" SG_ 3221225472 YRS_YawSigSta 2;
BA_ "UserSigValidity" SG_ 3221225472 YRS_YawSigSta 3;
BA_ "RoutingFactor" SG_ 3221225472 YRS_YawSigSta 5;
BA_ "Version" SG_ 3221225472 YRS_YawSigSta "18.02.01";
BA_ "Description" SG_ 3221225472 YRS_LatAccelSigSta "This signal indicates failure status of lateral acceleration signal and sensing element.



0000B : No failure



xxx1B : Yrs_LatAc failure



xx1xB : Initialization is running



x1xxB : Reserved



1xxxB : Reserved



This signal represents the physica";
BA_ "GenSigStartValue" SG_ 3221225472 YRS_LatAccelSigSta 2;
BA_ "UserSigValidity" SG_ 3221225472 YRS_LatAccelSigSta 3;
BA_ "RoutingFactor" SG_ 3221225472 YRS_LatAccelSigSta 5;
BA_ "Version" SG_ 3221225472 YRS_LatAccelSigSta "18.02.01";
BA_ "Description" SG_ 3221225472 YRS_LongAccelSigSta "This signal indicates failure status of longitudinal acceleration signal and sensing element.



0000B : No failure 



xxx1B : Yrs_LongAc failure



xx1xB : Initialization is running



x1xxB : Reserved



1xxxB : Reserved



This signal represents the ";
BA_ "GenSigStartValue" SG_ 3221225472 YRS_LongAccelSigSta 2;
BA_ "UserSigValidity" SG_ 3221225472 YRS_LongAccelSigSta 3;
BA_ "RoutingFactor" SG_ 3221225472 YRS_LongAccelSigSta 5;
BA_ "Version" SG_ 3221225472 YRS_LongAccelSigSta "18.02.01";
BA_ "Description" SG_ 3221225472 YRS_McuVoltSta "This signal indicates the failure status of MCU.



0000B : No failure



xxx1B : MCU failure



xx1xB : Under voltage detected



x1xxB : Over voltage detected



1xxxB : Bus off failure



The status information(xxx1B) occurs when MCU error is detected";
BA_ "UserSigValidity" SG_ 3221225472 YRS_McuVoltSta 3;
BA_ "RoutingFactor" SG_ 3221225472 YRS_McuVoltSta 5;
BA_ "Version" SG_ 3221225472 YRS_McuVoltSta "18.02.01";
BA_ "Description" SG_ 3221225472 YRS_AcuRstSta "This signal indicates the status of IMU.



0000B : Normal mode 



xxx1B : IMU Reset mode



xx1xB : Reserved



x1xxB : Reserved



1xxxB : Reserved



If ACU reset is required, ACU will send IMU RESET bit(XXX1B) up to 30 times and perform a reset. If ";
BA_ "UserSigValidity" SG_ 3221225472 YRS_AcuRstSta 3;
BA_ "RoutingFactor" SG_ 3221225472 YRS_AcuRstSta 5;
BA_ "Version" SG_ 3221225472 YRS_AcuRstSta "18.02.01";
BA_ "Description" SG_ 3221225472 YRS_SnsrTyp "This signal indicates supported signals that are correspond to sensor type.



0001B = YRS (yaw rate and lateral acceleration)



0010B = YRS (yaw rate, lateral and longitudinal acceleration)



All other values are reserved



※ Start Value : Actual Va";
BA_ "UserSigValidity" SG_ 3221225472 YRS_SnsrTyp 3;
BA_ "RoutingFactor" SG_ 3221225472 YRS_SnsrTyp 5;
BA_ "Version" SG_ 3221225472 YRS_SnsrTyp "17.12.00";
BA_ "Description" SG_ 3221225472 HSWS_SysWrngSta_ICU "0x0 : Normal

0x1 : System Fail

0x2 : Reserved

0x3 : Invalid";
BA_ "GenSigSendType" SG_ 3221225472 HSWS_SysWrngSta_ICU 4;
BA_ "UserSigValidity" SG_ 3221225472 HSWS_SysWrngSta_ICU 4;
BA_ "GenSigTimeoutTime" SG_ 3221225472 HSWS_SysWrngSta_ICU 1500;
BA_ "Version" SG_ 3221225472 HSWS_SysWrngSta_ICU "17.12.00";
BA_ "Description" SG_ 3221225472 HeatedSteerWheel_StrWhlHtrSwSta "This signal is used to sent information of current state of 

Steering Wheel Heated SW.

0x0:Off/0x1:On/0x2:Reserved/0x3:Invalid";
BA_ "GenSigSendType" SG_ 3221225472 HeatedSteerWheel_StrWhlHtrSwSta 4;
BA_ "GenSigStartValue" SG_ 3221225472 HeatedSteerWheel_StrWhlHtrSwSta 3;
BA_ "UserSigValidity" SG_ 3221225472 HeatedSteerWheel_StrWhlHtrSwSta 0;
BA_ "GenSigTimeoutTime" SG_ 3221225472 HeatedSteerWheel_StrWhlHtrSwSta 1500;
BA_ "Version" SG_ 3221225472 HeatedSteerWheel_StrWhlHtrSwSta "17.12.00";
BA_ "Description" SG_ 3221225472 DriveTypeOption "Drive Type Option

This signal is used to determine driver's seat position('Drive Type') about this vehicle.";
BA_ "GenSigSendType" SG_ 3221225472 DriveTypeOption 4;
BA_ "UserSigValidity" SG_ 3221225472 DriveTypeOption 0;
BA_ "GenSigTimeoutTime" SG_ 3221225472 DriveTypeOption 1500;
BA_ "NetworkRequest" SG_ 3221225472 DriveTypeOption 0;
BA_ "NetworkRequestHoldingTime" SG_ 3221225472 DriveTypeOption 5000;
BA_ "Version" SG_ 3221225472 DriveTypeOption "17.12.00";
BA_ "Description" SG_ 3221225472 Warn_RrLftSBRMATSwSta "Rear Left Seated State";
BA_ "GenSigSendType" SG_ 3221225472 Warn_RrLftSBRMATSwSta 4;
BA_ "UserSigValidity" SG_ 3221225472 Warn_RrLftSBRMATSwSta 0;
BA_ "GenSigTimeoutTime" SG_ 3221225472 Warn_RrLftSBRMATSwSta 1500;
BA_ "NetworkRequest" SG_ 3221225472 Warn_RrLftSBRMATSwSta 0;
BA_ "NetworkRequestHoldingTime" SG_ 3221225472 Warn_RrLftSBRMATSwSta 5000;
BA_ "Version" SG_ 3221225472 Warn_RrLftSBRMATSwSta "17.12.00";
BA_ "Description" SG_ 3221225472 Warn_RrRhtSBRMATSwSta "Rear Right Seated State";
BA_ "GenSigSendType" SG_ 3221225472 Warn_RrRhtSBRMATSwSta 4;
BA_ "UserSigValidity" SG_ 3221225472 Warn_RrRhtSBRMATSwSta 0;
BA_ "GenSigTimeoutTime" SG_ 3221225472 Warn_RrRhtSBRMATSwSta 1500;
BA_ "NetworkRequest" SG_ 3221225472 Warn_RrRhtSBRMATSwSta 0;
BA_ "NetworkRequestHoldingTime" SG_ 3221225472 Warn_RrRhtSBRMATSwSta 5000;
BA_ "Version" SG_ 3221225472 Warn_RrRhtSBRMATSwSta "17.12.00";
BA_ "Description" SG_ 3221225472 StrWheelAutoHeatSta "USM Response for Steering Wheel Auto Heat function";
BA_ "GenSigSendType" SG_ 3221225472 StrWheelAutoHeatSta 4;
BA_ "UserSigValidity" SG_ 3221225472 StrWheelAutoHeatSta 3;
BA_ "GenSigTimeoutTime" SG_ 3221225472 StrWheelAutoHeatSta 1500;
BA_ "Version" SG_ 3221225472 StrWheelAutoHeatSta "17.12.00";
BA_ "Description" SG_ 3221225472 StrWheelHeatIndSta "Indicator of StrgWheel heater";
BA_ "GenSigSendType" SG_ 3221225472 StrWheelHeatIndSta 4;
BA_ "UserSigValidity" SG_ 3221225472 StrWheelHeatIndSta 3;
BA_ "GenSigTimeoutTime" SG_ 3221225472 StrWheelHeatIndSta 1500;
BA_ "Version" SG_ 3221225472 StrWheelHeatIndSta "17.12.00";
BA_ "Description" SG_ 3221225472 Warn_LftSEA "Command for SEA LH Warning Text on cluster";
BA_ "GenSigSendType" SG_ 3221225472 Warn_LftSEA 4;
BA_ "UserSigValidity" SG_ 3221225472 Warn_LftSEA 0;
BA_ "GenSigTimeoutTime" SG_ 3221225472 Warn_LftSEA 1500;
BA_ "Version" SG_ 3221225472 Warn_LftSEA "17.12.00";
BA_ "Description" SG_ 3221225472 Warn_RhtSEA "Command for SEA RH Warning Text on cluster";
BA_ "GenSigSendType" SG_ 3221225472 Warn_RhtSEA 4;
BA_ "UserSigValidity" SG_ 3221225472 Warn_RhtSEA 0;
BA_ "GenSigTimeoutTime" SG_ 3221225472 Warn_RhtSEA 1500;
BA_ "Version" SG_ 3221225472 Warn_RhtSEA "17.12.00";
BA_ "Description" SG_ 3221225472 Lamp_FootLampOnReq "Foot Lamp Command";
BA_ "GenSigSendType" SG_ 3221225472 Lamp_FootLampOnReq 4;
BA_ "UserSigValidity" SG_ 3221225472 Lamp_FootLampOnReq 0;
BA_ "GenSigTimeoutTime" SG_ 3221225472 Lamp_FootLampOnReq 1500;
BA_ "NetworkRequest" SG_ 3221225472 Lamp_FootLampOnReq 0;
BA_ "NetworkRequestHoldingTime" SG_ 3221225472 Lamp_FootLampOnReq 5000;
BA_ "Version" SG_ 3221225472 Lamp_FootLampOnReq "17.12.00";
BA_ "Description" SG_ 3221225472 Lamp_MoodLampOnReq "Mood lamp command";
BA_ "GenSigSendType" SG_ 3221225472 Lamp_MoodLampOnReq 4;
BA_ "UserSigValidity" SG_ 3221225472 Lamp_MoodLampOnReq 0;
BA_ "GenSigTimeoutTime" SG_ 3221225472 Lamp_MoodLampOnReq 1500;
BA_ "NetworkRequest" SG_ 3221225472 Lamp_MoodLampOnReq 0;
BA_ "NetworkRequestHoldingTime" SG_ 3221225472 Lamp_MoodLampOnReq 5000;
BA_ "Version" SG_ 3221225472 Lamp_MoodLampOnReq "17.12.00";
BA_ "Description" SG_ 3221225472 ICU_PowerAutoCutModSta "ICU Delivery Mode State";
BA_ "GenSigSendType" SG_ 3221225472 ICU_PowerAutoCutModSta 4;
BA_ "UserSigValidity" SG_ 3221225472 ICU_PowerAutoCutModSta 3;
BA_ "GenSigTimeoutTime" SG_ 3221225472 ICU_PowerAutoCutModSta 1500;
BA_ "Version" SG_ 3221225472 ICU_PowerAutoCutModSta "17.12.00";
BA_ "Description" SG_ 3221225472 ICU_SoCBattStaMsgReq "Determine if soc level is warning or alert.";
BA_ "GenSigSendType" SG_ 3221225472 ICU_SoCBattStaMsgReq 4;
BA_ "GenSigStartValue" SG_ 3221225472 ICU_SoCBattStaMsgReq 3;
BA_ "UserSigValidity" SG_ 3221225472 ICU_SoCBattStaMsgReq 0;
BA_ "GenSigTimeoutTime" SG_ 3221225472 ICU_SoCBattStaMsgReq 1500;
BA_ "Version" SG_ 3221225472 ICU_SoCBattStaMsgReq "17.12.00";
BA_ "Description" SG_ 3221225472 DrvDrLockIND "Driver door lock indicator on/off signal";
BA_ "GenSigSendType" SG_ 3221225472 DrvDrLockIND 4;
BA_ "UserSigValidity" SG_ 3221225472 DrvDrLockIND 0;
BA_ "GenSigTimeoutTime" SG_ 3221225472 DrvDrLockIND 1500;
BA_ "Version" SG_ 3221225472 DrvDrLockIND "17.11.00";
BA_ "Description" SG_ 3221225472 Brake_SwSta_ICU "Brake Switch Status";
BA_ "GenSigSendType" SG_ 3221225472 Brake_SwSta_ICU 4;
BA_ "UserSigValidity" SG_ 3221225472 Brake_SwSta_ICU 0;
BA_ "GenSigTimeoutTime" SG_ 3221225472 Brake_SwSta_ICU 1500;
BA_ "NetworkRequest" SG_ 3221225472 Brake_SwSta_ICU 0;
BA_ "NetworkRequestHoldingTime" SG_ 3221225472 Brake_SwSta_ICU 5000;
BA_ "Version" SG_ 3221225472 Brake_SwSta_ICU "17.12.00";
BA_ "Description" SG_ 3221225472 C_3rdRRSBRMatSw "3rd Rear Right Seated State



-Default value: 0x0 (미탑승)

-Initial value: 0x0 (미탑승)

-Timeout value: 0x0 (미탑승)";
BA_ "GenSigSendType" SG_ 3221225472 C_3rdRRSBRMatSw 4;
BA_ "UserSigValidity" SG_ 3221225472 C_3rdRRSBRMatSw 0;
BA_ "GenSigTimeoutTime" SG_ 3221225472 C_3rdRRSBRMatSw 1500;
BA_ "NetworkRequest" SG_ 3221225472 C_3rdRRSBRMatSw 0;
BA_ "NetworkRequestHoldingTime" SG_ 3221225472 C_3rdRRSBRMatSw 5000;
BA_ "Version" SG_ 3221225472 C_3rdRRSBRMatSw "18.03.04";
BA_ "Description" SG_ 3221225472 C_3rdRLSBRMatSw "3rd Rear Left Seated State



-Default value: 0x0 (미탑승)

-Initial value: 0x0 (미탑승)

-Timeout value: 0x0 (미탑승)";
BA_ "GenSigSendType" SG_ 3221225472 C_3rdRLSBRMatSw 4;
BA_ "UserSigValidity" SG_ 3221225472 C_3rdRLSBRMatSw 0;
BA_ "GenSigTimeoutTime" SG_ 3221225472 C_3rdRLSBRMatSw 1500;
BA_ "NetworkRequest" SG_ 3221225472 C_3rdRLSBRMatSw 0;
BA_ "NetworkRequestHoldingTime" SG_ 3221225472 C_3rdRLSBRMatSw 5000;
BA_ "Version" SG_ 3221225472 C_3rdRLSBRMatSw "18.03.04";
BA_ "Description" SG_ 3221225472 C_3rdRRSeatBeltSW "3rd Rear Right Seat Belt Switch Status";
BA_ "GenSigSendType" SG_ 3221225472 C_3rdRRSeatBeltSW 4;
BA_ "UserSigValidity" SG_ 3221225472 C_3rdRRSeatBeltSW 0;
BA_ "GenSigTimeoutTime" SG_ 3221225472 C_3rdRRSeatBeltSW 1500;
BA_ "NetworkRequest" SG_ 3221225472 C_3rdRRSeatBeltSW 0;
BA_ "NetworkRequestHoldingTime" SG_ 3221225472 C_3rdRRSeatBeltSW 5000;
BA_ "Version" SG_ 3221225472 C_3rdRRSeatBeltSW "18.03.04";
BA_ "Description" SG_ 3221225472 C_3rdRLSeatBeltSW "3rd Rear Left Seat Belt Switch Status";
BA_ "GenSigSendType" SG_ 3221225472 C_3rdRLSeatBeltSW 4;
BA_ "UserSigValidity" SG_ 3221225472 C_3rdRLSeatBeltSW 0;
BA_ "GenSigTimeoutTime" SG_ 3221225472 C_3rdRLSeatBeltSW 1500;
BA_ "NetworkRequest" SG_ 3221225472 C_3rdRLSeatBeltSW 0;
BA_ "NetworkRequestHoldingTime" SG_ 3221225472 C_3rdRLSeatBeltSW 5000;
BA_ "Version" SG_ 3221225472 C_3rdRLSeatBeltSW "18.03.04";
BA_ "Description" SG_ 3221225472 BCM_Crc9Val "The CRC checking process calculates the CRC over the entire data block, including the CRC result CRC Polynomial (0x1D) ,

Initial Value : 0x00, XOR value : 0x00

The mathematical expression to 8 bit CRC polynomial is given here. G(x) = x8 + x4 + x3 + x2 ";
BA_ "GenSigSendType" SG_ 3221225472 BCM_Crc9Val 4;
BA_ "GenSigStartValue" SG_ 3221225472 BCM_Crc9Val 255;
BA_ "UserSigValidity" SG_ 3221225472 BCM_Crc9Val 0;
BA_ "GenSigTimeoutTime" SG_ 3221225472 BCM_Crc9Val 1500;
BA_ "Version" SG_ 3221225472 BCM_Crc9Val "17.11.00";
BA_ "Description" SG_ 3221225472 BCM_AlvCnt9Val "For the first transmission request for a data element the counter shall be initialized with 0 and shall be incremented by 1

for every subsequent send request. When the counter reaches the maximum value(0xE), then it shall restart with ? for the next sen";
BA_ "GenSigSendType" SG_ 3221225472 BCM_AlvCnt9Val 4;
BA_ "UserSigValidity" SG_ 3221225472 BCM_AlvCnt9Val 0;
BA_ "GenSigTimeoutTime" SG_ 3221225472 BCM_AlvCnt9Val 1500;
BA_ "Version" SG_ 3221225472 BCM_AlvCnt9Val "17.11.00";
BA_ "Description" SG_ 3221225472 Lamp_AutoLtSnsrNightSta "This signal indicates autolight sensor output";
BA_ "GenSigSendType" SG_ 3221225472 Lamp_AutoLtSnsrNightSta 4;
BA_ "UserSigValidity" SG_ 3221225472 Lamp_AutoLtSnsrNightSta 0;
BA_ "GenSigTimeoutTime" SG_ 3221225472 Lamp_AutoLtSnsrNightSta 1500;
BA_ "NetworkRequest" SG_ 3221225472 Lamp_AutoLtSnsrNightSta 0;
BA_ "NetworkRequestHoldingTime" SG_ 3221225472 Lamp_AutoLtSnsrNightSta 5000;
BA_ "Version" SG_ 3221225472 Lamp_AutoLtSnsrNightSta "17.12.00";
BA_ "Description" SG_ 3221225472 Lamp_AutoLtSnsrHorVal "This signal indicates autolight sensor output (for HUD)";
BA_ "GenSigSendType" SG_ 3221225472 Lamp_AutoLtSnsrHorVal 4;
BA_ "UserSigValidity" SG_ 3221225472 Lamp_AutoLtSnsrHorVal 0;
BA_ "GenSigTimeoutTime" SG_ 3221225472 Lamp_AutoLtSnsrHorVal 1500;
BA_ "NetworkRequest" SG_ 3221225472 Lamp_AutoLtSnsrHorVal 0;
BA_ "NetworkRequestHoldingTime" SG_ 3221225472 Lamp_AutoLtSnsrHorVal 5000;
BA_ "Version" SG_ 3221225472 Lamp_AutoLtSnsrHorVal "17.12.00";
BA_ "Description" SG_ 3221225472 ICU_Crc2Val "The CRC checking process calculates the CRC over the entire data block, including the CRC result CRC Polynomial (0x1D) ,

Initial Value : 0x00, XOR value : 0x00

The mathematical expression to 8 bit CRC polynomial is given here. G(x) = x8 + x4 + x3 + x2 ";
BA_ "GenSigSendType" SG_ 3221225472 ICU_Crc2Val 4;
BA_ "GenSigStartValue" SG_ 3221225472 ICU_Crc2Val 255;
BA_ "UserSigValidity" SG_ 3221225472 ICU_Crc2Val 0;
BA_ "GenSigTimeoutTime" SG_ 3221225472 ICU_Crc2Val 1500;
BA_ "Version" SG_ 3221225472 ICU_Crc2Val "17.11.00";
BA_ "Description" SG_ 3221225472 ICU_AlvCnt2Val "For the first transmission request for a data element the counter shall be initialized with 0 and shall be incremented by 1

for every subsequent send request. When the counter reaches the maximum value(0xE), then it shall restart with ? for the next sen";
BA_ "GenSigSendType" SG_ 3221225472 ICU_AlvCnt2Val 4;
BA_ "UserSigValidity" SG_ 3221225472 ICU_AlvCnt2Val 0;
BA_ "GenSigTimeoutTime" SG_ 3221225472 ICU_AlvCnt2Val 1500;
BA_ "Version" SG_ 3221225472 ICU_AlvCnt2Val "17.11.00";
BA_ "Description" SG_ 3221225472 Autocut_DlvryModSta "-(Old)C_SJB_DeliveryMode

-Initial value: 1";
BA_ "GenSigSendType" SG_ 3221225472 Autocut_DlvryModSta 4;
BA_ "GenSigStartValue" SG_ 3221225472 Autocut_DlvryModSta 1;
BA_ "UserSigValidity" SG_ 3221225472 Autocut_DlvryModSta 0;
BA_ "GenSigTimeoutTime" SG_ 3221225472 Autocut_DlvryModSta 1500;
BA_ "NetworkRequest" SG_ 3221225472 Autocut_DlvryModSta 0;
BA_ "NetworkRequestHoldingTime" SG_ 3221225472 Autocut_DlvryModSta 5000;
BA_ "Version" SG_ 3221225472 Autocut_DlvryModSta "17.12.00";
BA_ "GenSigSendType" SG_ 3221225472 DoorLock_AsstDrUnLkSta 4;
BA_ "UserSigValidity" SG_ 3221225472 DoorLock_AsstDrUnLkSta 0;
BA_ "GenSigTimeoutTime" SG_ 3221225472 DoorLock_AsstDrUnLkSta 1500;
BA_ "NetworkRequest" SG_ 3221225472 DoorLock_AsstDrUnLkSta 0;
BA_ "NetworkRequestHoldingTime" SG_ 3221225472 DoorLock_AsstDrUnLkSta 5000;
BA_ "Version" SG_ 3221225472 DoorLock_AsstDrUnLkSta "17.12.00";
BA_ "GenSigSendType" SG_ 3221225472 Warn_DrvDrSwSta 4;
BA_ "UserSigValidity" SG_ 3221225472 Warn_DrvDrSwSta 0;
BA_ "GenSigTimeoutTime" SG_ 3221225472 Warn_DrvDrSwSta 1500;
BA_ "NetworkRequest" SG_ 3221225472 Warn_DrvDrSwSta 0;
BA_ "NetworkRequestHoldingTime" SG_ 3221225472 Warn_DrvDrSwSta 5000;
BA_ "Version" SG_ 3221225472 Warn_DrvDrSwSta "17.12.00";
BA_ "GenSigSendType" SG_ 3221225472 DoorLock_RrLftDrUnLkSta 4;
BA_ "UserSigValidity" SG_ 3221225472 DoorLock_RrLftDrUnLkSta 0;
BA_ "GenSigTimeoutTime" SG_ 3221225472 DoorLock_RrLftDrUnLkSta 1500;
BA_ "NetworkRequest" SG_ 3221225472 DoorLock_RrLftDrUnLkSta 0;
BA_ "NetworkRequestHoldingTime" SG_ 3221225472 DoorLock_RrLftDrUnLkSta 5000;
BA_ "Version" SG_ 3221225472 DoorLock_RrLftDrUnLkSta "17.12.00";
BA_ "GenSigSendType" SG_ 3221225472 DoorLock_RrRtDrUnLkSta 4;
BA_ "UserSigValidity" SG_ 3221225472 DoorLock_RrRtDrUnLkSta 0;
BA_ "GenSigTimeoutTime" SG_ 3221225472 DoorLock_RrRtDrUnLkSta 1500;
BA_ "NetworkRequest" SG_ 3221225472 DoorLock_RrRtDrUnLkSta 0;
BA_ "NetworkRequestHoldingTime" SG_ 3221225472 DoorLock_RrRtDrUnLkSta 5000;
BA_ "Version" SG_ 3221225472 DoorLock_RrRtDrUnLkSta "17.12.00";
BA_ "GenSigSendType" SG_ 3221225472 Warn_AsstDrSwSta 4;
BA_ "UserSigValidity" SG_ 3221225472 Warn_AsstDrSwSta 0;
BA_ "GenSigTimeoutTime" SG_ 3221225472 Warn_AsstDrSwSta 1500;
BA_ "NetworkRequest" SG_ 3221225472 Warn_AsstDrSwSta 0;
BA_ "NetworkRequestHoldingTime" SG_ 3221225472 Warn_AsstDrSwSta 5000;
BA_ "Version" SG_ 3221225472 Warn_AsstDrSwSta "17.12.00";
BA_ "Description" SG_ 3221225472 Warn_AsstStBltSwSta "-Default value: 0x1 (Belt)



-Initial value: 0x1 (Belt)



-Timeout value: 0x1 (Belt)";
BA_ "GenSigSendType" SG_ 3221225472 Warn_AsstStBltSwSta 4;
BA_ "GenSigStartValue" SG_ 3221225472 Warn_AsstStBltSwSta 1;
BA_ "UserSigValidity" SG_ 3221225472 Warn_AsstStBltSwSta 0;
BA_ "GenSigTimeoutTime" SG_ 3221225472 Warn_AsstStBltSwSta 1500;
BA_ "NetworkRequest" SG_ 3221225472 Warn_AsstStBltSwSta 0;
BA_ "NetworkRequestHoldingTime" SG_ 3221225472 Warn_AsstStBltSwSta 5000;
BA_ "Version" SG_ 3221225472 Warn_AsstStBltSwSta "17.12.00";
BA_ "GenSigSendType" SG_ 3221225472 Warn_BrkFldSwSta 4;
BA_ "UserSigValidity" SG_ 3221225472 Warn_BrkFldSwSta 0;
BA_ "GenSigTimeoutTime" SG_ 3221225472 Warn_BrkFldSwSta 1500;
BA_ "NetworkRequest" SG_ 3221225472 Warn_BrkFldSwSta 0;
BA_ "NetworkRequestHoldingTime" SG_ 3221225472 Warn_BrkFldSwSta 5000;
BA_ "Version" SG_ 3221225472 Warn_BrkFldSwSta "17.12.00";
BA_ "GenSigSendType" SG_ 3221225472 Warn_DrvStBltSwSta 4;
BA_ "UserSigValidity" SG_ 3221225472 Warn_DrvStBltSwSta 0;
BA_ "GenSigTimeoutTime" SG_ 3221225472 Warn_DrvStBltSwSta 1500;
BA_ "NetworkRequest" SG_ 3221225472 Warn_DrvStBltSwSta 0;
BA_ "NetworkRequestHoldingTime" SG_ 3221225472 Warn_DrvStBltSwSta 5000;
BA_ "Version" SG_ 3221225472 Warn_DrvStBltSwSta "17.12.00";
BA_ "GenSigSendType" SG_ 3221225472 Warn_HoodSwSta 4;
BA_ "UserSigValidity" SG_ 3221225472 Warn_HoodSwSta 0;
BA_ "GenSigTimeoutTime" SG_ 3221225472 Warn_HoodSwSta 1500;
BA_ "NetworkRequest" SG_ 3221225472 Warn_HoodSwSta 0;
BA_ "NetworkRequestHoldingTime" SG_ 3221225472 Warn_HoodSwSta 5000;
BA_ "Version" SG_ 3221225472 Warn_HoodSwSta "17.12.00";
BA_ "Description" SG_ 3221225472 Warn_PassStOccSta "Passenger Seated State







-Default value: 0x0 (미탑승)



-Initial value: 0x0 (미탑승)



-Timeout value: 0x0 (미탑승)";
BA_ "GenSigSendType" SG_ 3221225472 Warn_PassStOccSta 4;
BA_ "UserSigValidity" SG_ 3221225472 Warn_PassStOccSta 0;
BA_ "GenSigTimeoutTime" SG_ 3221225472 Warn_PassStOccSta 1500;
BA_ "NetworkRequest" SG_ 3221225472 Warn_PassStOccSta 0;
BA_ "NetworkRequestHoldingTime" SG_ 3221225472 Warn_PassStOccSta 5000;
BA_ "Version" SG_ 3221225472 Warn_PassStOccSta "17.12.00";
BA_ "GenSigSendType" SG_ 3221225472 Warn_PrkngBrkSwSta 4;
BA_ "UserSigValidity" SG_ 3221225472 Warn_PrkngBrkSwSta 0;
BA_ "GenSigTimeoutTime" SG_ 3221225472 Warn_PrkngBrkSwSta 1500;
BA_ "NetworkRequest" SG_ 3221225472 Warn_PrkngBrkSwSta 0;
BA_ "NetworkRequestHoldingTime" SG_ 3221225472 Warn_PrkngBrkSwSta 5000;
BA_ "Version" SG_ 3221225472 Warn_PrkngBrkSwSta "17.12.00";
BA_ "GenSigSendType" SG_ 3221225472 Warn_RrCtrStBltSwSta 4;
BA_ "UserSigValidity" SG_ 3221225472 Warn_RrCtrStBltSwSta 0;
BA_ "GenSigTimeoutTime" SG_ 3221225472 Warn_RrCtrStBltSwSta 1500;
BA_ "NetworkRequest" SG_ 3221225472 Warn_RrCtrStBltSwSta 0;
BA_ "NetworkRequestHoldingTime" SG_ 3221225472 Warn_RrCtrStBltSwSta 5000;
BA_ "Version" SG_ 3221225472 Warn_RrCtrStBltSwSta "17.12.00";
BA_ "GenSigSendType" SG_ 3221225472 Warn_RrLftDrSwSta 4;
BA_ "UserSigValidity" SG_ 3221225472 Warn_RrLftDrSwSta 0;
BA_ "GenSigTimeoutTime" SG_ 3221225472 Warn_RrLftDrSwSta 1500;
BA_ "NetworkRequest" SG_ 3221225472 Warn_RrLftDrSwSta 0;
BA_ "NetworkRequestHoldingTime" SG_ 3221225472 Warn_RrLftDrSwSta 5000;
BA_ "Version" SG_ 3221225472 Warn_RrLftDrSwSta "17.12.00";
BA_ "GenSigSendType" SG_ 3221225472 Warn_RrLftStBltSwSta 4;
BA_ "UserSigValidity" SG_ 3221225472 Warn_RrLftStBltSwSta 0;
BA_ "GenSigTimeoutTime" SG_ 3221225472 Warn_RrLftStBltSwSta 1500;
BA_ "NetworkRequest" SG_ 3221225472 Warn_RrLftStBltSwSta 0;
BA_ "NetworkRequestHoldingTime" SG_ 3221225472 Warn_RrLftStBltSwSta 5000;
BA_ "Version" SG_ 3221225472 Warn_RrLftStBltSwSta "17.12.00";
BA_ "GenSigSendType" SG_ 3221225472 Warn_RrRtDrSwSta 4;
BA_ "UserSigValidity" SG_ 3221225472 Warn_RrRtDrSwSta 0;
BA_ "GenSigTimeoutTime" SG_ 3221225472 Warn_RrRtDrSwSta 1500;
BA_ "NetworkRequest" SG_ 3221225472 Warn_RrRtDrSwSta 0;
BA_ "NetworkRequestHoldingTime" SG_ 3221225472 Warn_RrRtDrSwSta 5000;
BA_ "Version" SG_ 3221225472 Warn_RrRtDrSwSta "17.12.00";
BA_ "GenSigSendType" SG_ 3221225472 Warn_RrRtStBltSwSta 4;
BA_ "UserSigValidity" SG_ 3221225472 Warn_RrRtStBltSwSta 0;
BA_ "GenSigTimeoutTime" SG_ 3221225472 Warn_RrRtStBltSwSta 1500;
BA_ "NetworkRequest" SG_ 3221225472 Warn_RrRtStBltSwSta 0;
BA_ "NetworkRequestHoldingTime" SG_ 3221225472 Warn_RrRtStBltSwSta 5000;
BA_ "Version" SG_ 3221225472 Warn_RrRtStBltSwSta "17.12.00";
BA_ "Description" SG_ 3221225472 Warn_HoodSwMemorySta "Hood swtich open->close information(memory)



This signal is for oil level warning lamp reset In case hood open->close when IG-OFF, 0x01 sent for 5 sec at next IG-ON";
BA_ "GenSigSendType" SG_ 3221225472 Warn_HoodSwMemorySta 4;
BA_ "UserSigValidity" SG_ 3221225472 Warn_HoodSwMemorySta 3;
BA_ "GenSigTimeoutTime" SG_ 3221225472 Warn_HoodSwMemorySta 1500;
BA_ "NetworkRequest" SG_ 3221225472 Warn_HoodSwMemorySta 0;
BA_ "NetworkRequestHoldingTime" SG_ 3221225472 Warn_HoodSwMemorySta 5000;
BA_ "Version" SG_ 3221225472 Warn_HoodSwMemorySta "17.12.00";
BA_ "Description" SG_ 3221225472 Warn_WshrFldSwSta "Washer Fluid Switch Signal

This signal indicates Washer Fluid Switch Signal

0x0:Off/0x1:On";
BA_ "GenSigSendType" SG_ 3221225472 Warn_WshrFldSwSta 4;
BA_ "UserSigValidity" SG_ 3221225472 Warn_WshrFldSwSta 3;
BA_ "GenSigTimeoutTime" SG_ 3221225472 Warn_WshrFldSwSta 1500;
BA_ "NetworkRequest" SG_ 3221225472 Warn_WshrFldSwSta 0;
BA_ "NetworkRequestHoldingTime" SG_ 3221225472 Warn_WshrFldSwSta 5000;
BA_ "Version" SG_ 3221225472 Warn_WshrFldSwSta "17.12.00";
BA_ "Description" SG_ 3221225472 ICU_Crc5Val "The CRC checking process calculates the CRC over the entire data block, including the CRC result CRC Polynomial (0x1D) ,

Initial Value : 0x00, XOR value : 0x00

The mathematical expression to 8 bit CRC polynomial is given here. G(x) = x8 + x4 + x3 + x2 ";
BA_ "GenSigSendType" SG_ 3221225472 ICU_Crc5Val 4;
BA_ "GenSigStartValue" SG_ 3221225472 ICU_Crc5Val 255;
BA_ "UserSigValidity" SG_ 3221225472 ICU_Crc5Val 0;
BA_ "GenSigTimeoutTime" SG_ 3221225472 ICU_Crc5Val 1500;
BA_ "Version" SG_ 3221225472 ICU_Crc5Val "17.11.00";
BA_ "Description" SG_ 3221225472 ICU_AlvCnt5Val "For the first transmission request for a data element the counter shall be initialized with 0 and shall be incremented by 1

for every subsequent send request. When the counter reaches the maximum value(0xE), then it shall restart with ? for the next sen";
BA_ "GenSigSendType" SG_ 3221225472 ICU_AlvCnt5Val 4;
BA_ "UserSigValidity" SG_ 3221225472 ICU_AlvCnt5Val 0;
BA_ "GenSigTimeoutTime" SG_ 3221225472 ICU_AlvCnt5Val 1500;
BA_ "Version" SG_ 3221225472 ICU_AlvCnt5Val "17.11.00";
BA_ "Description" SG_ 3221225472 Trunk_TrnkInReleaseSwSta "-Trunk Inner Release SW";
BA_ "GenSigSendType" SG_ 3221225472 Trunk_TrnkInReleaseSwSta 4;
BA_ "UserSigValidity" SG_ 3221225472 Trunk_TrnkInReleaseSwSta 0;
BA_ "GenSigTimeoutTime" SG_ 3221225472 Trunk_TrnkInReleaseSwSta 1500;
BA_ "NetworkRequest" SG_ 3221225472 Trunk_TrnkInReleaseSwSta 0;
BA_ "NetworkRequestHoldingTime" SG_ 3221225472 Trunk_TrnkInReleaseSwSta 5000;
BA_ "Version" SG_ 3221225472 Trunk_TrnkInReleaseSwSta "17.12.00";
BA_ "Description" SG_ 3221225472 Trunk_TrnkTlgtOutReleaseSwSta "-(Old)C_TRUNK_LID

-Trunk/Tailgate Outter Release SW";
BA_ "GenSigSendType" SG_ 3221225472 Trunk_TrnkTlgtOutReleaseSwSta 4;
BA_ "UserSigValidity" SG_ 3221225472 Trunk_TrnkTlgtOutReleaseSwSta 0;
BA_ "GenSigTimeoutTime" SG_ 3221225472 Trunk_TrnkTlgtOutReleaseSwSta 1500;
BA_ "NetworkRequest" SG_ 3221225472 Trunk_TrnkTlgtOutReleaseSwSta 0;
BA_ "NetworkRequestHoldingTime" SG_ 3221225472 Trunk_TrnkTlgtOutReleaseSwSta 5000;
BA_ "Version" SG_ 3221225472 Trunk_TrnkTlgtOutReleaseSwSta "17.12.00";
BA_ "Description" SG_ 3221225472 Trunk_TrnkTlgtSwSta "Full Lock SW Status Signal



(TailGate/TrunkLid Tpye all)



1. Luggage or Trunkroom Lamp On/Off



2. TailGate/TrunkLid Open Ind in cluster



3. Normal Open SW



  - SW Off: Full Lock(Full Close state)



  - SW On: ^Full Lock";
BA_ "GenSigSendType" SG_ 3221225472 Trunk_TrnkTlgtSwSta 4;
BA_ "UserSigValidity" SG_ 3221225472 Trunk_TrnkTlgtSwSta 0;
BA_ "GenSigTimeoutTime" SG_ 3221225472 Trunk_TrnkTlgtSwSta 1500;
BA_ "NetworkRequest" SG_ 3221225472 Trunk_TrnkTlgtSwSta 0;
BA_ "NetworkRequestHoldingTime" SG_ 3221225472 Trunk_TrnkTlgtSwSta 5000;
BA_ "Version" SG_ 3221225472 Trunk_TrnkTlgtSwSta "17.12.00";
BA_ "Description" SG_ 3221225472 Trunk_GlvBxTrnkLkSwSta "- Glove Box Trunk Lock SW";
BA_ "GenSigSendType" SG_ 3221225472 Trunk_GlvBxTrnkLkSwSta 4;
BA_ "UserSigValidity" SG_ 3221225472 Trunk_GlvBxTrnkLkSwSta 0;
BA_ "GenSigTimeoutTime" SG_ 3221225472 Trunk_GlvBxTrnkLkSwSta 1500;
BA_ "NetworkRequest" SG_ 3221225472 Trunk_GlvBxTrnkLkSwSta 0;
BA_ "NetworkRequestHoldingTime" SG_ 3221225472 Trunk_GlvBxTrnkLkSwSta 5000;
BA_ "Version" SG_ 3221225472 Trunk_GlvBxTrnkLkSwSta "17.12.00";
BA_ "Description" SG_ 3221225472 Trunk_TlgtFullOpnSwSta "Full Open SW Status Signal



(Power TailGate/TrunkLid Tpye or tailgate latch 2sw type)



* Normal Open SW



  - SW Off: ^Full Open



  - SW On: Full Open(Full Open state)";
BA_ "GenSigSendType" SG_ 3221225472 Trunk_TlgtFullOpnSwSta 4;
BA_ "UserSigValidity" SG_ 3221225472 Trunk_TlgtFullOpnSwSta 0;
BA_ "GenSigTimeoutTime" SG_ 3221225472 Trunk_TlgtFullOpnSwSta 1500;
BA_ "NetworkRequest" SG_ 3221225472 Trunk_TlgtFullOpnSwSta 0;
BA_ "NetworkRequestHoldingTime" SG_ 3221225472 Trunk_TlgtFullOpnSwSta 5000;
BA_ "Version" SG_ 3221225472 Trunk_TlgtFullOpnSwSta "17.12.00";
BA_ "Description" SG_ 3221225472 Trunk_OpnDiagSetSta "Trunk/TailGate open function diagnostic setting



 - Off : Normal mode



 - On : Restrict mode";
BA_ "GenSigSendType" SG_ 3221225472 Trunk_OpnDiagSetSta 4;
BA_ "UserSigValidity" SG_ 3221225472 Trunk_OpnDiagSetSta 0;
BA_ "GenSigTimeoutTime" SG_ 3221225472 Trunk_OpnDiagSetSta 1500;
BA_ "NetworkRequest" SG_ 3221225472 Trunk_OpnDiagSetSta 0;
BA_ "NetworkRequestHoldingTime" SG_ 3221225472 Trunk_OpnDiagSetSta 5000;
BA_ "Version" SG_ 3221225472 Trunk_OpnDiagSetSta "17.12.00";
BA_ "Description" SG_ 3221225472 USM_OneTouchTrnSigFuncSta "This signal is 



- For One Touch Turn Signal Function,



 the advanced version of One Touch triple turn signal



- Communicated with Cluster for setting USM



- Periodic Event Signal to notice current staus to USM of Cluster";
BA_ "GenSigSendType" SG_ 3221225472 USM_OneTouchTrnSigFuncSta 4;
BA_ "UserSigValidity" SG_ 3221225472 USM_OneTouchTrnSigFuncSta 0;
BA_ "GenSigTimeoutTime" SG_ 3221225472 USM_OneTouchTrnSigFuncSta 1500;
BA_ "NetworkRequest" SG_ 3221225472 USM_OneTouchTrnSigFuncSta 0;
BA_ "NetworkRequestHoldingTime" SG_ 3221225472 USM_OneTouchTrnSigFuncSta 5000;
BA_ "Version" SG_ 3221225472 USM_OneTouchTrnSigFuncSta "17.12.00";
BA_ "GenSigSendType" SG_ 3221225472 DoorLock_DrvDrUnLkSta 4;
BA_ "UserSigValidity" SG_ 3221225472 DoorLock_DrvDrUnLkSta 0;
BA_ "GenSigTimeoutTime" SG_ 3221225472 DoorLock_DrvDrUnLkSta 1500;
BA_ "NetworkRequest" SG_ 3221225472 DoorLock_DrvDrUnLkSta 0;
BA_ "NetworkRequestHoldingTime" SG_ 3221225472 DoorLock_DrvDrUnLkSta 5000;
BA_ "Version" SG_ 3221225472 DoorLock_DrvDrUnLkSta "17.12.00";
BA_ "Description" SG_ 3221225472 DoorLock_LkOutSta "- Door Lock or Unlock Output State 



0x0 : Off (Door lock/unlock output Off state)



0x1 : On (Door lock/unlock output On state)";
BA_ "GenSigSendType" SG_ 3221225472 DoorLock_LkOutSta 4;
BA_ "UserSigValidity" SG_ 3221225472 DoorLock_LkOutSta 0;
BA_ "GenSigTimeoutTime" SG_ 3221225472 DoorLock_LkOutSta 1500;
BA_ "NetworkRequest" SG_ 3221225472 DoorLock_LkOutSta 0;
BA_ "NetworkRequestHoldingTime" SG_ 3221225472 DoorLock_LkOutSta 5000;
BA_ "Version" SG_ 3221225472 DoorLock_LkOutSta "17.12.00";
BA_ "Description" SG_ 3221225472 Trunk_TrnkTlgtOpenOutput "Trunk/Tailgate Open Command

0x0:Off

0x1:On";
BA_ "GenSigSendType" SG_ 3221225472 Trunk_TrnkTlgtOpenOutput 4;
BA_ "UserSigValidity" SG_ 3221225472 Trunk_TrnkTlgtOpenOutput 0;
BA_ "GenSigTimeoutTime" SG_ 3221225472 Trunk_TrnkTlgtOpenOutput 1500;
BA_ "NetworkRequest" SG_ 3221225472 Trunk_TrnkTlgtOpenOutput 0;
BA_ "NetworkRequestHoldingTime" SG_ 3221225472 Trunk_TrnkTlgtOpenOutput 5000;
BA_ "Version" SG_ 3221225472 Trunk_TrnkTlgtOpenOutput "18.01.06";
BA_ "Description" SG_ 3221225472 TwoTrnUnLkOptTyp "-(Old)C_TTUnlockOpt";
BA_ "GenSigSendType" SG_ 3221225472 TwoTrnUnLkOptTyp 4;
BA_ "UserSigValidity" SG_ 3221225472 TwoTrnUnLkOptTyp 0;
BA_ "GenSigTimeoutTime" SG_ 3221225472 TwoTrnUnLkOptTyp 1500;
BA_ "NetworkRequest" SG_ 3221225472 TwoTrnUnLkOptTyp 0;
BA_ "NetworkRequestHoldingTime" SG_ 3221225472 TwoTrnUnLkOptTyp 5000;
BA_ "Version" SG_ 3221225472 TwoTrnUnLkOptTyp "17.12.03";
BA_ "GenSigSendType" SG_ 3221225472 Defog_DfgrRlySta 4;
BA_ "UserSigValidity" SG_ 3221225472 Defog_DfgrRlySta 0;
BA_ "GenSigTimeoutTime" SG_ 3221225472 Defog_DfgrRlySta 1500;
BA_ "NetworkRequest" SG_ 3221225472 Defog_DfgrRlySta 0;
BA_ "NetworkRequestHoldingTime" SG_ 3221225472 Defog_DfgrRlySta 5000;
BA_ "Version" SG_ 3221225472 Defog_DfgrRlySta "17.12.00";
BA_ "Description" SG_ 3221225472 SEA_ActvSta "Cluster pop-up when SEA function is activated";
BA_ "GenSigSendType" SG_ 3221225472 SEA_ActvSta 4;
BA_ "UserSigValidity" SG_ 3221225472 SEA_ActvSta 0;
BA_ "GenSigTimeoutTime" SG_ 3221225472 SEA_ActvSta 1500;
BA_ "NetworkRequest" SG_ 3221225472 SEA_ActvSta 0;
BA_ "NetworkRequestHoldingTime" SG_ 3221225472 SEA_ActvSta 5000;
BA_ "Version" SG_ 3221225472 SEA_ActvSta "17.12.00";
BA_ "Description" SG_ 3221225472 ChildLock_ActnFlSta "Child Lock actuation failed";
BA_ "GenSigSendType" SG_ 3221225472 ChildLock_ActnFlSta 4;
BA_ "UserSigValidity" SG_ 3221225472 ChildLock_ActnFlSta 0;
BA_ "GenSigTimeoutTime" SG_ 3221225472 ChildLock_ActnFlSta 1500;
BA_ "NetworkRequest" SG_ 3221225472 ChildLock_ActnFlSta 0;
BA_ "NetworkRequestHoldingTime" SG_ 3221225472 ChildLock_ActnFlSta 5000;
BA_ "Version" SG_ 3221225472 ChildLock_ActnFlSta "17.12.00";
BA_ "GenSigSendType" SG_ 3221225472 USM_AutoDrLkReq 4;
BA_ "UserSigValidity" SG_ 3221225472 USM_AutoDrLkReq 0;
BA_ "GenSigTimeoutTime" SG_ 3221225472 USM_AutoDrLkReq 1500;
BA_ "NetworkRequest" SG_ 3221225472 USM_AutoDrLkReq 0;
BA_ "NetworkRequestHoldingTime" SG_ 3221225472 USM_AutoDrLkReq 5000;
BA_ "Version" SG_ 3221225472 USM_AutoDrLkReq "17.12.00";
BA_ "GenSigSendType" SG_ 3221225472 USM_AutoDrUnLkReq 4;
BA_ "UserSigValidity" SG_ 3221225472 USM_AutoDrUnLkReq 0;
BA_ "GenSigTimeoutTime" SG_ 3221225472 USM_AutoDrUnLkReq 1500;
BA_ "NetworkRequest" SG_ 3221225472 USM_AutoDrUnLkReq 0;
BA_ "NetworkRequestHoldingTime" SG_ 3221225472 USM_AutoDrUnLkReq 5000;
BA_ "Version" SG_ 3221225472 USM_AutoDrUnLkReq "17.12.00";
BA_ "GenSigSendType" SG_ 3221225472 USM_TwoTrnUnLkCurrentSta 4;
BA_ "UserSigValidity" SG_ 3221225472 USM_TwoTrnUnLkCurrentSta 0;
BA_ "GenSigTimeoutTime" SG_ 3221225472 USM_TwoTrnUnLkCurrentSta 1500;
BA_ "NetworkRequest" SG_ 3221225472 USM_TwoTrnUnLkCurrentSta 0;
BA_ "NetworkRequestHoldingTime" SG_ 3221225472 USM_TwoTrnUnLkCurrentSta 5000;
BA_ "Version" SG_ 3221225472 USM_TwoTrnUnLkCurrentSta "17.12.00";
BA_ "Description" SG_ 3221225472 HWSW_SysSta "This signal indicates normal or failure status of HSWS. 



 - HSWS : Haptic Steering Warning System";
BA_ "GenSigSendType" SG_ 3221225472 HWSW_SysSta 4;
BA_ "UserSigValidity" SG_ 3221225472 HWSW_SysSta 3;
BA_ "GenSigTimeoutTime" SG_ 3221225472 HWSW_SysSta 1500;
BA_ "NetworkRequest" SG_ 3221225472 HWSW_SysSta 0;
BA_ "NetworkRequestHoldingTime" SG_ 3221225472 HWSW_SysSta 5000;
BA_ "Version" SG_ 3221225472 HWSW_SysSta "17.11.00";
BA_ "Description" SG_ 3221225472 SCM_PlyBckSta "This signal indicates the steering column playback status for IMS";
BA_ "GenSigSendType" SG_ 3221225472 SCM_PlyBckSta 4;
BA_ "UserSigValidity" SG_ 3221225472 SCM_PlyBckSta 0;
BA_ "GenSigTimeoutTime" SG_ 3221225472 SCM_PlyBckSta 1500;
BA_ "NetworkRequest" SG_ 3221225472 SCM_PlyBckSta 0;
BA_ "NetworkRequestHoldingTime" SG_ 3221225472 SCM_PlyBckSta 5000;
BA_ "Version" SG_ 3221225472 SCM_PlyBckSta "17.11.00";
BA_ "GenSigSendType" SG_ 3221225472 USM_CmdSta 4;
BA_ "UserSigValidity" SG_ 3221225472 USM_CmdSta 0;
BA_ "GenSigTimeoutTime" SG_ 3221225472 USM_CmdSta 1500;
BA_ "NetworkRequest" SG_ 3221225472 USM_CmdSta 0;
BA_ "NetworkRequestHoldingTime" SG_ 3221225472 USM_CmdSta 5000;
BA_ "Version" SG_ 3221225472 USM_CmdSta "17.11.00";
BA_ "GenSigSendType" SG_ 3221225472 SCM_HptWrngUSMSta 4;
BA_ "UserSigValidity" SG_ 3221225472 SCM_HptWrngUSMSta 0;
BA_ "GenSigTimeoutTime" SG_ 3221225472 SCM_HptWrngUSMSta 1500;
BA_ "NetworkRequest" SG_ 3221225472 SCM_HptWrngUSMSta 0;
BA_ "NetworkRequestHoldingTime" SG_ 3221225472 SCM_HptWrngUSMSta 5000;
BA_ "Version" SG_ 3221225472 SCM_HptWrngUSMSta "17.11.00";
BA_ "Description" SG_ 3221225472 AVH_Sta "This signal indicates whether the vehicle is held with hydraulic brake (service brake).";
BA_ "UserSigValidity" SG_ 3221225472 AVH_Sta 3;
BA_ "RoutingFactor" SG_ 3221225472 AVH_Sta 5;
BA_ "Version" SG_ 3221225472 AVH_Sta "17.12.00";
BA_ "Description" SG_ 3221225472 LDM_Sta "Information about ESC-Readiness to perform Dynamic Braking Function (DBF) or Automatic Vehicle Hold (AVH) which is requested by AVH switch.



LDM_STAT (0H)

 - EPB function : EPB is slave

LDM_STAT (1H)

 - EPB function : EPB stand alone";
BA_ "UserSigValidity" SG_ 3221225472 LDM_Sta 3;
BA_ "RoutingFactor" SG_ 3221225472 LDM_Sta 5;
BA_ "Version" SG_ 3221225472 LDM_Sta "17.12.00";
BA_ "Description" SG_ 3221225472 EPB_ActvReq "This signal indicates that an ESC requests EPB to activate braking. 



REQ_EPB_ACT (0H)

 - AVH status : Don’t care

REQ_EPB_ACT (1H)

 - AVH status : Active

REQ_EPB_ACT (2H)

 - AVH status : Active

REQ_EPB_ACT (3H)

 - AVH status : Disabled

(EPB St";
BA_ "UserSigValidity" SG_ 3221225472 EPB_ActvReq 3;
BA_ "RoutingFactor" SG_ 3221225472 EPB_ActvReq 5;
BA_ "Version" SG_ 3221225472 EPB_ActvReq "17.12.00";
BA_ "Description" SG_ 3221225472 EPB_StaReq "This signal indicates the validity of REQ_EPB_ACT (ESC request for EPB to activate braking) signal.";
BA_ "GenSigStartValue" SG_ 3221225472 EPB_StaReq 1;
BA_ "UserSigValidity" SG_ 3221225472 EPB_StaReq 3;
BA_ "RoutingFactor" SG_ 3221225472 EPB_StaReq 5;
BA_ "Version" SG_ 3221225472 EPB_StaReq "17.12.00";
BA_ "Description" SG_ 3221225472 ECD_ActvSta "ECD Active signal indicates whether ECD function is active (operating) or not.";
BA_ "UserSigValidity" SG_ 3221225472 ECD_ActvSta 3;
BA_ "RoutingFactor" SG_ 3221225472 ECD_ActvSta 5;
BA_ "Version" SG_ 3221225472 ECD_ActvSta "17.12.00";
BA_ "Description" SG_ 3221225472 AVH_CluDis "An ESC can show its information message to driver on a cluster or a display module with this signal.";
BA_ "UserSigValidity" SG_ 3221225472 AVH_CluDis 3;
BA_ "RoutingFactor" SG_ 3221225472 AVH_CluDis 5;
BA_ "Version" SG_ 3221225472 AVH_CluDis "17.12.00";
BA_ "Description" SG_ 3221225472 AVH_AlrmReq "This signal indicates that an ESC requests cluster or tone controller to ring the alarm according to the status of an ESC";
BA_ "UserSigValidity" SG_ 3221225472 AVH_AlrmReq 3;
BA_ "RoutingFactor" SG_ 3221225472 AVH_AlrmReq 5;
BA_ "Version" SG_ 3221225472 AVH_AlrmReq "17.12.00";
BA_ "Description" SG_ 3221225472 AVH_ActvStaLmpDis "This signal indicates AVH active status lamp request from ESC to cluster.";
BA_ "UserSigValidity" SG_ 3221225472 AVH_ActvStaLmpDis 3;
BA_ "RoutingFactor" SG_ 3221225472 AVH_ActvStaLmpDis 5;
BA_ "Version" SG_ 3221225472 AVH_ActvStaLmpDis "17.12.00";
BA_ "Description" SG_ 3221225472 AVH_LmpDis "Information about the status lamp request from ESC (AVH) to cluster.";
BA_ "UserSigValidity" SG_ 3221225472 AVH_LmpDis 3;
BA_ "RoutingFactor" SG_ 3221225472 AVH_LmpDis 5;
BA_ "Version" SG_ 3221225472 AVH_LmpDis "17.12.00";
BA_ "Description" SG_ 3221225472 AWD_CrdnShftTqLimVal "Interface signal between ABS/TCS/ESC and 4WD, demands 4WD cardan shaft torque limit.";
BA_ "GenSigStartValue" SG_ 3221225472 AWD_CrdnShftTqLimVal 64255;
BA_ "UserSigValidity" SG_ 3221225472 AWD_CrdnShftTqLimVal 3;
BA_ "RoutingFactor" SG_ 3221225472 AWD_CrdnShftTqLimVal 5;
BA_ "Version" SG_ 3221225472 AWD_CrdnShftTqLimVal "17.12.00";
BA_ "Description" SG_ 3221225472 AWD_CltchDtyLimVal "Interface signal between ABS/TCS/ESC and 4WD and demands 4WD clutch duty limit.";
BA_ "UserSigValidity" SG_ 3221225472 AWD_CltchDtyLimVal 3;
BA_ "RoutingFactor" SG_ 3221225472 AWD_CltchDtyLimVal 5;
BA_ "Version" SG_ 3221225472 AWD_CltchDtyLimVal "17.12.00";
BA_ "Description" SG_ 3221225472 AWD_TransmsnTqLimModSta "This signal indicates that Interface signal between ESC and 4WD, selecting cardan shaft torque limitation mode of 4WD.";
BA_ "UserSigValidity" SG_ 3221225472 AWD_TransmsnTqLimModSta 3;
BA_ "RoutingFactor" SG_ 3221225472 AWD_TransmsnTqLimModSta 5;
BA_ "Version" SG_ 3221225472 AWD_TransmsnTqLimModSta "17.12.00";
BA_ "Description" SG_ 3221225472 AWD_RrWhlDtyLimReq "This signal indicates that ESC request 4WD ECU to limit control duty of rear wheels for improvement of stability of a vehicle during ESC control.";
BA_ "UserSigValidity" SG_ 3221225472 AWD_RrWhlDtyLimReq 3;
BA_ "RoutingFactor" SG_ 3221225472 AWD_RrWhlDtyLimReq 5;
BA_ "Version" SG_ 3221225472 AWD_RrWhlDtyLimReq "17.12.00";
BA_ "Description" SG_ 3221225472 AWD_FastOpnCrdnShftCltchReq "Interface signal between ESC and 4WD, demands fast opening or torque limit of the 4WD cardan shaft clutch.";
BA_ "UserSigValidity" SG_ 3221225472 AWD_FastOpnCrdnShftCltchReq 3;
BA_ "RoutingFactor" SG_ 3221225472 AWD_FastOpnCrdnShftCltchReq 5;
BA_ "Version" SG_ 3221225472 AWD_FastOpnCrdnShftCltchReq "17.12.00";
BA_ "Description" SG_ 3221225472 DATC_Crc12Val "The CRC checking process calculates the CRC over the entire data block, including the CRC result.

- CRC Polynomial (0x1021) , Initial Value : 0xFFFF, XOR value : 0x0000

- The mathematical expression to 16 bit CRC polynomial is given here. G(x) = x16 + ";
BA_ "GenSigSendType" SG_ 3221225472 DATC_Crc12Val 4;
BA_ "GenSigStartValue" SG_ 3221225472 DATC_Crc12Val 65535;
BA_ "UserSigValidity" SG_ 3221225472 DATC_Crc12Val 3;
BA_ "GenSigTimeoutTime" SG_ 3221225472 DATC_Crc12Val 1500;
BA_ "Version" SG_ 3221225472 DATC_Crc12Val "17.11.00";
BA_ "Description" SG_ 3221225472 DATC_AlvCnt12Val "For the first transmission request for a data element the counter shall be initialized with 0 and shall be incremented by 1

for every subsequent send request. When the counter reaches the maximum value(0xFF), then it shall restart with ? for the next se";
BA_ "GenSigSendType" SG_ 3221225472 DATC_AlvCnt12Val 4;
BA_ "UserSigValidity" SG_ 3221225472 DATC_AlvCnt12Val 3;
BA_ "GenSigTimeoutTime" SG_ 3221225472 DATC_AlvCnt12Val 1500;
BA_ "Version" SG_ 3221225472 DATC_AlvCnt12Val "17.11.00";
BA_ "Description" SG_ 3221225472 DATC_StrWhlHtrSwReq "Steering Wheel heater S/W";
BA_ "GenSigSendType" SG_ 3221225472 DATC_StrWhlHtrSwReq 4;
BA_ "UserSigValidity" SG_ 3221225472 DATC_StrWhlHtrSwReq 7;
BA_ "GenSigTimeoutTime" SG_ 3221225472 DATC_StrWhlHtrSwReq 1500;
BA_ "Version" SG_ 3221225472 DATC_StrWhlHtrSwReq "17.11.00";
BA_ "Description" SG_ 3221225472 DATC_FRStHtrSwReq "Front Right Seat heater S/W";
BA_ "GenSigSendType" SG_ 3221225472 DATC_FRStHtrSwReq 4;
BA_ "UserSigValidity" SG_ 3221225472 DATC_FRStHtrSwReq 7;
BA_ "GenSigTimeoutTime" SG_ 3221225472 DATC_FRStHtrSwReq 1500;
BA_ "Version" SG_ 3221225472 DATC_FRStHtrSwReq "17.11.00";
BA_ "Description" SG_ 3221225472 DATC_FRStVentSwReq "Front Right Seat cooler S/W";
BA_ "GenSigSendType" SG_ 3221225472 DATC_FRStVentSwReq 4;
BA_ "UserSigValidity" SG_ 3221225472 DATC_FRStVentSwReq 7;
BA_ "GenSigTimeoutTime" SG_ 3221225472 DATC_FRStVentSwReq 1500;
BA_ "Version" SG_ 3221225472 DATC_FRStVentSwReq "17.11.00";
BA_ "Description" SG_ 3221225472 DATC_FLStOpReq "Left Seat warmer / Ventilation Operation request";
BA_ "GenSigSendType" SG_ 3221225472 DATC_FLStOpReq 4;
BA_ "UserSigValidity" SG_ 3221225472 DATC_FLStOpReq 7;
BA_ "GenSigTimeoutTime" SG_ 3221225472 DATC_FLStOpReq 1500;
BA_ "Version" SG_ 3221225472 DATC_FLStOpReq "17.11.00";
BA_ "Description" SG_ 3221225472 DATC_FLStHtrSwReq "Front Left Seat heater S/W";
BA_ "GenSigSendType" SG_ 3221225472 DATC_FLStHtrSwReq 4;
BA_ "UserSigValidity" SG_ 3221225472 DATC_FLStHtrSwReq 7;
BA_ "GenSigTimeoutTime" SG_ 3221225472 DATC_FLStHtrSwReq 1500;
BA_ "Version" SG_ 3221225472 DATC_FLStHtrSwReq "17.11.00";
BA_ "Description" SG_ 3221225472 DATC_FLStVentSwReq "Front Left Seat cooler S/W";
BA_ "GenSigSendType" SG_ 3221225472 DATC_FLStVentSwReq 4;
BA_ "UserSigValidity" SG_ 3221225472 DATC_FLStVentSwReq 7;
BA_ "GenSigTimeoutTime" SG_ 3221225472 DATC_FLStVentSwReq 1500;
BA_ "Version" SG_ 3221225472 DATC_FLStVentSwReq "17.11.00";
BA_ "Description" SG_ 3221225472 DATC_RRStHtrSwReq "This signal indicate DATC Rear Right Seat Heater Switch Request";
BA_ "GenSigSendType" SG_ 3221225472 DATC_RRStHtrSwReq 4;
BA_ "UserSigValidity" SG_ 3221225472 DATC_RRStHtrSwReq 7;
BA_ "GenSigTimeoutTime" SG_ 3221225472 DATC_RRStHtrSwReq 1500;
BA_ "Version" SG_ 3221225472 DATC_RRStHtrSwReq "18.03.05";
BA_ "Description" SG_ 3221225472 DATC_RRStVentSwReq "This signal indicates DATC Rear Right Seat Ventilation Switch Request";
BA_ "GenSigSendType" SG_ 3221225472 DATC_RRStVentSwReq 4;
BA_ "UserSigValidity" SG_ 3221225472 DATC_RRStVentSwReq 7;
BA_ "GenSigTimeoutTime" SG_ 3221225472 DATC_RRStVentSwReq 1500;
BA_ "Version" SG_ 3221225472 DATC_RRStVentSwReq "18.03.05";
BA_ "Description" SG_ 3221225472 DATC_RLStHtrSwReq "This signal indicates DATC Rear Left Seat Heater Switch Request";
BA_ "GenSigSendType" SG_ 3221225472 DATC_RLStHtrSwReq 4;
BA_ "UserSigValidity" SG_ 3221225472 DATC_RLStHtrSwReq 7;
BA_ "GenSigTimeoutTime" SG_ 3221225472 DATC_RLStHtrSwReq 1500;
BA_ "Version" SG_ 3221225472 DATC_RLStHtrSwReq "18.03.05";
BA_ "Description" SG_ 3221225472 DATC_RLStVentSwReq "This signal indicates DATC Rear Left Seat Ventilation Switch Request";
BA_ "GenSigSendType" SG_ 3221225472 DATC_RLStVentSwReq 4;
BA_ "UserSigValidity" SG_ 3221225472 DATC_RLStVentSwReq 7;
BA_ "GenSigTimeoutTime" SG_ 3221225472 DATC_RLStVentSwReq 1500;
BA_ "Version" SG_ 3221225472 DATC_RLStVentSwReq "18.03.05";
BA_ "Description" SG_ 3221225472 TCS_DisableSta "Information regarding the TCS 'enable/disable' indication.



Conversion :

1. TCS_DEF(0)/TCS_PAS(0)/TCS_CTL(0) -> TCS lamp OFF

2. TCS_DEF(0)/TCS_PAS(0)/TCS_CTL(1) -> TCS Active

3. TCS_DEF(0)/TCS_PAS(1)/TCS_CTL(x) -> TCS is disabled by user

4. TCS_DEF";
BA_ "UserSigValidity" SG_ 3221225472 TCS_DisableSta 3;
BA_ "RoutingFactor" SG_ 3221225472 TCS_DisableSta 5;
BA_ "Version" SG_ 3221225472 TCS_DisableSta "17.12.00";
BA_ "Description" SG_ 3221225472 TCS_DfctvSta "Information regarding the TCS 'defective' indication.



Conversion :

1. TCS_DEF(0)/TCS_PAS(0)/TCS_CTL(0) -> TCS lamp OFF

2. TCS_DEF(0)/TCS_PAS(0)/TCS_CTL(1) -> TCS Active

3. TCS_DEF(0)/TCS_PAS(1)/TCS_CTL(x) -> TCS is disabled by user

4. TCS_DEF(1)/T";
BA_ "UserSigValidity" SG_ 3221225472 TCS_DfctvSta 3;
BA_ "RoutingFactor" SG_ 3221225472 TCS_DfctvSta 5;
BA_ "Version" SG_ 3221225472 TCS_DfctvSta "17.12.00";
BA_ "Description" SG_ 3221225472 TCS_CtrlSta "Information regarding the TCS 'control' indication.



Conversion :

1. TCS_DEF(0)/TCS_PAS(0)/TCS_CTL(0) -> TCS lamp OFF

2. TCS_DEF(0)/TCS_PAS(0)/TCS_CTL(1) -> TCS Active

3. TCS_DEF(0)/TCS_PAS(1)/TCS_CTL(x) -> TCS is disabled by user

4. TCS_DEF(1)/TCS";
BA_ "UserSigValidity" SG_ 3221225472 TCS_CtrlSta 3;
BA_ "RoutingFactor" SG_ 3221225472 TCS_CtrlSta 5;
BA_ "Version" SG_ 3221225472 TCS_CtrlSta "17.12.00";
BA_ "Description" SG_ 3221225472 ESC_DisableSta "Information regarding the ESC 'enable/disable' indication.



Conversion:

1. ESP_DEF(0)/ESP_PAS(0)/ESP_CTL(0) -> ESC lamp OFF

2. ESP_DEF(0)/ESP_PAS(0)/ESP_CTL(1) -> ESC active

3. ESP_DEF(0)/ESP_PAS(1)/ESP_CTL(x) -> ESC disabled by user (SW off)

4. ES";
BA_ "UserSigValidity" SG_ 3221225472 ESC_DisableSta 3;
BA_ "RoutingFactor" SG_ 3221225472 ESC_DisableSta 5;
BA_ "Version" SG_ 3221225472 ESC_DisableSta "17.12.00";
BA_ "Description" SG_ 3221225472 ESC_DfctvSta "Information regarding the ESC 'defective' indication.



Conversion:

1. ESP_DEF(0)/ESP_PAS(0)/ESP_CTL(0) -> ESC lamp OFF

2. ESP_DEF(0)/ESP_PAS(0)/ESP_CTL(1) -> ESC active

3. ESP_DEF(0)/ESP_PAS(1)/ESP_CTL(x) -> ESC disabled by user (SW off)

4. ESP_DEF";
BA_ "UserSigValidity" SG_ 3221225472 ESC_DfctvSta 3;
BA_ "RoutingFactor" SG_ 3221225472 ESC_DfctvSta 5;
BA_ "Version" SG_ 3221225472 ESC_DfctvSta "17.12.00";
BA_ "Description" SG_ 3221225472 ESC_CtrlSta "Information regarding the ESC 'control' indication.



Conversion:

1. ESP_DEF(0)/ESP_PAS(0)/ESP_CTL(0) -> ESC lamp OFF

2. ESP_DEF(0)/ESP_PAS(0)/ESP_CTL(1) -> ESC active

3. ESP_DEF(0)/ESP_PAS(1)/ESP_CTL(x) -> ESC disabled by user (SW off)

4. ESP_DEF(1";
BA_ "UserSigValidity" SG_ 3221225472 ESC_CtrlSta 3;
BA_ "RoutingFactor" SG_ 3221225472 ESC_CtrlSta 5;
BA_ "Version" SG_ 3221225472 ESC_CtrlSta "17.12.00";
BA_ "Description" SG_ 3221225472 TCS_PreActvSta "Pre TCS Control Signal";
BA_ "UserSigValidity" SG_ 3221225472 TCS_PreActvSta 3;
BA_ "RoutingFactor" SG_ 3221225472 TCS_PreActvSta 5;
BA_ "Version" SG_ 3221225472 TCS_PreActvSta "17.12.00";
BA_ "Description" SG_ 3221225472 DBC_StdbySta "This signal indicates the information regarding the DBC “enable/disable” indicator



Conversion:

1. DBC_DEF(0)/DBC_PAS(0)/DBC_CTL(0) -> DBC is not applied

2. DBC_DEF(0)/DBC_PAS(x)/DBC_CTL(1) -> DBC is Active

3. DBC_DEF(0)/DBC_PAS(1)/DBC_CTL(0) -> D";
BA_ "UserSigValidity" SG_ 3221225472 DBC_StdbySta 3;
BA_ "RoutingFactor" SG_ 3221225472 DBC_StdbySta 5;
BA_ "Version" SG_ 3221225472 DBC_StdbySta "17.12.00";
BA_ "Description" SG_ 3221225472 DBC_DfctvSta "This signal indicates the information regarding the DBC “defective” indicator



Conversion:

1. DBC_DEF(0)/DBC_PAS(0)/DBC_CTL(0) -> DBC is not applied

2. DBC_DEF(0)/DBC_PAS(x)/DBC_CTL(1) -> DBC is Active

3. DBC_DEF(0)/DBC_PAS(1)/DBC_CTL(0) -> DBC is";
BA_ "UserSigValidity" SG_ 3221225472 DBC_DfctvSta 3;
BA_ "RoutingFactor" SG_ 3221225472 DBC_DfctvSta 5;
BA_ "Version" SG_ 3221225472 DBC_DfctvSta "17.12.00";
BA_ "Description" SG_ 3221225472 DBC_CtrlSta "This signal indicates the information regarding the DBC “control” indicator



Conversion:

1. DBC_DEF(0)/DBC_PAS(0)/DBC_CTL(0) -> DBC is not applied

2. DBC_DEF(0)/DBC_PAS(x)/DBC_CTL(1) -> DBC is Active

3. DBC_DEF(0)/DBC_PAS(1)/DBC_CTL(0) -> DBC is s";
BA_ "UserSigValidity" SG_ 3221225472 DBC_CtrlSta 3;
BA_ "RoutingFactor" SG_ 3221225472 DBC_CtrlSta 5;
BA_ "Version" SG_ 3221225472 DBC_CtrlSta "17.12.00";
BA_ "Description" SG_ 3221225472 HAC_StdbySta "This signal indicates the information regarding the HAC “enable/disable” indicator



Conversion:

1. HAC_DEF(0)/HAC_PAS(0)/HAC_CTL(0) -> HAC is not applied

2. HAC_DEF(0)/HAC_PAS(x)/HAC_CTL(1) -> HAC is Active

3. HAC_DEF(0)/HAC_PAS(1)/HAC_CTL(0) -> H";
BA_ "UserSigValidity" SG_ 3221225472 HAC_StdbySta 3;
BA_ "RoutingFactor" SG_ 3221225472 HAC_StdbySta 5;
BA_ "Version" SG_ 3221225472 HAC_StdbySta "17.12.00";
BA_ "Description" SG_ 3221225472 HAC_DfctvSta "This signal indicates the information regarding the HAC 'defective' indicator



Conversion:

1. HAC_DEF(0)/HAC_PAS(0)/HAC_CTL(0) -> HAC is not applied

2. HAC_DEF(0)/HAC_PAS(x)/HAC_CTL(1) -> HAC is Active

3. HAC_DEF(0)/HAC_PAS(1)/HAC_CTL(0) -> HAC is s";
BA_ "UserSigValidity" SG_ 3221225472 HAC_DfctvSta 3;
BA_ "RoutingFactor" SG_ 3221225472 HAC_DfctvSta 5;
BA_ "Version" SG_ 3221225472 HAC_DfctvSta "17.12.00";
BA_ "Description" SG_ 3221225472 HAC_CtrlSta "This signal indicates the information regarding the HAC 'control' indicator



Conversion:

1. HAC_DEF(0)/HAC_PAS(0)/HAC_CTL(0) -> HAC is not applied

2. HAC_DEF(0)/HAC_PAS(x)/HAC_CTL(1) -> HAC is Active

3. HAC_DEF(0)/HAC_PAS(1)/HAC_CTL(0) -> HAC is sta";
BA_ "UserSigValidity" SG_ 3221225472 HAC_CtrlSta 3;
BA_ "RoutingFactor" SG_ 3221225472 HAC_CtrlSta 5;
BA_ "Version" SG_ 3221225472 HAC_CtrlSta "17.12.00";
BA_ "Description" SG_ 3221225472 TCS_Req "Request for an indicated desired engine torque, the combination of signals calls, on the one hand, for a desire for charge reduction (TCS or ESC function), and, on the other hand, for a desire for charge increase (MSR function).



TCS_REQ : Identifies a";
BA_ "UserSigValidity" SG_ 3221225472 TCS_Req 3;
BA_ "RoutingFactor" SG_ 3221225472 TCS_Req 5;
BA_ "Version" SG_ 3221225472 TCS_Req "17.12.00";
BA_ "Description" SG_ 3221225472 MSR_FuncReq "Request for an indicated desired engine torque, the combination of signals calls, on the one hand, for a desire for charge reduction (TCS or ESC function), and, on the other hand, for a desire for charge increase (MSR function).



MSR_C_REQ : Identifies";
BA_ "UserSigValidity" SG_ 3221225472 MSR_FuncReq 3;
BA_ "RoutingFactor" SG_ 3221225472 MSR_FuncReq 5;
BA_ "Version" SG_ 3221225472 MSR_FuncReq "17.12.00";
BA_ "Description" SG_ 3221225472 TCS_GearShftCharacteristicVal "Interface signal between TCS/ESC and TCU influencing the TCU switching characteristics in the case of an TCS control system.";
BA_ "UserSigValidity" SG_ 3221225472 TCS_GearShftCharacteristicVal 3;
BA_ "RoutingFactor" SG_ 3221225472 TCS_GearShftCharacteristicVal 5;
BA_ "Version" SG_ 3221225472 TCS_GearShftCharacteristicVal "17.12.00";
BA_ "Description" SG_ 3221225472 TCS_ManufacturerVal "TCS manufacturer information to distinguish between a system which requires only TQI_TCS function and a system which requires both TQI_TCS and TQI_SLW_TCS functions. This signal indicates that TCS requests torque reduction using only TQI_TCS or using bot";
BA_ "UserSigValidity" SG_ 3221225472 TCS_ManufacturerVal 3;
BA_ "RoutingFactor" SG_ 3221225472 TCS_ManufacturerVal 5;
BA_ "Version" SG_ 3221225472 TCS_ManufacturerVal "17.12.00";
BA_ "Description" SG_ 3221225472 TCS_TqIntrvntnVal "Request for an indicated desired engine torque, the combination of signals calls, on the one hand, for a desire for charge reduction (TCS or ESC function), and, on the other hand, for a desire for charge increase (MSR function).



TQI_TCS : Torque reduc";
BA_ "GenSigStartValue" SG_ 3221225472 TCS_TqIntrvntnVal 255;
BA_ "UserSigValidity" SG_ 3221225472 TCS_TqIntrvntnVal 3;
BA_ "RoutingFactor" SG_ 3221225472 TCS_TqIntrvntnVal 5;
BA_ "Version" SG_ 3221225472 TCS_TqIntrvntnVal "17.12.00";
BA_ "Description" SG_ 3221225472 MSR_TqIntrvntnVal "Request for an indicated desired engine torque, the combination of signals calls, on the one hand, for a desire for charge reduction (TCS or ESC function), and, on the other hand, for a desire for charge increase (MSR function).



TQI_MSR : The torque i";
BA_ "UserSigValidity" SG_ 3221225472 MSR_TqIntrvntnVal 3;
BA_ "RoutingFactor" SG_ 3221225472 MSR_TqIntrvntnVal 5;
BA_ "Version" SG_ 3221225472 MSR_TqIntrvntnVal "17.12.00";
BA_ "Description" SG_ 3221225472 TCS_SlwTqIntrvntnVal "Request for an indicated desired engine torque, the combination of signals calls, on the one hand, for a desire for charge reduction (TCS or ESC function), and, on the other hand, for a desire for charge increase (MSR function).



TQI_SLW_TCS : The driv";
BA_ "GenSigStartValue" SG_ 3221225472 TCS_SlwTqIntrvntnVal 255;
BA_ "UserSigValidity" SG_ 3221225472 TCS_SlwTqIntrvntnVal 3;
BA_ "RoutingFactor" SG_ 3221225472 TCS_SlwTqIntrvntnVal 5;
BA_ "Version" SG_ 3221225472 TCS_SlwTqIntrvntnVal "17.12.00";
BA_ "Description" SG_ 3221225472 RL_SHVU_HtSwHiIndSta "RL 시트 열선 스위치 High Indicator 정보

-2nd LH Seat heater high Information";
BA_ "GenSigSendType" SG_ 3221225472 RL_SHVU_HtSwHiIndSta 4;
BA_ "UserSigValidity" SG_ 3221225472 RL_SHVU_HtSwHiIndSta 3;
BA_ "GenSigTimeoutTime" SG_ 3221225472 RL_SHVU_HtSwHiIndSta 1500;
BA_ "NetworkRequest" SG_ 3221225472 RL_SHVU_HtSwHiIndSta 0;
BA_ "NetworkRequestHoldingTime" SG_ 3221225472 RL_SHVU_HtSwHiIndSta 5000;
BA_ "Version" SG_ 3221225472 RL_SHVU_HtSwHiIndSta "18.05.02";
BA_ "Description" SG_ 3221225472 RL_SHVU_HtSwMidIndSta "RL 시트 열선 스위치 Mid Indicator 정보

-2nd LH Seat heater mid Information";
BA_ "GenSigSendType" SG_ 3221225472 RL_SHVU_HtSwMidIndSta 4;
BA_ "UserSigValidity" SG_ 3221225472 RL_SHVU_HtSwMidIndSta 3;
BA_ "GenSigTimeoutTime" SG_ 3221225472 RL_SHVU_HtSwMidIndSta 1500;
BA_ "NetworkRequest" SG_ 3221225472 RL_SHVU_HtSwMidIndSta 0;
BA_ "NetworkRequestHoldingTime" SG_ 3221225472 RL_SHVU_HtSwMidIndSta 5000;
BA_ "Version" SG_ 3221225472 RL_SHVU_HtSwMidIndSta "18.05.02";
BA_ "Description" SG_ 3221225472 RL_SHVU_HtSwLowIndSta "RL 시트 열선 스위치 Low Indicator 정보

-2nd LH Seat heater low Information";
BA_ "GenSigSendType" SG_ 3221225472 RL_SHVU_HtSwLowIndSta 4;
BA_ "UserSigValidity" SG_ 3221225472 RL_SHVU_HtSwLowIndSta 3;
BA_ "GenSigTimeoutTime" SG_ 3221225472 RL_SHVU_HtSwLowIndSta 1500;
BA_ "NetworkRequest" SG_ 3221225472 RL_SHVU_HtSwLowIndSta 0;
BA_ "NetworkRequestHoldingTime" SG_ 3221225472 RL_SHVU_HtSwLowIndSta 5000;
BA_ "Version" SG_ 3221225472 RL_SHVU_HtSwLowIndSta "18.05.02";
BA_ "Description" SG_ 3221225472 RL_SHVU_VntSwHiIndSta "RL 시트 통풍 스위치 High Indicator 정보

-2nd LH Seat vent high Information";
BA_ "GenSigSendType" SG_ 3221225472 RL_SHVU_VntSwHiIndSta 4;
BA_ "UserSigValidity" SG_ 3221225472 RL_SHVU_VntSwHiIndSta 3;
BA_ "GenSigTimeoutTime" SG_ 3221225472 RL_SHVU_VntSwHiIndSta 1500;
BA_ "NetworkRequest" SG_ 3221225472 RL_SHVU_VntSwHiIndSta 0;
BA_ "NetworkRequestHoldingTime" SG_ 3221225472 RL_SHVU_VntSwHiIndSta 5000;
BA_ "Version" SG_ 3221225472 RL_SHVU_VntSwHiIndSta "18.05.02";
BA_ "Description" SG_ 3221225472 RL_SHVU_VntSwMidIndSta "RL 시트 통풍 스위치 Mid Indicator 정보

-2nd LH Seat vent mid Information";
BA_ "GenSigSendType" SG_ 3221225472 RL_SHVU_VntSwMidIndSta 4;
BA_ "UserSigValidity" SG_ 3221225472 RL_SHVU_VntSwMidIndSta 3;
BA_ "GenSigTimeoutTime" SG_ 3221225472 RL_SHVU_VntSwMidIndSta 1500;
BA_ "NetworkRequest" SG_ 3221225472 RL_SHVU_VntSwMidIndSta 0;
BA_ "NetworkRequestHoldingTime" SG_ 3221225472 RL_SHVU_VntSwMidIndSta 5000;
BA_ "Version" SG_ 3221225472 RL_SHVU_VntSwMidIndSta "18.05.02";
BA_ "Description" SG_ 3221225472 RL_SHVU_VntSwLowIndSta "RL 시트 통풍 스위치 Low Indicator 정보

-2nd LH Seat vent low Information";
BA_ "GenSigSendType" SG_ 3221225472 RL_SHVU_VntSwLowIndSta 4;
BA_ "UserSigValidity" SG_ 3221225472 RL_SHVU_VntSwLowIndSta 3;
BA_ "GenSigTimeoutTime" SG_ 3221225472 RL_SHVU_VntSwLowIndSta 1500;
BA_ "NetworkRequest" SG_ 3221225472 RL_SHVU_VntSwLowIndSta 0;
BA_ "NetworkRequestHoldingTime" SG_ 3221225472 RL_SHVU_VntSwLowIndSta 5000;
BA_ "Version" SG_ 3221225472 RL_SHVU_VntSwLowIndSta "18.05.02";
BA_ "Description" SG_ 3221225472 ESC_CylPrsrVal "This signal indicates pressure of brake master cylinder and provides information how deeply  a driver is pressing brake pedal.";
BA_ "UserSigValidity" SG_ 3221225472 ESC_CylPrsrVal 3;
BA_ "RoutingFactor" SG_ 3221225472 ESC_CylPrsrVal 5;
BA_ "Version" SG_ 3221225472 ESC_CylPrsrVal "17.12.00";
BA_ "Description" SG_ 3221225472 ESC_CylPrsrSta "This signal indicates validity of CYL_PRES signal.";
BA_ "GenSigStartValue" SG_ 3221225472 ESC_CylPrsrSta 1;
BA_ "UserSigValidity" SG_ 3221225472 ESC_CylPrsrSta 3;
BA_ "RoutingFactor" SG_ 3221225472 ESC_CylPrsrSta 5;
BA_ "Version" SG_ 3221225472 ESC_CylPrsrSta "18.02.00";
BA_ "Description" SG_ 3221225472 ESC_CylPrsrDiagSta "This signal indicates self-diagnosis mode of master cylinder pressure signal. During system check, master cylinder pressure information cannot be sent(not available) and this bit should be set to 1.";
BA_ "GenSigStartValue" SG_ 3221225472 ESC_CylPrsrDiagSta 1;
BA_ "UserSigValidity" SG_ 3221225472 ESC_CylPrsrDiagSta 3;
BA_ "RoutingFactor" SG_ 3221225472 ESC_CylPrsrDiagSta 5;
BA_ "Version" SG_ 3221225472 ESC_CylPrsrDiagSta "17.12.00";
BA_ "Description" SG_ 3221225472 ESC_CylPrsrFlagSta "This signal means that the pressure of master cylinder is 15 bar or over.

(0x0 : under 15 bar, 0x1 : 15 bar or over)



This signal may be difference with actual BLS(Brake Lamp Switch) state.

So the ESC does not guarantee using this signal as substitut";
BA_ "UserSigValidity" SG_ 3221225472 ESC_CylPrsrFlagSta 3;
BA_ "RoutingFactor" SG_ 3221225472 ESC_CylPrsrFlagSta 5;
BA_ "Version" SG_ 3221225472 ESC_CylPrsrFlagSta "17.12.00";
BA_ "Description" SG_ 3221225472 ESC_VsmActvSta "ESC controller provides an information on VSM (ESC+MDPS) Active signal. It indicates VSM control is

active or inactive.";
BA_ "UserSigValidity" SG_ 3221225472 ESC_VsmActvSta 3;
BA_ "RoutingFactor" SG_ 3221225472 ESC_VsmActvSta 5;
BA_ "Version" SG_ 3221225472 ESC_VsmActvSta "17.12.00";
BA_ "Description" SG_ 3221225472 ESC_VsmDfctvSta "Information regarding the VSM “defective” Indication";
BA_ "UserSigValidity" SG_ 3221225472 ESC_VsmDfctvSta 3;
BA_ "RoutingFactor" SG_ 3221225472 ESC_VsmDfctvSta 5;
BA_ "Version" SG_ 3221225472 ESC_VsmDfctvSta "17.12.00";
BA_ "Description" SG_ 3221225472 ESC_VsmCtrlModSta "Classify mode1 , mode2 and mode3 of torque overlay. 

- Mode1 is sensor value overlay mode.

- Mode2 is output torque overlay mode. 

- Mode3 is for an alternative mode for Mobis VSM system";
BA_ "UserSigValidity" SG_ 3221225472 ESC_VsmCtrlModSta 3;
BA_ "RoutingFactor" SG_ 3221225472 ESC_VsmCtrlModSta 5;
BA_ "Version" SG_ 3221225472 ESC_VsmCtrlModSta "17.12.00";
BA_ "Description" SG_ 3221225472 ESC_StrTqReq "Requested additional Assist torque of MDPS gets from ESC to make vehicle more stable.



Relationship between signals:

ESC_StrTrqReq = 0 Nm  ( DST inactive )

-> ESC_DstAct = 0, ESC_DstCtrMode = 0

ESC_StrTrqReq < 0 Nm  or  ESC_StrTrqReq > 0 Nm  (active";
BA_ "GenSigStartValue" SG_ 3221225472 ESC_StrTqReq 2048;
BA_ "UserSigValidity" SG_ 3221225472 ESC_StrTqReq 3;
BA_ "RoutingFactor" SG_ 3221225472 ESC_StrTqReq 5;
BA_ "Version" SG_ 3221225472 ESC_StrTqReq "17.12.00";
BA_ "Description" SG_ 3221225472 ESC_LongAccelOffstCalibPrmtr "This signal indicates information regarding the calibration parameter for longitudinal acceleration value.

This signal doesn't guarantee the actual offset value.

But this signal is the result of the offset measuring process.

The allowed use of this si";
BA_ "GenSigStartValue" SG_ 3221225472 ESC_LongAccelOffstCalibPrmtr 255;
BA_ "UserSigValidity" SG_ 3221225472 ESC_LongAccelOffstCalibPrmtr 3;
BA_ "RoutingFactor" SG_ 3221225472 ESC_LongAccelOffstCalibPrmtr 5;
BA_ "Version" SG_ 3221225472 ESC_LongAccelOffstCalibPrmtr "18.02.00";
BA_ "Description" SG_ 3221225472 RR_SHVU_HtSwHiIndSta "RR 시트 열선 스위치 High Indicator 정보

-2nd RH Seat heater high Information";
BA_ "GenSigSendType" SG_ 3221225472 RR_SHVU_HtSwHiIndSta 4;
BA_ "UserSigValidity" SG_ 3221225472 RR_SHVU_HtSwHiIndSta 3;
BA_ "GenSigTimeoutTime" SG_ 3221225472 RR_SHVU_HtSwHiIndSta 1500;
BA_ "NetworkRequest" SG_ 3221225472 RR_SHVU_HtSwHiIndSta 0;
BA_ "NetworkRequestHoldingTime" SG_ 3221225472 RR_SHVU_HtSwHiIndSta 5000;
BA_ "Version" SG_ 3221225472 RR_SHVU_HtSwHiIndSta "18.05.02";
BA_ "Description" SG_ 3221225472 RR_SHVU_HtSwMidIndSta "RL 시트 열선 스위치 Mid Indicator 정보

-2nd LH Seat heater mid Information";
BA_ "GenSigSendType" SG_ 3221225472 RR_SHVU_HtSwMidIndSta 4;
BA_ "UserSigValidity" SG_ 3221225472 RR_SHVU_HtSwMidIndSta 3;
BA_ "GenSigTimeoutTime" SG_ 3221225472 RR_SHVU_HtSwMidIndSta 1500;
BA_ "NetworkRequest" SG_ 3221225472 RR_SHVU_HtSwMidIndSta 0;
BA_ "NetworkRequestHoldingTime" SG_ 3221225472 RR_SHVU_HtSwMidIndSta 5000;
BA_ "Version" SG_ 3221225472 RR_SHVU_HtSwMidIndSta "18.05.02";
BA_ "Description" SG_ 3221225472 RR_SHVU_HtSwLowIndSta "RR 시트 열선 스위치 Low Indicator 정보

-2nd RH Seat heater low Information";
BA_ "GenSigSendType" SG_ 3221225472 RR_SHVU_HtSwLowIndSta 4;
BA_ "UserSigValidity" SG_ 3221225472 RR_SHVU_HtSwLowIndSta 3;
BA_ "GenSigTimeoutTime" SG_ 3221225472 RR_SHVU_HtSwLowIndSta 1500;
BA_ "NetworkRequest" SG_ 3221225472 RR_SHVU_HtSwLowIndSta 0;
BA_ "NetworkRequestHoldingTime" SG_ 3221225472 RR_SHVU_HtSwLowIndSta 5000;
BA_ "Version" SG_ 3221225472 RR_SHVU_HtSwLowIndSta "18.05.02";
BA_ "Description" SG_ 3221225472 RR_SHVU_VntSwHiIndSta "RR 시트 통풍 스위치 High Indicator 정보

-2nd RH Seat vent high Information";
BA_ "GenSigSendType" SG_ 3221225472 RR_SHVU_VntSwHiIndSta 4;
BA_ "UserSigValidity" SG_ 3221225472 RR_SHVU_VntSwHiIndSta 3;
BA_ "GenSigTimeoutTime" SG_ 3221225472 RR_SHVU_VntSwHiIndSta 1500;
BA_ "NetworkRequest" SG_ 3221225472 RR_SHVU_VntSwHiIndSta 0;
BA_ "NetworkRequestHoldingTime" SG_ 3221225472 RR_SHVU_VntSwHiIndSta 5000;
BA_ "Version" SG_ 3221225472 RR_SHVU_VntSwHiIndSta "18.05.02";
BA_ "Description" SG_ 3221225472 RR_SHVU_VntSwMidIndSta "RR 시트 통풍 스위치 Mid Indicator 정보

-2nd RH Seat vent mid Information";
BA_ "GenSigSendType" SG_ 3221225472 RR_SHVU_VntSwMidIndSta 4;
BA_ "UserSigValidity" SG_ 3221225472 RR_SHVU_VntSwMidIndSta 3;
BA_ "GenSigTimeoutTime" SG_ 3221225472 RR_SHVU_VntSwMidIndSta 1500;
BA_ "NetworkRequest" SG_ 3221225472 RR_SHVU_VntSwMidIndSta 0;
BA_ "NetworkRequestHoldingTime" SG_ 3221225472 RR_SHVU_VntSwMidIndSta 5000;
BA_ "Version" SG_ 3221225472 RR_SHVU_VntSwMidIndSta "18.05.02";
BA_ "Description" SG_ 3221225472 RR_SHVU_VntSwLowIndSta "RR 시트 통풍 스위치 Low Indicator 정보

-2nd RH Seat vent low Information";
BA_ "GenSigSendType" SG_ 3221225472 RR_SHVU_VntSwLowIndSta 4;
BA_ "UserSigValidity" SG_ 3221225472 RR_SHVU_VntSwLowIndSta 3;
BA_ "GenSigTimeoutTime" SG_ 3221225472 RR_SHVU_VntSwLowIndSta 1500;
BA_ "NetworkRequest" SG_ 3221225472 RR_SHVU_VntSwLowIndSta 0;
BA_ "NetworkRequestHoldingTime" SG_ 3221225472 RR_SHVU_VntSwLowIndSta 5000;
BA_ "Version" SG_ 3221225472 RR_SHVU_VntSwLowIndSta "18.05.02";
BA_ "Description" SG_ 3221225472 RLPSU_ReclMtrPos "2열 LH 시트 Recline 모터 위치값 송신

 - Seat Recline Position Information signal for 2nd LH seat";
BA_ "GenSigSendType" SG_ 3221225472 RLPSU_ReclMtrPos 4;
BA_ "UserSigValidity" SG_ 3221225472 RLPSU_ReclMtrPos 0;
BA_ "GenSigTimeoutTime" SG_ 3221225472 RLPSU_ReclMtrPos 1500;
BA_ "NetworkRequest" SG_ 3221225472 RLPSU_ReclMtrPos 0;
BA_ "NetworkRequestHoldingTime" SG_ 3221225472 RLPSU_ReclMtrPos 5000;
BA_ "Version" SG_ 3221225472 RLPSU_ReclMtrPos "18.05.01";
BA_ "Description" SG_ 3221225472 ESC_Crc1Val "The CRC checking process calculates the CRC over the entire data block, including the CRC result.

- CRC Polynomial (0x1021) , Initial Value : 0xFFFF, XOR value : 0x0000

- The mathematical expression to 16 bit CRC polynomial is given here. G(x) = x16 + ";
BA_ "GenSigStartValue" SG_ 3221225472 ESC_Crc1Val 65535;
BA_ "UserSigValidity" SG_ 3221225472 ESC_Crc1Val 3;
BA_ "RoutingFactor" SG_ 3221225472 ESC_Crc1Val 5;
BA_ "Version" SG_ 3221225472 ESC_Crc1Val "17.11.00";
BA_ "Description" SG_ 3221225472 ESC_AlvCnt1Val "For the first transmission request for a data element the counter shall be initialized with 0 and shall be incremented by 1

for every subsequent send request. When the counter reaches the maximum value(0xFF), then it shall restart with ? for the next se";
BA_ "UserSigValidity" SG_ 3221225472 ESC_AlvCnt1Val 3;
BA_ "RoutingFactor" SG_ 3221225472 ESC_AlvCnt1Val 5;
BA_ "Version" SG_ 3221225472 ESC_AlvCnt1Val "17.11.00";
BA_ "Description" SG_ 3221225472 ABS_WrngLmpSta "The signal indicates the status of the “ABS Warning lamp”";
BA_ "UserSigValidity" SG_ 3221225472 ABS_WrngLmpSta 3;
BA_ "RoutingFactor" SG_ 3221225472 ABS_WrngLmpSta 5;
BA_ "Version" SG_ 3221225472 ABS_WrngLmpSta "17.12.00";
BA_ "Description" SG_ 3221225472 ABS_DfctvSta "Information regarding the ABS 'defective' indication.";
BA_ "UserSigValidity" SG_ 3221225472 ABS_DfctvSta 3;
BA_ "RoutingFactor" SG_ 3221225472 ABS_DfctvSta 5;
BA_ "Version" SG_ 3221225472 ABS_DfctvSta "17.12.00";
BA_ "Description" SG_ 3221225472 ABS_ActvSta "ABS controller provides an information on ABS Active signal.



ABS_ACT signal is 1 during the ABS control and if it is not ABS control phase this value is 0.";
BA_ "UserSigValidity" SG_ 3221225472 ABS_ActvSta 3;
BA_ "RoutingFactor" SG_ 3221225472 ABS_ActvSta 5;
BA_ "Version" SG_ 3221225472 ABS_ActvSta "17.12.00";
BA_ "Description" SG_ 3221225472 ABS_DiagSta "Information regarding the ABS/TCS/ESC “diagnostic mode” indication.";
BA_ "UserSigValidity" SG_ 3221225472 ABS_DiagSta 3;
BA_ "RoutingFactor" SG_ 3221225472 ABS_DiagSta 5;
BA_ "Version" SG_ 3221225472 ABS_DiagSta "17.12.00";
BA_ "Description" SG_ 3221225472 EBD_WrngLmpSta "The signal indicates the status of the “EBD Warning lamp”";
BA_ "UserSigValidity" SG_ 3221225472 EBD_WrngLmpSta 3;
BA_ "RoutingFactor" SG_ 3221225472 EBD_WrngLmpSta 5;
BA_ "Version" SG_ 3221225472 EBD_WrngLmpSta "17.12.00";
BA_ "Description" SG_ 3221225472 EBD_DfctvSta "Information regarding the EBD  'defective' indication.";
BA_ "UserSigValidity" SG_ 3221225472 EBD_DfctvSta 3;
BA_ "RoutingFactor" SG_ 3221225472 EBD_DfctvSta 5;
BA_ "Version" SG_ 3221225472 EBD_DfctvSta "17.12.00";
BA_ "Description" SG_ 3221225472 ESC_BrkLtActvSta "Flag from TCS which activates the illumination of the brake lights during automatic braking";
BA_ "UserSigValidity" SG_ 3221225472 ESC_BrkLtActvSta 0;
BA_ "RoutingFactor" SG_ 3221225472 ESC_BrkLtActvSta 5;
BA_ "Version" SG_ 3221225472 ESC_BrkLtActvSta "17.12.00";
BA_ "Description" SG_ 3221225472 ESS_Sta "Information on ESS system active/inactive/fail from ABS/ESC.";
BA_ "UserSigValidity" SG_ 3221225472 ESS_Sta 3;
BA_ "RoutingFactor" SG_ 3221225472 ESS_Sta 5;
BA_ "Version" SG_ 3221225472 ESS_Sta "17.12.00";
BA_ "Description" SG_ 3221225472 TCS_LmpSta "The signal indicates the status of the “TCS/ESC Function/Warning Lamp”";
BA_ "UserSigValidity" SG_ 3221225472 TCS_LmpSta 3;
BA_ "RoutingFactor" SG_ 3221225472 TCS_LmpSta 5;
BA_ "Version" SG_ 3221225472 TCS_LmpSta "17.12.00";
BA_ "Description" SG_ 3221225472 TCS_OffLmpSta "The signal indicates the status of the “TCS/ESC OFF SW Lamp”";
BA_ "UserSigValidity" SG_ 3221225472 TCS_OffLmpSta 3;
BA_ "RoutingFactor" SG_ 3221225472 TCS_OffLmpSta 5;
BA_ "Version" SG_ 3221225472 TCS_OffLmpSta "17.12.00";
BA_ "Description" SG_ 3221225472 ESC_OffTempSta "Information regarding the ESC OFF step by switch input of driver.";
BA_ "UserSigValidity" SG_ 3221225472 ESC_OffTempSta 3;
BA_ "RoutingFactor" SG_ 3221225472 ESC_OffTempSta 5;
BA_ "Version" SG_ 3221225472 ESC_OffTempSta "17.12.00";
BA_ "Description" SG_ 3221225472 DBC_WrngLmpSta "The signal indicates the status of the “DBC Warning lamp”";
BA_ "UserSigValidity" SG_ 3221225472 DBC_WrngLmpSta 3;
BA_ "RoutingFactor" SG_ 3221225472 DBC_WrngLmpSta 5;
BA_ "Version" SG_ 3221225472 DBC_WrngLmpSta "17.12.00";
BA_ "Description" SG_ 3221225472 DBC_FuncLmpSta "The signal indicates the status of the “DBC Function lamp”";
BA_ "UserSigValidity" SG_ 3221225472 DBC_FuncLmpSta 3;
BA_ "RoutingFactor" SG_ 3221225472 DBC_FuncLmpSta 5;
BA_ "Version" SG_ 3221225472 DBC_FuncLmpSta "17.12.00";
BA_ "Description" SG_ 3221225472 ESC_BrkCtrlSta "This signal indicates that if brake control from the ECU request is in activation or not  during cruise control or speed limiter.";
BA_ "UserSigValidity" SG_ 3221225472 ESC_BrkCtrlSta 3;
BA_ "RoutingFactor" SG_ 3221225472 ESC_BrkCtrlSta 5;
BA_ "Version" SG_ 3221225472 ESC_BrkCtrlSta "17.12.00";
BA_ "Description" SG_ 3221225472 RRPSU_ReclMtrPos "2열 RH 시트 Recline 모터 위치값 송신

 - Seat Recline Position Information signal for 2nd RH seat";
BA_ "GenSigSendType" SG_ 3221225472 RRPSU_ReclMtrPos 4;
BA_ "UserSigValidity" SG_ 3221225472 RRPSU_ReclMtrPos 0;
BA_ "GenSigTimeoutTime" SG_ 3221225472 RRPSU_ReclMtrPos 1500;
BA_ "NetworkRequest" SG_ 3221225472 RRPSU_ReclMtrPos 0;
BA_ "NetworkRequestHoldingTime" SG_ 3221225472 RRPSU_ReclMtrPos 5000;
BA_ "Version" SG_ 3221225472 RRPSU_ReclMtrPos "18.05.01";
BA_ "Description" SG_ 3221225472 BCM_Crc10Val "The CRC checking process calculates the CRC over the entire data block, including the CRC result CRC Polynomial (0x1D) ,

Initial Value : 0x00, XOR value : 0x00

The mathematical expression to 8 bit CRC polynomial is given here. G(x) = x8 + x4 + x3 + x2 ";
BA_ "GenSigSendType" SG_ 3221225472 BCM_Crc10Val 4;
BA_ "GenSigStartValue" SG_ 3221225472 BCM_Crc10Val 255;
BA_ "UserSigValidity" SG_ 3221225472 BCM_Crc10Val 0;
BA_ "GenSigTimeoutTime" SG_ 3221225472 BCM_Crc10Val 1500;
BA_ "Version" SG_ 3221225472 BCM_Crc10Val "17.11.00";
BA_ "Description" SG_ 3221225472 BCM_AlvCnt10Val "For the first transmission request for a data element the counter shall be initialized with 0 and shall be incremented by 1

for every subsequent send request. When the counter reaches the maximum value(0xE), then it shall restart with ? for the next sen";
BA_ "GenSigSendType" SG_ 3221225472 BCM_AlvCnt10Val 4;
BA_ "UserSigValidity" SG_ 3221225472 BCM_AlvCnt10Val 0;
BA_ "GenSigTimeoutTime" SG_ 3221225472 BCM_AlvCnt10Val 1500;
BA_ "Version" SG_ 3221225472 BCM_AlvCnt10Val "17.11.00";
BA_ "GenSigSendType" SG_ 3221225472 Wiper_PrkngPosSta 4;
BA_ "UserSigValidity" SG_ 3221225472 Wiper_PrkngPosSta 0;
BA_ "GenSigTimeoutTime" SG_ 3221225472 Wiper_PrkngPosSta 1500;
BA_ "NetworkRequest" SG_ 3221225472 Wiper_PrkngPosSta 0;
BA_ "NetworkRequestHoldingTime" SG_ 3221225472 Wiper_PrkngPosSta 5000;
BA_ "Version" SG_ 3221225472 Wiper_PrkngPosSta "17.12.00";
BA_ "Description" SG_ 3221225472 Wiper_RainSnsrOptionTyp "Rain Sensor Option Information";
BA_ "GenSigSendType" SG_ 3221225472 Wiper_RainSnsrOptionTyp 4;
BA_ "UserSigValidity" SG_ 3221225472 Wiper_RainSnsrOptionTyp 0;
BA_ "GenSigTimeoutTime" SG_ 3221225472 Wiper_RainSnsrOptionTyp 1500;
BA_ "NetworkRequest" SG_ 3221225472 Wiper_RainSnsrOptionTyp 0;
BA_ "NetworkRequestHoldingTime" SG_ 3221225472 Wiper_RainSnsrOptionTyp 5000;
BA_ "Version" SG_ 3221225472 Wiper_RainSnsrOptionTyp "17.12.00";
BA_ "Description" SG_ 3221225472 Wiper_RainSnsrSta "This signal represents the status of Rain Sensor signal state.";
BA_ "GenSigSendType" SG_ 3221225472 Wiper_RainSnsrSta 4;
BA_ "UserSigValidity" SG_ 3221225472 Wiper_RainSnsrSta 0;
BA_ "GenSigTimeoutTime" SG_ 3221225472 Wiper_RainSnsrSta 1500;
BA_ "NetworkRequest" SG_ 3221225472 Wiper_RainSnsrSta 0;
BA_ "NetworkRequestHoldingTime" SG_ 3221225472 Wiper_RainSnsrSta 5000;
BA_ "Version" SG_ 3221225472 Wiper_RainSnsrSta "17.12.00";
BA_ "Description" SG_ 3221225472 BCM_SolSnsrRtOutVoltVal "This signal indicates solar sensor output voltage - RH";
BA_ "GenSigSendType" SG_ 3221225472 BCM_SolSnsrRtOutVoltVal 4;
BA_ "UserSigValidity" SG_ 3221225472 BCM_SolSnsrRtOutVoltVal 0;
BA_ "GenSigTimeoutTime" SG_ 3221225472 BCM_SolSnsrRtOutVoltVal 1500;
BA_ "NetworkRequest" SG_ 3221225472 BCM_SolSnsrRtOutVoltVal 0;
BA_ "NetworkRequestHoldingTime" SG_ 3221225472 BCM_SolSnsrRtOutVoltVal 5000;
BA_ "Version" SG_ 3221225472 BCM_SolSnsrRtOutVoltVal "17.12.00";
VAL_ 3221225472 SCR_SysErrMsgDis 0 "No display" 1 "‘incorrect urea detected’ or ‘incorrect AdBlue detected’ or ‘incorrect reagent detected" 2 "urea dosing malfunction’ or ‘AdBlue dosing malfunction’ or ‘reagent dosing malfunction" 3 "‘urea dosing interruption’, ‘AdBlue dosing interruption’, or ‘reagent dosing interruption'" 4 "'emissions too high-check urea', 'emissions too high-check AdBlue', 'emissions too high-check" ;
VAL_ 3221225472 SCR_SysWrngLmpReq 0 "Lamp Off" 1 "Lamp ON" ;
VAL_ 3221225472 SCR_IndcmtExitStaDis 0 "No display" 1 "'fill up correct urea' AND No Restart In %Mileage%" 2 "‘check the SCR system' AND No Restart In %Mileage%" ;
VAL_ 3221225472 SCR_UreaLvlSta 0 "0x00~0xC8:urea level in % scale" 200 "0x00~0xC8:urea level in % scale" 255 "urea level sensor error(Error indicator)" ;
VAL_ 3221225472 SCR_RmnRstrtDis 0 "No display" 1 "01~0xFE:number of remaining restarts" 254 "01~0xFE:number of remaining restarts" 255 "Error indicator" ;
VAL_ 3221225472 SCR_RmnDstDis 0 "No display" 1 "0001~0x61A8:Remaining distance before disabled engine restart" 25000 "0001~0x61A8:Remaining distance before disabled engine restart" 65535 "Error indicator" ;
VAL_ 3221225472 ENG_TransmsnTyp 0 "A/T vehicle (Step Shift A/T)" 10 "CVT vehicle (CVT A/T)" 11 "DCT vehicle (DCT A/T)" 15 "M/T vehicle" ;
VAL_ 3221225472 ENG_EngDsplceTyp 255 "Error indicator" ;
VAL_ 3221225472 EMS_Crc5Val 65535 "Signal Invalid (Message with unused CRC. CRC signal is transmitted fixed value)" ;
VAL_ 3221225472 EMS_AlvCnt5Val 255 "Signal Invalid (Message with unused Alive counter. Alive counter signal is transmitted fixed value)" ;
VAL_ 3221225472 ENG_ImmoLmpSta 0 "Immobilizer lamp OFF" 1 "Immobilizer lamp ON" ;
VAL_ 3221225472 ENG_MilSta 0 "Check Engine lamp OFF" 1 "Check Engine lamp ON" ;
VAL_ 3221225472 ENG_ImmoSta 0 "Immobilizer active" 1 "Immobilizer passive" ;
VAL_ 3221225472 OBD_RbmInhbtSta 0 "Enable of standardized vehicle operation and all numerators/denominators for RBM" 1 "Inhibition of standardized vehicle operation and all numerators/denominators for RMB" ;
VAL_ 3221225472 ENG_AtmsphPrsrVal 28 "Error indicator" ;
VAL_ 3221225472 ENG_AltFdbckLoadVal 255 "Error indicator" ;
VAL_ 3221225472 ENG_BattVoltVal 255 "Error indicator" ;
VAL_ 3221225472 ENG_FuelTempVal 255 "Error indicator" ;
VAL_ 3221225472 TCU_GearSlctDis 0 "P" 1 "L" 2 "2" 3 "3" 4 "DS Mode" 5 "D" 6 "N" 7 "R" 8 "sports mode / manual shift / paddle shift" 9 "Not Display at Cluster" 10 "Sub-Rom Communication" 11 "Sub-Rom Communication Error" 12 "Paddle shift (D-position)" 13 "Reserved" 14 "Intermediate Position" 15 "fault" ;
VAL_ 3221225472 TCU_Typ 0 "Reserved" 1 "Step A/T" 2 "CVT" 3 "DCT" ;
VAL_ 3221225472 TCU_TqRdctnVal 0 "Max. reduction" 2047 "No reduction" ;
VAL_ 3221225472 TCU_GearStepTyp 3 "3 - Speed A/T or DCT" 4 "4 - Speed A/T or DCT" 5 "5 - Speed A/T or DCT" 6 "6 - Speed A/T or DCT" ;
VAL_ 3221225472 TCU_GearShftSta 0 "no gear change" 1 "gear change is active" 2 "Not used" 3 "Error Indicator" ;
VAL_ 3221225472 TCU_TqCnvrtrSta 0 "No lock up control" 1 "Slip lock up" 2 "Fully lock up" 3 "Off slip lock up" ;
VAL_ 3221225472 ENG_EngTyp4 0 "Non-ETC" 1 "ETC" 2 "Not used" 3 "Error indicator" ;
VAL_ 3221225472 ENG_EngTyp3 0 "FF" 1 "FR" 2 "Not used" 3 "Error indicator" ;
VAL_ 3221225472 ENG_EngTyp2 0 "LPI" 1 "MPI" 2 "GDI" 3 "TGDI" 4 "CVVL" 5 "CVVD" 6 "PDI" 7 "FFV" 8 "TCI" 9 "VGT" 10 "Turbo" 14 "Not used" 15 "Error indicator" ;
VAL_ 3221225472 ENG_EngTyp1 0 "epsilon(ε)" 1 "gamma(γ)" 2 "kappa(κ)" 3 "theta(θ)" 4 "nu(ν)" 5 "lambda(λ)" 6 "tau(τ)" 10 "S" 11 "A" 12 "R" 13 "U" 14 "D" 15 "Error indicator" ;
VAL_ 3221225472 ENG_S_F 0 "AMS" 1 "ISG" 2 "Reserved" 3 "Reserved" ;
VAL_ 3221225472 ENG_S_F_GEN 0 "No AMS" 1 "1G Generation AMS" 2 "1.5G Generation AMS" 3 "2G Generation AMS" 4 "Reserved" 5 "Reserved" 6 "Reserved" 7 "Reserved" ;
VAL_ 3221225472 TCU_CurrGearSta 0 "if N or P are detected (no frictional connection)" 1 "1st speed" 2 "2nd speed" 3 "3rd speed" 4 "4th speed" 5 "5th speed" 6 "6th speed" 7 "7th speed" 8 "8th speed" 14 "Reverse speed" ;
VAL_ 3221225472 TCU_TrgtGearSta 0 "if N or P are detected (no frictional connection)" 1 "1st speed" 2 "2nd speed" 3 "3rd speed" 4 "4th speed" 5 "5th speed" 6 "6th speed" 7 "7th speed" 8 "8th speed" 14 "Reverse speed" ;
VAL_ 3221225472 TCU_CluTrgtGearSta 0 "if N or P are detected (no frictional connection)" 1 "1st speed" 2 "2nd speed" 3 "3rd speed" 4 "4th speed" 5 "5th speed" 6 "6th speed" 7 "7th speed" 8 "8th speed" 14 "Reverse speed" ;
VAL_ 3221225472 TCH_EngTrgtGearSta 0 "if N or P are detected (no frictional connection)" 1 "1st speed" 2 "2nd speed" 3 "3rd speed" 4 "4th speed" 5 "5th speed" 6 "6th speed" 7 "7th speed" 8 "8th speed" 14 "Reverse speed" ;
VAL_ 3221225472 TCU_EngTqLimVal 0 "Max. reduction" 2047 "No reduction" ;
VAL_ 3221225472 TCU_VehSpdKphVal 255 "Error Indicator" ;
VAL_ 3221225472 TCU_DcmlVehSpdKphVal 0 "Error Indicator" ;
VAL_ 3221225472 TCU_GearLmpBlnkngReq 0 "No blink" 1 "Request lamp blinking" 2 "Not used" 3 "Error Indicator" ;
VAL_ 3221225472 TCU_FuelCutInhbtReq 0 "No request" 1 "Fuel cut inhibition request from TCU" 2 "Not used" 3 "Error Indicator" ;
VAL_ 3221225472 TCU_IdleUpReq 0 "No IDLE UP request" 1 "IDLE UP request" 2 "Not used" 3 "Error Indicator" ;
VAL_ 3221225472 TCU_EngRpmDis 65535 "Error Indicator" ;
VAL_ 3221225472 TCU_EngSpdIncReq 0 "No request" 1 "Engine speed increase is requested" 2 "Not used" 3 "Error Indicator" ;
VAL_ 3221225472 TCU_ObdSta 2 "Failure information of TCU" 3 "Failure information of TCU" 4 "MIL on request" 5 "MIL on request" 6 "Failure information of TCU & MIL on request" 7 "Failure information of TCU & MIL on request" ;
VAL_ 3221225472 TCU_SprtyIndxSta 0 "Invalid" 1 "Step 1" 2 "Step 2" 3 "Step 3" 4 "Step 4" 5 "Step 5" 6 "Step 6" 7 "Step 7" 8 "Step 8" 9 "Step 9" 10 "Step 10" 11 "Step 11" 12 "Step 12" 13 "Step 13" 14 "Step 14" 15 "Step 15" 16 "Step 16" 17 "Step 17" 18 "Step 18" 19 "Step 19" 20 "Step 20" 21 "Step 21" 22 "Step 22" 23 "Step 23" 24 "Step 24" 25 "Step 25" 26 "Invalid" 27 "Invalid" 28 "Invalid" 29 "Invalid" 30 "Invalid" 31 "Invalid" ;
VAL_ 3221225472 TCU_DrvngModDis 0 "Inactive" 1 "Normal" 2 "Eco" 3 "Eco+" 4 "Sport" 5 "Sport+" 6 "Snow" 7 "Reserved" ;
VAL_ 3221225472 TCU_DrvngModReq 0 "Inactive" 1 "Normal" 2 "Eco" 3 "Eco+" 4 "Sport" 5 "Sport+" 6 "Snow" 7 "Reserved" ;
VAL_ 3221225472 TCU_SmrtShftSta 0 "Smart Shift not Applied" 1 "Smart Shift Applied" 2 "Not used" 3 "Error Indicator" ;
VAL_ 3221225472 TCU_FrtStcShftSta 0 "First static shift function is not activated." 1 "First static shift function is activated" 2 "Not used" 3 "Error Indicator" ;
VAL_ 3221225472 TCU_IsgInhbtReq 0 "TCU inhibits the ISG function" 1 "ISG is available" 2 "Not used" 3 "Error Indicator" ;
VAL_ 3221225472 TCU_CdaInhbtReq 0 "CDA transition is available" 1 "TCU prohibits CDA transition" 2 "Not used" 3 "Error Indicator" ;
VAL_ 3221225472 TCU_BrkOnReq 0 "No request" 1 "Brake On Request" 2 "Not used" 3 "Error Indicator" ;
VAL_ 3221225472 TCU_TqGrdntLimVal 255 "No torque gradient limitation" ;
VAL_ 3221225472 Mirror_OSMirFldOpt 0 "Off" 1 "On" 2 "Not Used" 3 "Error Indicator" ;
VAL_ 3221225472 Mirror_OSMirFldSta 0 "Off" 1 "On" 2 "Not Used" 3 "Error Indicator" ;
VAL_ 3221225472 Mirror_OSMirManualFldSta 0 "OFF" 1 "ON" 2 "Not Used" 3 "Error Indicator" ;
VAL_ 3221225472 Mirror_OSMirFldCtrlSta 0 "OFF" 1 "ON" 2 "Not Used" 3 "Error Indicator" ;
VAL_ 3221225472 Mirror_OSMirUnFldCtrlSta 0 "OFF" 1 "ON" 2 "Not Used" 3 "Error Indicator" ;
VAL_ 3221225472 Mirror_LHOMUOSMirFldCtrlSta 0 "Off" 1 "Folding" 2 "Unfolding" 3 "Error Indicator" ;
VAL_ 3221225472 Mirror_RHOMUOSMirFldCtrlSta 0 "Off" 1 "Folding" 2 "Unfolding" 3 "Error Indicator" ;
VAL_ 3221225472 Mirror_LHOutDrTempSnsrVal 0 "0x0~0xC8:Exterior Temperature" 200 "0x0~0xC8:Exterior Temperature" 201 "Reserved" 202 "Reserved" 203 "Reserved" 204 "Reserved" 205 "Reserved" 206 "Reserved" 207 "Reserved" 208 "Reserved" 209 "Reserved" 210 "Reserved" 211 "Reserved" 212 "Reserved" 213 "Reserved" 214 "Reserved" 215 "Reserved" 216 "Reserved" 217 "Reserved" 218 "Reserved" 219 "Reserved" 220 "Reserved" 221 "Reserved" 222 "Reserved" 223 "Reserved" 224 "Reserved" 225 "Reserved" 226 "Reserved" 227 "Reserved" 228 "Reserved" 229 "Reserved" 230 "Reserved" 231 "Reserved" 232 "Reserved" 233 "Reserved" 234 "Reserved" 235 "Reserved" 236 "Reserved" 237 "Reserved" 238 "Reserved" 239 "Reserved" 240 "Reserved" 241 "Reserved" 242 "Reserved" 243 "Reserved" 244 "Reserved" 245 "Reserved" 246 "Reserved" 247 "Reserved" 248 "Reserved" 249 "Reserved" 250 "Invalid" 251 "Reserved" 252 "Reserved" 253 "Reserved" 254 "Reserved" 255 "Sensor Fail" ;
VAL_ 3221225472 IMS_DrvrImsSwSetSta 0 "Off" 1 "On" 2 "Not Used" 3 "Error Indicator" ;
VAL_ 3221225472 IMS_DrvrImsSw1Sta 0 "Off" 1 "On" 2 "Not Used" 3 "Error Indicator" ;
VAL_ 3221225472 IMS_DrvrImsSw2Sta 0 "Off" 1 "On" 2 "Not Used" 3 "Error Indicator" ;
VAL_ 3221225472 IMS_DrvrImsSwSmrtSta 0 "Off" 1 "On" 2 "Not Used" 3 "Error Indicator" ;
VAL_ 3221225472 IMS_LHOSMirPlyBckSta 0 "Stop" 1 "Play 1" 2 "Play 2" 3 "Smart IMS" 4 "Reserved" 5 "Reserved" 6 "Reserved" 7 "Invalid" ;
VAL_ 3221225472 Window_AsstPwrWdwAutoSwSta 0 "Off" 1 "On" 2 "Not Used" 3 "Error Indicator" ;
VAL_ 3221225472 Window_AsstPwrWdwUpSwSta 0 "Off" 1 "On" 2 "Not Used" 3 "Error Indicator" ;
VAL_ 3221225472 Window_AsstPwrWdwDnSwSta 0 "Off" 1 "On" 2 "Not Used" 3 "Error Indicator" ;
VAL_ 3221225472 Window_RrLftPwrWdwAutoSwSta 0 "Off" 1 "On" 2 "Not Used" 3 "Error Indicator" ;
VAL_ 3221225472 Window_RrLftPwrWdwUpSwSta 0 "Off" 1 "On" 2 "Not Used" 3 "Error Indicator" ;
VAL_ 3221225472 Window_RrLftPwrWdwDnSwSta 0 "Off" 1 "On" 2 "Not Used" 3 "Error Indicator" ;
VAL_ 3221225472 Window_RrRtPwrWdwAutoSwSta 0 "Off" 1 "On" 2 "Not Used" 3 "Error Indicator" ;
VAL_ 3221225472 Window_RrRtPwrWdwUpSwSta 0 "Off" 1 "On" 2 "Not Used" 3 "Error Indicator" ;
VAL_ 3221225472 Window_RrRtPwrWdwDnSwSta 0 "Off" 1 "On" 2 "Not Used" 3 "Error Indicator" ;
VAL_ 3221225472 Window_PwrWdwMaintainSta 0 "Diasble" 1 "Enable" 2 "Not Used" 3 "Error Indicator" ;
VAL_ 3221225472 Window_PwrWdwMvInhbtSta 0 "Off" 1 "On" 2 "Not Used" 3 "Error Indicator" ;
VAL_ 3221225472 HSWS_SysWrngSta_ICU 0 "Normal" 1 "System Fail" 2 "Reserved" 3 "Invalid" ;
VAL_ 3221225472 HeatedSteerWheel_StrWhlHtrSwSta 0 "Off" 1 "On" 2 "Reserved" 3 "Invalid" ;
VAL_ 3221225472 DriveTypeOption 0 "Left Handle Drive Type" 1 "Right Handle Drive Type" 3 "Error Indicator" ;
VAL_ 3221225472 Warn_RrLftSBRMATSwSta 0 "Off (UnSeated)" 1 "On (Seated)" 3 "Error Indicator" ;
VAL_ 3221225472 Warn_RrRhtSBRMATSwSta 0 "Off (UnSeated)" 1 "On (Seated)" 3 "Error Indicator" ;
VAL_ 3221225472 StrWheelAutoHeatSta 0 "Default" 1 "Off" 2 "On" 3 "Invalid" 3 "Error Indicator" ;
VAL_ 3221225472 StrWheelHeatIndSta 0 "OFF" 1 "ON(Step1)" 2 "ON(Step2)" 3 "Error Indicator" ;
VAL_ 3221225472 Warn_LftSEA 0 "SEA Left Warning OFF" 1 "SEA Left Warning ON" 2 "Reserved" 3 "Invalid" ;
VAL_ 3221225472 Warn_RhtSEA 0 "SEA Right Warning OFF" 1 "SEA Right Warning ON" 2 "Reserved" 3 "Invalid" ;
VAL_ 3221225472 Lamp_FootLampOnReq 0 "Off" 1 "On" 2 "Dim Out" 3 "Error Indicator" ;
VAL_ 3221225472 Lamp_MoodLampOnReq 0 "0%" 1 "FadeIn" 2 "MoodBrightPercent" 3 "FadeOut" 4 "100%" ;
VAL_ 3221225472 ICU_PowerAutoCutModSta 0 "Factory Mode (default)" 1 "Dealer Mode" 2 "Customer Mode" 3 "Error Indicator" ;
VAL_ 3221225472 ICU_SoCBattStaMsgReq 0 "Default" 1 "Alert" 2 "Warning" 3 "Invalid" ;
VAL_ 3221225472 DrvDrLockIND 0 "Off" 1 "On" ;
VAL_ 3221225472 Brake_SwSta_ICU 0 "Off" 1 "On" ;
VAL_ 3221225472 C_3rdRRSBRMatSw 0 "Off (UnSeated)" 1 "On (Seated)" ;
VAL_ 3221225472 C_3rdRLSBRMatSw 0 "Off (UnSeated)" 1 "On (Seated)" ;
VAL_ 3221225472 C_3rdRRSeatBeltSW 0 "Unbelted" 1 "Belted" ;
VAL_ 3221225472 C_3rdRLSeatBeltSW 0 "Unbelted" 1 "Belted" ;
VAL_ 3221225472 Lamp_AutoLtSnsrNightSta 0 "Off" 1 "Night" 2 "Not Used" 3 "Error Indicator" ;
VAL_ 3221225472 Autocut_DlvryModSta 0 "Before Delivery(Welcome Off)" 1 "After Delivery(Welcome On)" 2 "Not Used" 3 "Error Indicator" ;
VAL_ 3221225472 DoorLock_AsstDrUnLkSta 0 "Lock" 1 "Unlock" 2 "Not Used" 3 "Error Indicator" ;
VAL_ 3221225472 Warn_DrvDrSwSta 0 "Close" 1 "Open" 2 "Not Used" 3 "Error Indicator" ;
VAL_ 3221225472 DoorLock_RrLftDrUnLkSta 0 "Lock" 1 "Unlock" 2 "Not Used" 3 "Error Indicator" ;
VAL_ 3221225472 DoorLock_RrRtDrUnLkSta 0 "Lock" 1 "Unlock" 2 "Not Used" 3 "Error Indicator" ;
VAL_ 3221225472 Warn_AsstDrSwSta 0 "Close" 1 "Open" 2 "Not Used" 3 "Error Indicator" ;
VAL_ 3221225472 Warn_AsstStBltSwSta 0 "Unbelted" 1 "Belted" 2 "Not Used" 3 "Error Indicator" ;
VAL_ 3221225472 Warn_BrkFldSwSta 0 "Off" 1 "On" 2 "Not Used" 3 "Error Indicator" ;
VAL_ 3221225472 Warn_DrvStBltSwSta 0 "Unbelted" 1 "Belted" 2 "Not Used" 3 "Error Indicator" ;
VAL_ 3221225472 Warn_HoodSwSta 0 "Off" 1 "On" 2 "Not Used" 3 "Error Indicator" ;
VAL_ 3221225472 Warn_PassStOccSta 0 "Off (UnSeated)" 1 "On (Seated)" 2 "Not Used" 3 "Error Indicator" ;
VAL_ 3221225472 Warn_PrkngBrkSwSta 0 "Off" 1 "On" 2 "Not Used" 3 "Error Indicator" ;
VAL_ 3221225472 Warn_RrCtrStBltSwSta 0 "Unbelted" 1 "Belted" 2 "Not Used" 3 "Error Indicator" ;
VAL_ 3221225472 Warn_RrLftDrSwSta 0 "Close" 1 "Open" 2 "Not Used" 3 "Error Indicator" ;
VAL_ 3221225472 Warn_RrLftStBltSwSta 0 "Unbelted" 1 "Belted" 2 "Not Used" 3 "Error Indicator" ;
VAL_ 3221225472 Warn_RrRtDrSwSta 0 "Close" 1 "Open" 2 "Not Used" 3 "Error Indicator" ;
VAL_ 3221225472 Warn_RrRtStBltSwSta 0 "Unbelted" 1 "Belted" 2 "Not Used" 3 "Error Indicator" ;
VAL_ 3221225472 Warn_HoodSwMemorySta 0 "No event" 1 "hood_open_close" 2 "reserved" 3 "reserved" ;
VAL_ 3221225472 Warn_WshrFldSwSta 0 "Off" 1 "On" ;
VAL_ 3221225472 Trunk_TrnkInReleaseSwSta 0 "Off" 1 "On" 2 "Not Used" 3 "Error Indicator" ;
VAL_ 3221225472 Trunk_TrnkTlgtOutReleaseSwSta 0 "Off" 1 "On" 2 "Not Used" 3 "Error Indicator" ;
VAL_ 3221225472 Trunk_TrnkTlgtSwSta 0 "Close(Full Lock)" 1 "Open(Not Full Lock)" 2 "Not Used" 3 "Error Indicator" ;
VAL_ 3221225472 Trunk_GlvBxTrnkLkSwSta 0 "Off" 1 "On" 2 "Not Used" 3 "Error Indicator" ;
VAL_ 3221225472 Trunk_TlgtFullOpnSwSta 0 "Close(Not Full Open)" 1 "Open(Full Open)" 2 "Not Used" 3 "Error Indicator" ;
VAL_ 3221225472 Trunk_OpnDiagSetSta 0 "OFF" 1 "ON" 2 "Not Used" 3 "Error Indicator" ;
VAL_ 3221225472 USM_OneTouchTrnSigFuncSta 0 "Default" 1 "One Touch Turn Off" 2 "3 Flashing" 3 "5 Flashing" 4 "7 Flashing" 5 "Invalid" ;
VAL_ 3221225472 DoorLock_DrvDrUnLkSta 0 "Lock" 1 "Unlock" 2 "Not Used" 3 "Error Indicator" ;
VAL_ 3221225472 DoorLock_LkOutSta 0 "Off" 1 "On" 2 "Not Used" 3 "Error Indicator" ;
VAL_ 3221225472 Trunk_TrnkTlgtOpenOutput 0 "Off" 1 "On" ;
VAL_ 3221225472 TwoTrnUnLkOptTyp 0 "Off" 1 "On" 2 "Not Used" 3 "Error Indicator" ;
VAL_ 3221225472 Defog_DfgrRlySta 0 "Off" 1 "On" 2 "Not Used" 3 "Error Indicator" ;
VAL_ 3221225472 SEA_ActvSta 0 "InActivated" 1 "Activated" 2 "Not Used" 3 "Error Indicator" ;
VAL_ 3221225472 ChildLock_ActnFlSta 0 "OK" 1 "Failed" 2 "Not Used" 3 "Error Indicator" ;
VAL_ 3221225472 USM_AutoDrLkReq 0 "Default" 1 "Off" 2 "Vehicle Speed On(15km)" 3 "Shift Lever On" 4 "Invalid" ;
VAL_ 3221225472 USM_AutoDrUnLkReq 0 "Default" 1 "Off" 2 "Key Out On (AllDoors)" 3 "Shift Lever On (AllDoors)" 4 "Override" 5 "Invalid" 6 "Key Out On (Driver Door)" 7 "Shift Lever On (Driver Door)" ;
VAL_ 3221225472 USM_TwoTrnUnLkCurrentSta 0 "Default" 1 "Ttunlock Off" 2 "Ttunlock On" 3 "Invalid" ;
VAL_ 3221225472 HWSW_SysSta 0 "Normal" 1 "System Fail" 2 "reserved" 3 "Invalid" ;
VAL_ 3221225472 SCM_PlyBckSta 0 "Stop" 1 "Play 1" 2 "Play 2" 3 "Health Care IMS" 4 "Reserved" 5 "Reserved" 6 "Reserved" 7 "Invalid" ;
VAL_ 3221225472 USM_CmdSta 0 "Default" 1 "Steering Off" 2 "Steering On" 3 "Invalid" ;
VAL_ 3221225472 SCM_HptWrngUSMSta 0 "Default" 1 "WEAK" 2 "MEDIUM" 3 "STRONG" 4 "Reserved" 5 "Reserved" 6 "Reserved" 7 "Invalid" ;
VAL_ 3221225472 AVH_Sta 0 "No apply" 1 "Vehicle is held by the service brake" 2 "Being released" 3 "Error Indicator" ;
VAL_ 3221225472 LDM_Sta 0 "ESC ready to DBF/AVH (requested by switch)" 1 "ESC can’t perform DBF/AVH (requested by switch)" 2 "Not used" 3 "Error Indicator" ;
VAL_ 3221225472 EPB_ActvReq 0 "No request" 1 "Release request" 2 "Close request in comfort mode" 3 "Close request in secure mode" ;
VAL_ 3221225472 EPB_StaReq 0 "REQ_EPB_ACT signal is invalid" 1 "REQ_EPB_ACT signal is valid" 2 "Not used" 3 "Error Indicator" ;
VAL_ 3221225472 ECD_ActvSta 0 "ECD is not active" 1 "ECD is active(operating)" 2 "Not used" 3 "Error Indicator" ;
VAL_ 3221225472 AVH_CluDis 0 "AVH is off" 1 "AUTO HOLD to be deactivated Press Brake Pedal" 2 "Press Brake Pedal to Release AUTO HOLD" 3 "AUTO HOLD cannot be activated Close Door, Hood, Trunk" 4 "AUTO HOLD cannot be deactivated, Close Door" ;
VAL_ 3221225472 AVH_AlrmReq 0 "No alarm" 1 "On AVH Activation, Vehicle is not secured and driver is still inside = comfortable tone" 2 "Not used" 3 "Error Indicator" ;
VAL_ 3221225472 AVH_ActvStaLmpDis 0 "Lamp On" 1 "Lamp Off" 2 "Not used" 3 "Error Indicator" ;
VAL_ 3221225472 AVH_LmpDis 0 "AVH Off (Lamp Status" 1 "AVH failure (Lamp Status" 2 "AVH ACTIVE (Lamp Status" 3 "AVH READY (Lamp Status" 4 "Lamp Status" 5 "Lamp Status" 6 "Lamp Status" ;
VAL_ 3221225472 AWD_CrdnShftTqLimVal 65535 "Error" ;
VAL_ 3221225472 AWD_CltchDtyLimVal 255 "Error" ;
VAL_ 3221225472 AWD_TransmsnTqLimModSta 0 "Maximum limitation mode" 1 "Minimum limitation mode" 2 "Not used" 3 "Error Indicator" ;
VAL_ 3221225472 AWD_RrWhlDtyLimReq 0 "No request from ESC" 1 "Request duty limit from ESC" 2 "Not used" 3 "Error Indicator" ;
VAL_ 3221225472 AWD_FastOpnCrdnShftCltchReq 0 "Passive" 1 "Clutch off" 2 "Torque limit" 3 "Error" ;
VAL_ 3221225472 DATC_StrWhlHtrSwReq 0 "Default" 1 "OFF" 2 "ON" 3 "Error Indicator" ;
VAL_ 3221225472 DATC_FRStHtrSwReq 0 "Default" 1 "OFF" 2 "ON" 3 "Error Indicator" ;
VAL_ 3221225472 DATC_FRStVentSwReq 0 "Default" 1 "OFF" 2 "ON" 3 "Error Indicator" ;
VAL_ 3221225472 DATC_FLStOpReq 0 "Default" 1 "Integrated control OFF" 2 "OFF" 3 "Left Seat Ventilation 1st ON" 4 "Left Seat Ventilation 1st&2nd ON" 5 "Left Seat Ventilation 1st&2nd&3rd ON" 6 "Left Seat Warmer 1st ON" 7 "Left Seat Warmer 1st&2nd ON" 8 "Left Seat Warmer 1st&2nd&3rd ON" 9 "Not Used" 10 "Not Used" 11 "Not Used" 12 "Not Used" 13 "Not Used" 14 "Not Used" 15 "Error Indicator" ;
VAL_ 3221225472 DATC_FLStHtrSwReq 0 "Default" 1 "OFF" 2 "ON" 3 "Error Indicator" ;
VAL_ 3221225472 DATC_FLStVentSwReq 0 "Default" 1 "OFF" 2 "ON" 3 "Error Indicator" ;
VAL_ 3221225472 DATC_RRStHtrSwReq 0 "Default" 1 "OFF" 2 "ON" 3 "Error Indicator" ;
VAL_ 3221225472 DATC_RRStVentSwReq 0 "Default" 1 "OFF" 2 "ON" 3 "Error Indicator" ;
VAL_ 3221225472 DATC_RLStHtrSwReq 0 "Error Indicator" 1 "Default" 2 "OFF" 3 "ON" ;
VAL_ 3221225472 DATC_RLStVentSwReq 0 "Default" 1 "OFF" 2 "ON" 3 "Error Indicator" ;
VAL_ 3221225472 TCS_DisableSta 0 "TCS is enabled by user" 1 "TCS is disabled by user" 2 "Not used" 3 "Error Indicator" ;
VAL_ 3221225472 TCS_DfctvSta 0 "TCS is not defective" 1 "TCS is defective (failed)" 2 "Not used" 3 "Error Indicator" ;
VAL_ 3221225472 TCS_CtrlSta 0 "TCS Inactive" 1 "TCS Active" 2 "Not used" 3 "Error Indicator" ;
VAL_ 3221225472 ESC_DisableSta 0 "ESC enabled by user (SW On)0x1:ESC disabled by user (SW Off)" 2 "Not used" 3 "Error Indicator" ;
VAL_ 3221225472 ESC_DfctvSta 0 "ESC is not defective" 1 "ESC is defective (failed)" 2 "Not used" 3 "Error Indicator" ;
VAL_ 3221225472 ESC_CtrlSta 0 "ESC inactive" 1 "ESC active" 2 "Not used" 3 "Error Indicator" ;
VAL_ 3221225472 TCS_PreActvSta 0 "-" 1 "Pre TCS Active" 2 "Not used" 3 "Error Indicator" ;
VAL_ 3221225472 DBC_StdbySta 0 "DBC is not stand by (SW OFF)" 1 "DBC is stand by (SW ON)" 2 "Not used" 3 "Error Indicator" ;
VAL_ 3221225472 DBC_DfctvSta 0 "DBC is not defective" 1 "DBC is defective (failed)" 2 "Not used" 3 "Error Indicator" ;
VAL_ 3221225472 DBC_CtrlSta 0 "DBC is Inactive" 1 "DBC is Active" 2 "Not used" 3 "Error Indicator" ;
VAL_ 3221225472 HAC_StdbySta 0 "HAC is not stand by (SW OFF) If SW is applied" 1 "HAC is stand by (SW ON) If SW is applied" 2 "Not used" 3 "Error Indicator" ;
VAL_ 3221225472 HAC_DfctvSta 0 "HAC is not defective" 1 "HAC is defective (failed)" 2 "Not used" 3 "Error Indicator" ;
VAL_ 3221225472 HAC_CtrlSta 0 "HAC is Inactive" 1 "HAC is Active" 2 "Not used" 3 "Error Indicator" ;
VAL_ 3221225472 TCS_Req 0 "Passive" 1 "TCS/ESC control active" 2 "Not used" 3 "Error Indicator" ;
VAL_ 3221225472 MSR_FuncReq 0 "Passive or TCS function" 1 "MSR control active" 2 "Not used" 3 "Error Indicator" ;
VAL_ 3221225472 TCS_GearShftCharacteristicVal 0 "passive (gear change allowed)" 1 "active (gear change not allowed)" 2 "Not used" 3 "Error Indicator" ;
VAL_ 3221225472 TCS_ManufacturerVal 0 "Using both TQI_TCS and TQI_SLW_TCS" 1 "Using TQI_TCS only (Not using TQI_SLW_TCS)" 2 "Not used" 3 "Error Indicator" ;
VAL_ 3221225472 RL_SHVU_HtSwHiIndSta 0 "OFF" 1 "ON" 2 "Error Indicator" 3 "Invalid" ;
VAL_ 3221225472 RL_SHVU_HtSwMidIndSta 0 "OFF" 1 "ON" 2 "Error Indicator" 3 "Invalid" ;
VAL_ 3221225472 RL_SHVU_HtSwLowIndSta 0 "OFF" 1 "ON" 2 "Error Indicator" 3 "Invalid" ;
VAL_ 3221225472 RL_SHVU_VntSwHiIndSta 0 "OFF" 1 "ON" 2 "Error Indicator" 3 "Invalid" ;
VAL_ 3221225472 RL_SHVU_VntSwMidIndSta 0 "OFF" 1 "ON" 2 "Error Indicator" 3 "Invalid" ;
VAL_ 3221225472 RL_SHVU_VntSwLowIndSta 0 "OFF" 1 "ON" 2 "Error Indicator" 3 "Invalid" ;
VAL_ 3221225472 ESC_CylPrsrVal 4095 "Error" ;
VAL_ 3221225472 ESC_CylPrsrSta 0 "Master cylinder pressure signal is invalid" 1 "Master cylinder pressure signal is valid" 2 "Not used" 3 "Error Indicator" ;
VAL_ 3221225472 ESC_CylPrsrDiagSta 0 "Master cylinder pressure is not available temporarily" 1 "Master cylinder pressure signal is available" 2 "Not used" 3 "Error Indicator" ;
VAL_ 3221225472 ESC_CylPrsrFlagSta 0 "Off" 1 "On" 2 "Not used" 3 "Error Indicator" ;
VAL_ 3221225472 ESC_VsmActvSta 0 "VSM control inactive" 1 "VSM control active" 2 "Not used" 3 "Error Indicator" ;
VAL_ 3221225472 ESC_VsmDfctvSta 0 "VSM is not defective" 1 "VSM is defective" 2 "Not used" 3 "Error Indicator" ;
VAL_ 3221225472 ESC_VsmCtrlModSta 0 "Inactive" 1 "Mode 1 (sensor value overlay mode)" 2 "Mode 2 (output torque overlay mode)" 3 "Mode 3 (Particular control)" ;
VAL_ 3221225472 ESC_StrTqReq 4095 "Error" ;
VAL_ 3221225472 RR_SHVU_HtSwHiIndSta 0 "OFF" 1 "ON" 2 "Error indicator" 3 "invalid" ;
VAL_ 3221225472 RR_SHVU_HtSwMidIndSta 0 "OFF" 1 "ON" 2 "Error Indicator" 3 "Invalid" ;
VAL_ 3221225472 RR_SHVU_HtSwLowIndSta 0 "OFF" 1 "ON" 2 "Error Indicator" 3 "Invalid" ;
VAL_ 3221225472 RR_SHVU_VntSwHiIndSta 0 "OFF" 1 "ON" 2 "Error Indictor" 3 "Invalid" ;
VAL_ 3221225472 RR_SHVU_VntSwMidIndSta 0 "OFF" 1 "ON" 2 "Error Indicator" 3 "Invalid" ;
VAL_ 3221225472 RR_SHVU_VntSwLowIndSta 0 "OFF" 1 "ON" 2 "Error Indicator" 3 "Invalid" ;
VAL_ 3221225472 RLPSU_ReclMtrPos 0 "Default" 1 "Zone1" 2 "Zone2" 3 "Zone3" 4 "Zone4" 5 "Zone5" 6 "Unused" 7 "Invalid" ;
VAL_ 3221225472 ABS_WrngLmpSta 0 "ABS Warning lamp OFF" 1 "ABS Warning lamp ON" 2 "Not used" 3 "Error Indicator" ;
VAL_ 3221225472 ABS_DfctvSta 0 "ABS is not defective" 1 "ABS is defective" 2 "Not used" 3 "Error Indicator" ;
VAL_ 3221225472 ABS_ActvSta 0 "ABS control inactive" 1 "ABS control active" 2 "Not used" 3 "Error Indicator" ;
VAL_ 3221225472 ABS_DiagSta 0 "ABS/TCS/ESC is not diagnostic mode" 1 "ABS/TCS/ESC is diagnostic mode" 2 "Not used" 3 "Error Indicator" ;
VAL_ 3221225472 EBD_WrngLmpSta 0 "EBD Warning lamp OFF" 1 "EBD Warning lamp ON" 2 "Not used" 3 "Error Indicator" ;
VAL_ 3221225472 EBD_DfctvSta 0 "EBD is not defective" 1 "EBD is defective" 2 "Not used" 3 "Error Indicator" ;
VAL_ 3221225472 ESC_BrkLtActvSta 0 "No request" 1 "Activate brake lights" 2 "Not used" 3 "Error Indicator" ;
VAL_ 3221225472 ESS_Sta 0 "ESS control 'inactive' (Normal condition)" 1 "ESS control 'active' (Emergency stop condition)" 2 "ESS system is defective" 3 "ESS extended function active (Hazard lamp blinking)" ;
VAL_ 3221225472 TCS_LmpSta 0 "TCS/ESC Function/Warning Lamp OFF" 1 "TCS/ESC Function/Warning Lamp ON" 2 "TCS/ESC Function/Warning Lamp BLINKING(2Hz)" 3 "Error Indicator" ;
VAL_ 3221225472 TCS_OffLmpSta 0 "TCS/ESC OFF SW Lamp OFF" 1 "TCS/ESC OFF SW Lamp ON" 2 "Not used" 3 "Error Indicator" ;
VAL_ 3221225472 ESC_OffTempSta 0 "Normal Mode" 1 "Sports Mode" 2 "Off Mode" 3 "ESC OFF SW is defective (failed)" ;
VAL_ 3221225472 DBC_WrngLmpSta 0 "DBC Warning lamp OFF" 1 "DBC Warning lamp ON" 2 "Not used" 3 "Error Indicator" ;
VAL_ 3221225472 DBC_FuncLmpSta 0 "DBC Function lamp OFF" 1 "DBC Function lamp ON" 2 "DBC Function lamp BLINKING(2Hz)" 3 "Error Indicator" ;
VAL_ 3221225472 ESC_BrkCtrlSta 0 "Brake control is not in activation" 1 "Brake control is in activation" 2 "Not used" 3 "Error Indicator" ;
VAL_ 3221225472 RRPSU_ReclMtrPos 0 "Default" 1 "Zone1" 2 "Zone2" 3 "Zone3" 4 "Zone4" 5 "Zone5" 6 "Unused" 7 "Invalid" ;
VAL_ 3221225472 Wiper_PrkngPosSta 0 "else" 1 "Parking Position" 2 "Not Used" 3 "Error Indicator" ;
VAL_ 3221225472 Wiper_RainSnsrOptionTyp 0 "Non Rain Sensor Option" 1 "Rain Sensor Option" 2 "Not Used" 3 "Error Indicator" ;
VAL_ 3221225472 Wiper_RainSnsrSta 0 "OFF" 1 "Rain Detected" 2 "Low" 3 "High" 4 "Fault 1" 5 "Fault 2" 6 "Fault 3" 7 "Reserved" 8 "Reserved" 9 "Reserved" 10 "Reserved" 11 "Reserved" 12 "Reserved" 13 "Reserved" 14 "Not Used" 15 "Error Indicator" ;
