VERSION ""

NS_ :

BS_:

BU_: MLM IBU_HS ILCU_RH MFSW DPSU ILCU_LH PSB APSU DPSS SWRC CGW PTGM DLBCU SCM DAU WPC IAU eCall PFSU RDC PSM

BO_ 3221225472 VECTOR__INDEPENDENT_SIG_MSG: 0 Vector__XXX
 SG_ ENG_AirconPrsrSnsrVal : 0|8@1+ (125,0) [0|0] "hPa" Vector__XXX
 SG_ ENG_CadModSta : 0|3@1+ (1,0) [0|0] "" Vector__XXX
 SG_ ENG_IsgSta : 0|3@1+ (1,0) [0|0] "" Vector__XXX
 SG_ ENG_OilLvlSta : 0|2@1+ (1,0) [0|0] "" Vector__XXX
 SG_ ODS_Crc1Val : 0|16@1+ (1,0) [0|0] "" Vector__XXX
 SG_ ODS_AlvCnt1Val : 0|8@1+ (1,0) [0|0] "" Vector__XXX
 SG_ ODS_IdVal : 0|8@1+ (1,0) [0|0] "" Vector__XXX
 SG_ ODS_OccClassSta : 0|8@1+ (1,0) [0|0] "" Vector__XXX
 SG_ ODS_DiagSta : 0|8@1+ (1,0) [0|0] "" Vector__XXX
 SG_ FL_SHVU_SeatOptSta : 0|3@1+ (1,0) [0|0] "" Vector__XXX
 SG_ FL_SHVU_SeatHtOperSta : 0|4@1+ (1,0) [0|0] "" Vector__XXX
 SG_ FL_SHVU_HtSwHiIndSta : 0|2@1+ (1,0) [0|0] "" Vector__XXX
 SG_ FL_SHVU_HtSwMidIndSta : 0|2@1+ (1,0) [0|0] "" Vector__XXX
 SG_ FL_SHVU_HtSwLowIndSta : 0|2@1+ (1,0) [0|0] "" Vector__XXX
 SG_ FL_SHVU_VntSwHiIndSta : 0|2@1+ (1,0) [0|0] "" Vector__XXX
 SG_ FL_SHVU_VntSwMidIndSta : 0|2@1+ (1,0) [0|0] "" Vector__XXX
 SG_ FL_SHVU_VntSwLowIndSta : 0|2@1+ (1,0) [0|0] "" Vector__XXX
 SG_ C_HazardFromIBOX : 0|1@1+ (1,0) [0|0] "" Vector__XXX
 SG_ C_PanicFromIBOX : 0|1@1+ (1,0) [0|0] "" Vector__XXX
 SG_ C_CtrlDrUnlockRlyIBOX : 0|1@1+ (1,0) [0|0] "" Vector__XXX
 SG_ C_CtrlDrLockRlyIBOX : 0|1@1+ (1,0) [0|0] "" Vector__XXX
 SG_ C_TeleHeatingCmdIBOX : 0|2@1+ (1,0) [0|0] "" Vector__XXX
 SG_ C_TeleStrgWhlHeatingCmdIBOX : 0|2@1+ (1,0) [0|0] "" Vector__XXX
 SG_ C_TeleDefoggerHeatingCmdIBOX : 0|2@1+ (1,0) [0|0] "" Vector__XXX
 SG_ C_TeleAstSeatOpCmdIBOX : 0|4@1+ (1,0) [0|0] "" Vector__XXX
 SG_ C_TeleDrvSeatOpCmdIBOX : 0|4@1+ (1,0) [0|0] "" Vector__XXX
 SG_ C_TeleRRSeatOpCmdIBOX : 0|4@1+ (1,0) [0|0] "" Vector__XXX
 SG_ C_TeleRLSeatOpCmdIBOX : 0|4@1+ (1,0) [0|0] "" Vector__XXX
 SG_ CF_AVN_CluWelcomeSnd : 0|2@1+ (1,0) [0|0] "" Vector__XXX
 SG_ CF_AVN_CluAutoInitFuelEconomy : 0|3@1+ (1,0) [0|0] "" Vector__XXX
 SG_ CF_AVN_CluVoiceVolume : 0|3@1+ (1,0) [0|0] "" Vector__XXX
 SG_ CF_AVN_CluServiceReminderSet : 0|2@1+ (1,0) [0|0] "" Vector__XXX
 SG_ CF_AVN_CluTransmissionDisp : 0|2@1+ (1,0) [0|0] "" Vector__XXX
 SG_ CF_AVN_CluWiperLight : 0|2@1+ (1,0) [0|0] "" Vector__XXX
 SG_ CF_AVN_CluRoadInfoGuide : 0|2@1+ (1,0) [0|0] "" Vector__XXX
 SG_ CF_AVN_CluUserSettingPeriod : 0|7@1+ (1,0) [0|0] "" Vector__XXX
 SG_ CF_AVN_CluSubspeedOdometerDisp : 0|2@1+ (1,0) [0|0] "" Vector__XXX
 SG_ CF_AVN_CluFuelEconUnit_mi : 0|2@1+ (1,0) [0|0] "" Vector__XXX
 SG_ CF_AVN_CluFuelEconUnit_km : 0|2@1+ (1,0) [0|0] "" Vector__XXX
 SG_ CF_AVN_CluUserSettingDistance : 0|17@1+ (1,0) [0|0] "" Vector__XXX
 SG_ CF_AVN_UnitReset : 0|2@1+ (1,0) [0|0] "" Vector__XXX
 SG_ CF_AVN_IcyRoadWarn : 0|2@1+ (1,0) [0|0] "" Vector__XXX
 SG_ CF_AVN_CluServiceReminderReset : 0|2@1+ (1,0) [0|0] "" Vector__XXX
 SG_ CF_AVN_CluUSMReset : 0|2@1+ (1,0) [0|0] "" Vector__XXX
 SG_ C_PTGMNValueSet : 0|2@1+ (1,0) [0|0] "" Vector__XXX
 SG_ CF_AVN_ADrUNValueSet : 0|3@1+ (1,0) [0|0] "" Vector__XXX
 SG_ CF_AVN_ADrLNValueSet : 0|3@1+ (1,0) [0|0] "" Vector__XXX
 SG_ CF_AVN_EscortHLNValueSet : 0|2@1+ (1,0) [0|0] "" Vector__XXX
 SG_ CF_AVN_PSMNValueSet : 0|3@1+ (1,0) [0|0] "" Vector__XXX
 SG_ C_HfreeTrunkTgNValueSet : 0|3@1+ (1,0) [0|0] "" Vector__XXX
 SG_ CF_AVN_TrfChgSet : 0|2@1+ (1,0) [0|0] "" Vector__XXX
 SG_ CF_AVN_SCMNValueSet : 0|2@1+ (1,0) [0|0] "" Vector__XXX
 SG_ CF_AVN_OTTurnNValueSet : 0|3@1+ (1,0) [0|0] "" Vector__XXX
 SG_ CF_Gway_WPCNValueSet : 0|2@1+ (1,0) [0|0] "" Vector__XXX
 SG_ C_AVN_RearWiperNValueSet : 0|2@1+ (1,0) [0|0] "" Vector__XXX
 SG_ C_UnlockWelocomeNValueSet : 0|2@1+ (1,0) [0|0] "" Vector__XXX
 SG_ C_SmartWelocomeNValueSet : 0|2@1+ (1,0) [0|0] "" Vector__XXX
 SG_ CF_AVN_PTGSpeedNValueSet : 0|2@1+ (1,0) [0|0] "" Vector__XXX
 SG_ CR_Datc_DRSeatWheel_USM_Set : 0|2@1+ (1,0) [0|0] "" Vector__XXX
 SG_ CF_AVN_TTUnlockNValueSet : 0|2@1+ (1,0) [0|0] "" Vector__XXX
 SG_ CF_Avn_BolsterNValueSet : 0|2@1+ (1,0) [0|0] "" Vector__XXX
 SG_ C_StrWheelAutoHeatNValueSet : 0|2@1+ (1,0) [0|0] "" Vector__XXX
 SG_ CF_Avn_HAPTICWARNINGNValueSet : 0|3@1+ (1,0) [0|0] "" Vector__XXX
 SG_ CR_Datc_DRSeatHeat_USM_Set : 0|2@1+ (1,0) [0|0] "" Vector__XXX
 SG_ C_WALNValueSet : 0|2@1+ (1,0) [0|0] "" Vector__XXX
 SG_ CF_AVN_RrSeatRemindNValueSet : 0|2@1+ (1,0) [0|0] "" Vector__XXX
 SG_ CF_AVN_TunnelWindowNvalueSet : 0|2@1+ (1,0) [0|0] "" Vector__XXX
 SG_ CF_AVN_MoodLpRedNValueSet : 0|10@1+ (1,0) [0|0] "" Vector__XXX
 SG_ CF_AVN_MoodLpGreenNValueSet : 0|10@1+ (1,0) [0|0] "" Vector__XXX
 SG_ CF_AVN_MoodLpBlueNValueSet : 0|10@1+ (1,0) [0|0] "" Vector__XXX
 SG_ CF_AVN_MoodLpBrightNValueSet : 0|9@1+ (1,0) [0|0] "" Vector__XXX
 SG_ C_MoodLpDrivingNValue : 0|2@1+ (1,0) [0|0] "" Vector__XXX
 SG_ C_HCIMSWeightNValueSet : 0|4@1+ (1,0) [0|0] "" Vector__XXX
 SG_ C_HCIMSHeightNvalueSet : 0|4@1+ (1,0) [0|0] "" Vector__XXX
 SG_ CF_AVN_HCIMSButtonCommand : 0|4@1+ (1,0) [0|0] "" Vector__XXX
 SG_ C_HCIMSSitHeightNValueSet : 0|4@1+ (1,0) [0|0] "" Vector__XXX
 SG_ CF_AVN_SeatDrvModNValueSet : 0|2@1+ (1,0) [0|0] "" Vector__XXX
 SG_ CF_AVN_AirSptStrNValueSet : 0|2@1+ (1,0) [0|0] "" Vector__XXX
 SG_ CF_AVN_AirSptTimeNValueSet : 0|3@1+ (1,0) [0|0] "" Vector__XXX
 SG_ CF_AVN_CushSoftNValueSet : 0|3@1+ (1,0) [0|0] "" Vector__XXX
 SG_ DoorLock_DrvrDrUnLkPsvAcsReq : 0|2@1+ (1,0) [0|0] "" Vector__XXX
 SG_ DoorLock_RmtKeyDrvrDrUnLkReq : 0|2@1+ (1,0) [0|0] "" Vector__XXX
 SG_ PTGM_GST_Byte0 : 0|8@1+ (1,0) [0|0] "" Vector__XXX
 SG_ PTGM_GST_Byte1 : 0|8@1+ (1,0) [0|0] "" Vector__XXX
 SG_ PTGM_GST_Byte2 : 0|8@1+ (1,0) [0|0] "" Vector__XXX
 SG_ PTGM_GST_Byte3 : 0|8@1+ (1,0) [0|0] "" Vector__XXX
 SG_ PTGM_GST_Byte4 : 0|8@1+ (1,0) [0|0] "" Vector__XXX
 SG_ PTGM_GST_Byte5 : 0|8@1+ (1,0) [0|0] "" Vector__XXX
 SG_ PTGM_GST_Byte6 : 0|8@1+ (1,0) [0|0] "" Vector__XXX
 SG_ PTGM_GST_Byte7 : 0|8@1+ (1,0) [0|0] "" Vector__XXX
 SG_ GST_PTGM_Byte0 : 0|8@1+ (1,0) [0|0] "" Vector__XXX
 SG_ GST_PTGM_Byte1 : 0|8@1+ (1,0) [0|0] "" Vector__XXX
 SG_ GST_PTGM_Byte2 : 0|8@1+ (1,0) [0|0] "" Vector__XXX
 SG_ GST_PTGM_Byte3 : 0|8@1+ (1,0) [0|0] "" Vector__XXX
 SG_ GST_PTGM_Byte4 : 0|8@1+ (1,0) [0|0] "" Vector__XXX
 SG_ GST_PTGM_Byte5 : 0|8@1+ (1,0) [0|0] "" Vector__XXX
 SG_ GST_PTGM_Byte6 : 0|8@1+ (1,0) [0|0] "" Vector__XXX
 SG_ GST_PTGM_Byte7 : 0|8@1+ (1,0) [0|0] "" Vector__XXX
 SG_ ENG_Ack4EngStpSta : 0|2@1+ (1,0) [0|0] "" Vector__XXX
 SG_ ENG_OverDrvOffReq : 0|2@1+ (1,0) [0|0] "" Vector__XXX
 SG_ ENG_AccActSta : 0|2@1+ (1,0) [0|0] "" Vector__XXX
 SG_ ENG_CltchOpSta : 0|2@1+ (1,0) [0|0] "" Vector__XXX
 SG_ DSL_GlowCtrlReq : 0|2@1+ (1,0) [0|0] "" Vector__XXX
 SG_ ENG_GlowLmpSta : 0|2@1+ (1,0) [0|0] "" Vector__XXX
 SG_ ENG_ThrPosVal : 0|8@1+ (0.4694836,-15.0234742) [0|0] "%" Vector__XXX
 SG_ ENG_AccelPdlVal : 0|10@1+ (0.09784,0) [0|0] "%" Vector__XXX
 SG_ ACC_CrsMainSwLmpSta : 0|2@1+ (1,0) [0|0] "" Vector__XXX
 SG_ ACC_CrsSetSwLmpSta : 0|2@1+ (1,0) [0|0] "" Vector__XXX
 SG_ ENG_PreFuelCutInSta : 0|2@1+ (1,0) [0|0] "" Vector__XXX
 SG_ ENG_SoakTimeErrSta : 0|2@1+ (1,0) [0|0] "" Vector__XXX
 SG_ ENG_SoakTimeVal : 0|8@1+ (1,0) [0|0] "Min" Vector__XXX
 SG_ ENG_SprkTimeVal : 0|8@1+ (0.375,-35.625) [0|0] "˚" Vector__XXX
 SG_ ENG_MinIndTqVal : 0|12@1- (1,0) [0|0] "Nm" Vector__XXX
 SG_ ENG_TrgtTqVal : 0|12@1- (1,0) [0|0] "Nm" Vector__XXX
 SG_ ENG_MaxIndTqVal : 0|12@1- (1,0) [0|0] "Nm" Vector__XXX
 SG_ ENG_AppAccelPdlSta : 0|2@1+ (1,0) [0|0] "" Vector__XXX
 SG_ ENG_BrkCtrlReq : 0|2@1+ (1,0) [0|0] "" Vector__XXX
 SG_ ACC_DnShftCtrlReq : 0|4@1+ (1,0) [0|0] "" Vector__XXX
 SG_ ENG_ReprgmModRdySta : 0|2@1+ (1,0) [0|0] "" Vector__XXX
 SG_ ENG_AafOpnReq : 0|2@1+ (1,0) [0|0] "" Vector__XXX
 SG_ EMS_Crc2Val : 0|16@1+ (1,0) [0|0] "" Vector__XXX
 SG_ EMS_AlvCnt2Val : 0|8@1+ (1,0) [0|0] "" Vector__XXX
 SG_ ENG_BrkSwSta : 0|2@1+ (1,0) [0|0] "" Vector__XXX
 SG_ ENG_ObdFrzFrmSta : 0|6@1+ (1,0) [0|0] "" Vector__XXX
 SG_ ENG_EngClntTempVal : 0|8@1+ (0.75,-48) [0|0] "℃" Vector__XXX
 SG_ ENG_MafCrctVal : 0|8@1+ (0.00781,0) [0|0] "" Vector__XXX
 SG_ ENG_BattDscnctSta : 0|2@1+ (1,0) [0|0] "" Vector__XXX
 SG_ OBD_MilConfgVal : 0|3@1+ (1,0) [0|0] "" Vector__XXX
 SG_ ENG_EngSta : 0|3@1+ (1,0) [0|0] "" Vector__XXX
 SG_ ENG_DclBrkCntrlReq : 0|12@1+ (0.001,-4.094) [0|0] "m/s^2" Vector__XXX
 SG_ ENG_BstPrsrVal : 0|12@1+ (1.322,0) [0|0] "hPa" Vector__XXX
 SG_ ENG_EngOilTempVal : 0|8@1+ (0.75,-40) [0|0] "℃" Vector__XXX
 SG_ ENG_AmbtTempModelVal : 0|8@1+ (0.5,-41) [0|0] "℃" Vector__XXX
 SG_ ENG_DpfWrngSta : 0|2@1+ (1,0) [0|0] "" Vector__XXX
 SG_ ENG_BattWrngLmpSta : 0|2@1+ (1,0) [0|0] "" Vector__XXX
 SG_ ENG_OilPrsrWrngLmpSta : 0|2@1+ (1,0) [0|0] "" Vector__XXX
 SG_ ENG_IsgInhbtLmpSta : 0|2@1+ (1,0) [0|0] "" Vector__XXX
 SG_ DLBCU_GST_Byte0 : 0|8@1+ (1,0) [0|0] "" Vector__XXX
 SG_ DLBCU_GST_Byte1 : 0|8@1+ (1,0) [0|0] "" Vector__XXX
 SG_ DLBCU_GST_Byte2 : 0|8@1+ (1,0) [0|0] "" Vector__XXX
 SG_ DLBCU_GST_Byte3 : 0|8@1+ (1,0) [0|0] "" Vector__XXX
 SG_ DLBCU_GST_Byte4 : 0|8@1+ (1,0) [0|0] "" Vector__XXX
 SG_ DLBCU_GST_Byte5 : 0|8@1+ (1,0) [0|0] "" Vector__XXX
 SG_ DLBCU_GST_Byte6 : 0|8@1+ (1,0) [0|0] "" Vector__XXX
 SG_ DLBCU_GST_Byte7 : 0|8@1+ (1,0) [0|0] "" Vector__XXX
 SG_ DPSS_GST_Byte0 : 0|8@1+ (1,0) [0|0] "" Vector__XXX
 SG_ DPSS_GST_Byte1 : 0|8@1+ (1,0) [0|0] "" Vector__XXX
 SG_ DPSS_GST_Byte2 : 0|8@1+ (1,0) [0|0] "" Vector__XXX
 SG_ DPSS_GST_Byte3 : 0|8@1+ (1,0) [0|0] "" Vector__XXX
 SG_ DPSS_GST_Byte4 : 0|8@1+ (1,0) [0|0] "" Vector__XXX
 SG_ DPSS_GST_Byte5 : 0|8@1+ (1,0) [0|0] "" Vector__XXX
 SG_ DPSS_GST_Byte6 : 0|8@1+ (1,0) [0|0] "" Vector__XXX
 SG_ DPSS_GST_Byte7 : 0|8@1+ (1,0) [0|0] "" Vector__XXX
 SG_ GST_DLBCU_Byte0 : 0|8@1+ (1,0) [0|0] "" Vector__XXX
 SG_ GST_DLBCU_Byte1 : 0|8@1+ (1,0) [0|0] "" Vector__XXX
 SG_ GST_DLBCU_Byte2 : 0|8@1+ (1,0) [0|0] "" Vector__XXX
 SG_ GST_DLBCU_Byte3 : 0|8@1+ (1,0) [0|0] "" Vector__XXX
 SG_ GST_DLBCU_Byte4 : 0|8@1+ (1,0) [0|0] "" Vector__XXX
 SG_ GST_DLBCU_Byte5 : 0|8@1+ (1,0) [0|0] "" Vector__XXX
 SG_ GST_DLBCU_Byte6 : 0|8@1+ (1,0) [0|0] "" Vector__XXX
 SG_ GST_DLBCU_Byte7 : 0|8@1+ (1,0) [0|0] "" Vector__XXX
 SG_ GST_DPSS_Byte0 : 0|8@1+ (1,0) [0|0] "" Vector__XXX
 SG_ GST_DPSS_Byte1 : 0|8@1+ (1,0) [0|0] "" Vector__XXX
 SG_ GST_DPSS_Byte2 : 0|8@1+ (1,0) [0|0] "" Vector__XXX
 SG_ GST_DPSS_Byte3 : 0|8@1+ (1,0) [0|0] "" Vector__XXX
 SG_ GST_DPSS_Byte4 : 0|8@1+ (1,0) [0|0] "" Vector__XXX
 SG_ GST_DPSS_Byte5 : 0|8@1+ (1,0) [0|0] "" Vector__XXX
 SG_ GST_DPSS_Byte6 : 0|8@1+ (1,0) [0|0] "" Vector__XXX
 SG_ GST_DPSS_Byte7 : 0|8@1+ (1,0) [0|0] "" Vector__XXX
 SG_ SAS_Crc1Val : 0|16@1+ (1,0) [0|0] "" Vector__XXX
 SG_ SAS_AlvCnt1Val : 0|8@1+ (1,0) [0|0] "" Vector__XXX
 SG_ SAS_AnglVal : 0|16@1- (0.1,0) [0|0] "Deg" Vector__XXX
 SG_ SAS_SpdVal : 0|8@1+ (4,0) [0|0] "Deg/s" Vector__XXX
 SG_ SAS_IntSta : 0|8@1+ (1,0) [0|0] "" Vector__XXX
 SG_ ADAS_CMD_Crc30Val : 0|16@1+ (1,0) [0|0] "" Vector__XXX
 SG_ ADAS_CMD_AlvCnt30Val : 0|8@1+ (1,0) [0|0] "" Vector__XXX
 SG_ LKA_OptUsmSta : 0|3@1+ (1,0) [0|0] "" Vector__XXX
 SG_ LKA_RcgSta : 0|3@1+ (1,0) [0|0] "" Vector__XXX
 SG_ LKA_LHLnWrnSta : 0|2@1+ (1,0) [0|0] "" Vector__XXX
 SG_ LKA_RHLnWrnSta : 0|2@1+ (1,0) [0|0] "" Vector__XXX
 SG_ LKA_HndsoffSnd : 0|2@1+ (1,0) [0|0] "" Vector__XXX
 SG_ LKA_StrSnd : 0|2@1+ (1,0) [0|0] "" Vector__XXX
 SG_ LKA_SysIndReq : 0|3@1+ (1,0) [0|0] "" Vector__XXX
 SG_ LKA_StrTqReqVal : 0|11@1+ (0.0078125,-8) [0|0] "Nm" Vector__XXX
 SG_ LKA_ActToiSta : 0|2@1+ (1,0) [0|0] "" Vector__XXX
 SG_ LKA_ToiFltSta : 0|2@1+ (1,0) [0|0] "" Vector__XXX
 SG_ BCA_Rear_WrnSta : 0|3@1+ (1,0) [0|0] "" Vector__XXX
 SG_ FCA_LO_WrnSta : 0|3@1+ (1,0) [0|0] "" Vector__XXX
 SG_ FCA_LS_WrnSta : 0|3@1+ (1,0) [0|0] "" Vector__XXX
 SG_ BCAref_FrCmrSta : 0|3@1+ (1,0) [0|0] "" Vector__XXX
 SG_ BCA_WrngSta : 0|2@1+ (1,0) [0|0] "" Vector__XXX
 SG_ LKA_UsmMod : 0|2@1+ (1,0) [0|0] "" Vector__XXX
 SG_ Info_PedtrnDst : 0|3@1+ (1,0) [0|0] "" Vector__XXX
 SG_ ACU_APSB_Crc1Val : 0|16@1+ (1,0) [0|0] "" Vector__XXX
 SG_ ACU_APSB_AlvCnt1Val : 0|8@1+ (1,0) [0|0] "" Vector__XXX
 SG_ APSB_ConfTbl : 0|6@1+ (1,0) [0|0] "" Vector__XXX
 SG_ APSB_CrashActvSta : 0|2@1+ (1,0) [0|0] "" Vector__XXX
 SG_ APSB_RRDrvImpt : 0|4@1+ (1,0) [0|0] "" Vector__XXX
 SG_ APSB_FCAFrImpt : 0|4@1+ (1,0) [0|0] "" Vector__XXX
 SG_ APSB_MinFrImpt : 0|4@1+ (1,0) [0|0] "" Vector__XXX
 SG_ APSB_MinSidImpt : 0|4@1+ (1,0) [0|0] "" Vector__XXX
 SG_ APSB_MinRollDetn : 0|4@1+ (1,0) [0|0] "" Vector__XXX
 SG_ APSB_MinRearImpt : 0|4@1+ (1,0) [0|0] "" Vector__XXX
 SG_ RRPSU_GST_Byte0 : 0|8@1+ (1,0) [0|0] "" Vector__XXX
 SG_ RRPSU_GST_Byte1 : 0|8@1+ (1,0) [0|0] "" Vector__XXX
 SG_ RRPSU_GST_Byte2 : 0|8@1+ (1,0) [0|0] "" Vector__XXX
 SG_ RRPSU_GST_Byte3 : 0|8@1+ (1,0) [0|0] "" Vector__XXX
 SG_ RRPSU_GST_Byte4 : 0|8@1+ (1,0) [0|0] "" Vector__XXX
 SG_ RRPSU_GST_Byte5 : 0|8@1+ (1,0) [0|0] "" Vector__XXX
 SG_ RRPSU_GST_Byte6 : 0|8@1+ (1,0) [0|0] "" Vector__XXX
 SG_ RRPSU_GST_Byte7 : 0|8@1+ (1,0) [0|0] "" Vector__XXX
 SG_ RLPSU_GST_Byte0 : 0|8@1+ (1,0) [0|0] "" Vector__XXX
 SG_ RLPSU_GST_Byte1 : 0|8@1+ (1,0) [0|0] "" Vector__XXX
 SG_ RLPSU_GST_Byte2 : 0|8@1+ (1,0) [0|0] "" Vector__XXX
 SG_ RLPSU_GST_Byte3 : 0|8@1+ (1,0) [0|0] "" Vector__XXX
 SG_ RLPSU_GST_Byte4 : 0|8@1+ (1,0) [0|0] "" Vector__XXX
 SG_ RLPSU_GST_Byte5 : 0|8@1+ (1,0) [0|0] "" Vector__XXX
 SG_ RLPSU_GST_Byte6 : 0|8@1+ (1,0) [0|0] "" Vector__XXX
 SG_ RLPSU_GST_Byte7 : 0|8@1+ (1,0) [0|0] "" Vector__XXX
 SG_ GST_RRPSU_Byte0 : 0|8@1+ (1,0) [0|0] "" Vector__XXX
 SG_ GST_RRPSU_Byte1 : 0|8@1+ (1,0) [0|0] "" Vector__XXX
 SG_ GST_RRPSU_Byte2 : 0|8@1+ (1,0) [0|0] "" Vector__XXX
 SG_ GST_RRPSU_Byte3 : 0|8@1+ (1,0) [0|0] "" Vector__XXX
 SG_ GST_RRPSU_Byte4 : 0|8@1+ (1,0) [0|0] "" Vector__XXX
 SG_ GST_RRPSU_Byte5 : 0|8@1+ (1,0) [0|0] "" Vector__XXX
 SG_ GST_RRPSU_Byte6 : 0|8@1+ (1,0) [0|0] "" Vector__XXX
 SG_ GST_RRPSU_Byte7 : 0|8@1+ (1,0) [0|0] "" Vector__XXX
 SG_ GST_RLPSU_Byte0 : 0|8@1+ (1,0) [0|0] "" Vector__XXX
 SG_ GST_RLPSU_Byte1 : 0|8@1+ (1,0) [0|0] "" Vector__XXX
 SG_ GST_RLPSU_Byte2 : 0|8@1+ (1,0) [0|0] "" Vector__XXX
 SG_ GST_RLPSU_Byte3 : 0|8@1+ (1,0) [0|0] "" Vector__XXX
 SG_ GST_RLPSU_Byte4 : 0|8@1+ (1,0) [0|0] "" Vector__XXX
 SG_ GST_RLPSU_Byte5 : 0|8@1+ (1,0) [0|0] "" Vector__XXX
 SG_ GST_RLPSU_Byte6 : 0|8@1+ (1,0) [0|0] "" Vector__XXX
 SG_ GST_RLPSU_Byte7 : 0|8@1+ (1,0) [0|0] "" Vector__XXX
 SG_ DATC_Crc1Val : 0|16@1+ (1,0) [0|0] "" Vector__XXX
 SG_ DATC_AlvCnt1Val : 0|8@1+ (1,0) [0|0] "" Vector__XXX
 SG_ DATC_PtcRlySta : 0|3@1+ (1,0) [0|0] "" Vector__XXX
 SG_ DATC_ManufacturerTyp : 0|3@1+ (1,0) [0|0] "" Vector__XXX
 SG_ DATC_AcnCompTyp : 0|3@1+ (1,0) [0|0] "flag" Vector__XXX
 SG_ DATC_AcnReq : 0|2@1+ (1,0) [0|0] "" Vector__XXX
 SG_ DATC_BlwSta : 0|2@1+ (1,0) [0|0] "" Vector__XXX
 SG_ DATC_BlwMaxSta : 0|2@1+ (1,0) [0|0] "" Vector__XXX
 SG_ DATC_EngStrtReq : 0|2@1+ (1,0) [0|0] "" Vector__XXX
 SG_ DATC_IsgInhbtReq : 0|2@1+ (1,0) [0|0] "" Vector__XXX
 SG_ DATC_AcnCompOnReq : 0|2@1+ (1,0) [0|0] "flag" Vector__XXX
 SG_ DATC_EngIdlRpmUpReq : 0|2@1+ (1,0) [0|0] "" Vector__XXX
 SG_ DATC_EcvFltSta : 0|2@1+ (1,0) [0|0] "" Vector__XXX
 SG_ DATC_CalcAcnCompTqVal : 0|8@1+ (0.2,0) [0|0] "Nm" Vector__XXX
 SG_ WPC_GST_Byte0 : 0|8@1+ (1,0) [0|0] "" Vector__XXX
 SG_ WPC_GST_Byte1 : 0|8@1+ (1,0) [0|0] "" Vector__XXX
 SG_ WPC_GST_Byte2 : 0|8@1+ (1,0) [0|0] "" Vector__XXX
 SG_ WPC_GST_Byte3 : 0|8@1+ (1,0) [0|0] "" Vector__XXX
 SG_ WPC_GST_Byte4 : 0|8@1+ (1,0) [0|0] "" Vector__XXX
 SG_ WPC_GST_Byte5 : 0|8@1+ (1,0) [0|0] "" Vector__XXX
 SG_ WPC_GST_Byte6 : 0|8@1+ (1,0) [0|0] "" Vector__XXX
 SG_ WPC_GST_Byte7 : 0|8@1+ (1,0) [0|0] "" Vector__XXX
 SG_ GST_WPC_Byte0 : 0|8@1+ (1,0) [0|0] "" Vector__XXX
 SG_ GST_WPC_Byte1 : 0|8@1+ (1,0) [0|0] "" Vector__XXX
 SG_ GST_WPC_Byte2 : 0|8@1+ (1,0) [0|0] "" Vector__XXX
 SG_ GST_WPC_Byte3 : 0|8@1+ (1,0) [0|0] "" Vector__XXX
 SG_ GST_WPC_Byte4 : 0|8@1+ (1,0) [0|0] "" Vector__XXX
 SG_ GST_WPC_Byte5 : 0|8@1+ (1,0) [0|0] "" Vector__XXX
 SG_ GST_WPC_Byte6 : 0|8@1+ (1,0) [0|0] "" Vector__XXX
 SG_ GST_WPC_Byte7 : 0|8@1+ (1,0) [0|0] "" Vector__XXX
 SG_ DATC_OutTempSnsrVal : 0|8@1+ (0.5,-40) [0|0] "℃" Vector__XXX
 SG_ DATC_DfgSw : 0|2@1+ (1,0) [0|0] "" Vector__XXX
 SG_ ADAS_PRK_Crc1Val : 0|16@1+ (1,0) [0|0] "" Vector__XXX
 SG_ ADAS_PRK_AlvCnt1Val : 0|8@1+ (1,0) [0|0] "" Vector__XXX
 SG_ PCA_SysSta : 0|3@1+ (1,0) [0|0] "" Vector__XXX
 SG_ PCA_EquipSta : 0|3@1+ (1,0) [0|0] "" Vector__XXX
 SG_ PCA_WrngLvlSta : 0|3@1+ (1,0) [0|0] "" Vector__XXX
 SG_ PCA_WrngMsgSta : 0|3@1+ (1,0) [0|0] "" Vector__XXX
 SG_ PCA_WrngSndCtrSta : 0|2@1+ (1,0) [0|0] "" Vector__XXX
 SG_ PCA_WrngSndLftSta : 0|2@1+ (1,0) [0|0] "" Vector__XXX
 SG_ PCA_WrngSndRtSta : 0|2@1+ (1,0) [0|0] "" Vector__XXX
 SG_ PCA_BrkReq : 0|1@1+ (1,0) [0|0] "" Vector__XXX
 SG_ PCA_DclTrgtVal : 0|4@1+ (0.04,0) [0|0] "" Vector__XXX
 SG_ PCA_DgrSta : 0|3@1+ (1,0) [0|0] "" Vector__XXX
 SG_ RRHVU_GST_Byte0 : 0|8@1+ (1,0) [0|0] "" Vector__XXX
 SG_ RRHVU_GST_Byte1 : 0|8@1+ (1,0) [0|0] "" Vector__XXX
 SG_ RRHVU_GST_Byte2 : 0|8@1+ (1,0) [0|0] "" Vector__XXX
 SG_ RRHVU_GST_Byte3 : 0|8@1+ (1,0) [0|0] "" Vector__XXX
 SG_ RRHVU_GST_Byte4 : 0|8@1+ (1,0) [0|0] "" Vector__XXX
 SG_ RRHVU_GST_Byte5 : 0|8@1+ (1,0) [0|0] "" Vector__XXX
 SG_ RRHVU_GST_Byte6 : 0|8@1+ (1,0) [0|0] "" Vector__XXX
 SG_ RRHVU_GST_Byte7 : 0|8@1+ (1,0) [0|0] "" Vector__XXX
 SG_ MLM_GST_Byte0 : 0|8@1+ (1,0) [0|0] "" Vector__XXX
 SG_ MLM_GST_Byte1 : 0|8@1+ (1,0) [0|0] "" Vector__XXX
 SG_ MLM_GST_Byte2 : 0|8@1+ (1,0) [0|0] "" Vector__XXX
 SG_ MLM_GST_Byte3 : 0|8@1+ (1,0) [0|0] "" Vector__XXX
 SG_ MLM_GST_Byte4 : 0|8@1+ (1,0) [0|0] "" Vector__XXX
 SG_ MLM_GST_Byte5 : 0|8@1+ (1,0) [0|0] "" Vector__XXX
 SG_ MLM_GST_Byte6 : 0|8@1+ (1,0) [0|0] "" Vector__XXX
 SG_ MLM_GST_Byte7 : 0|8@1+ (1,0) [0|0] "" Vector__XXX
 SG_ ADAS_CMD_Crc10Val : 0|16@1+ (1,0) [0|0] "" Vector__XXX
 SG_ ADAS_CMD_AlvCnt10Val : 0|8@1+ (1,0) [0|0] "" Vector__XXX
 SG_ FCA_OnOffEquipSta : 0|3@1+ (1,0) [0|0] "" Vector__XXX
 SG_ FCA_SysFlrSta : 0|3@1+ (1,0) [0|0] "" Vector__XXX
 SG_ FCA_WrngLvlSta : 0|2@1+ (1,0) [0|0] "" Vector__XXX
 SG_ FCA_VehStpReq : 0|2@1+ (1,0) [0|0] "" Vector__XXX
 SG_ FCA_StbltActvReq : 0|3@1+ (1,0) [0|0] "" Vector__XXX
 SG_ FCA_HydrlcBstAsstReq : 0|2@1+ (1,0) [0|0] "" Vector__XXX
 SG_ FCA_DclReqVal : 0|8@1+ (0.01,0) [0|0] "g" Vector__XXX
 SG_ FCA_PrefillActvReq : 0|2@1+ (1,0) [0|0] "" Vector__XXX
 SG_ FCA_PartialActvReq : 0|2@1+ (1,0) [0|0] "" Vector__XXX

CM_ SG_ 3221225472 ENG_AirconPrsrSnsrVal "ENG_AirconPressureSensorValue ##2G##EMS - EMS_H12 - R_PAcnC";
CM_ SG_ 3221225472 ENG_CadModSta "ENG_CdaModeStatus ##2G##EMS - EMS_H12 - CF_CdaStat";
CM_ SG_ 3221225472 ENG_IsgSta "ENG_IsgStatus ##2G##EMS - EMS_H12 - CF_Ems_IsgStat";
CM_ SG_ 3221225472 ENG_OilLvlSta "ENG_OilLevelStatus ##2G##EMS - EMS_H12 - CF_Ems_OilChg";
CM_ SG_ 3221225472 ODS_Crc1Val "ODS_CyclicRedundancyCheck1Value";
CM_ SG_ 3221225472 ODS_AlvCnt1Val "ODS_AliveCounter1Value";
CM_ SG_ 3221225472 ODS_IdVal "ODS_IdValue ##2G##ODS - ODS13 - CR_Ods_ID";
CM_ SG_ 3221225472 ODS_OccClassSta "ODS_OccupantClassificationStatus ##2G##ODS - ODS11 - CR_Wcs_ClassStat";
CM_ SG_ 3221225472 ODS_DiagSta "ODS_SelfDiagnosticStatus ##2G##ODS - ODS11 - CR_Wcs_ErrStat";
CM_ SG_ 3221225472 FL_SHVU_SeatOptSta "Front Left Seat Heater/Vent option info";
CM_ SG_ 3221225472 FL_SHVU_SeatHtOperSta "Front Left Seat Heater/Vent current operation state";
CM_ SG_ 3221225472 FL_SHVU_HtSwHiIndSta "Front Left Seat Heater Switch High Indicator Status";
CM_ SG_ 3221225472 FL_SHVU_HtSwMidIndSta "Front Left Seat Heater Switch Mid Indicator Status";
CM_ SG_ 3221225472 FL_SHVU_HtSwLowIndSta "Front Left Seat Heater Switch Low Indicator Status";
CM_ SG_ 3221225472 FL_SHVU_VntSwHiIndSta "Front Left Seat Vent Switch High Indicator Status";
CM_ SG_ 3221225472 FL_SHVU_VntSwMidIndSta "Front Left Seat Vent Switch Mid Indicator Status";
CM_ SG_ 3221225472 FL_SHVU_VntSwLowIndSta "Front Left Seat Vent Switch Low Indicator Status";
CM_ SG_ 3221225472 C_HazardFromIBOX "Command for Remote Hazard";
CM_ SG_ 3221225472 C_PanicFromIBOX "Command for Remote Panic (Only for USA)";
CM_ SG_ 3221225472 C_CtrlDrUnlockRlyIBOX "Command for Remote Door UnLock";
CM_ SG_ 3221225472 C_CtrlDrLockRlyIBOX "Command for Remote Door Lock";
CM_ SG_ 3221225472 C_TeleHeatingCmdIBOX "'Command for Remote Heating

(Steering Wheel, Rear Window, Side Mirror)";
CM_ SG_ 3221225472 C_TeleStrgWhlHeatingCmdIBOX "Command for Remote Heating
(Steering Wheel)";
CM_ SG_ 3221225472 C_TeleDefoggerHeatingCmdIBOX "Command for Remote Heating
(Rear Window, Side Mirror)";
CM_ SG_ 3221225472 C_TeleAstSeatOpCmdIBOX "Command for Remote Seat Heat/Vent control (Passenger)";
CM_ SG_ 3221225472 C_TeleDrvSeatOpCmdIBOX "Command for Remote Seat Heat/Vent control (Driver)";
CM_ SG_ 3221225472 C_TeleRRSeatOpCmdIBOX "Command for Remote Seat Heat/Vent control (Rear Right)";
CM_ SG_ 3221225472 C_TeleRLSeatOpCmdIBOX "Command for Remote Seat Heat/Vent control (Rear Left)";
CM_ SG_ 3221225472 CF_AVN_CluWelcomeSnd "Request to set CLU welcome soun";
CM_ SG_ 3221225472 CF_AVN_CluAutoInitFuelEconomy "Request to set CLU auto initailizing fuel economy";
CM_ SG_ 3221225472 CF_AVN_CluVoiceVolume "Request to set CLU Volume level";
CM_ SG_ 3221225472 CF_AVN_CluServiceReminderSet "Request to set CLU service notification";
CM_ SG_ 3221225472 CF_AVN_CluTransmissionDisp "Request to set CLU transmission display";
CM_ SG_ 3221225472 CF_AVN_CluWiperLight "Request to set CLU wiper & light mode";
CM_ SG_ 3221225472 CF_AVN_CluRoadInfoGuide "Request to set CLU road info guidance";
CM_ SG_ 3221225472 CF_AVN_CluUserSettingPeriod "Request to set CLU sservice period set by user";
CM_ SG_ 3221225472 CF_AVN_CluSubspeedOdometerDisp "Request to set CLU Subscale Odometer";
CM_ SG_ 3221225472 CF_AVN_CluFuelEconUnit_mi "Cluster setting status for cluster Fuel Economy Unit (mile)";
CM_ SG_ 3221225472 CF_AVN_CluFuelEconUnit_km "Cluster setting status for cluster Fuel Economy unit (km)";
CM_ SG_ 3221225472 CF_AVN_CluUserSettingDistance "Request to set CLU service distance set by user";
CM_ SG_ 3221225472 CF_AVN_UnitReset "Request to reset Unit setting";
CM_ SG_ 3221225472 CF_AVN_IcyRoadWarn "Request to set CLU icy road warning";
CM_ SG_ 3221225472 CF_AVN_CluServiceReminderReset "Request to reset CLU service reminder";
CM_ SG_ 3221225472 CF_AVN_CluUSMReset "Request to reset all USM service";
CM_ SG_ 3221225472 C_PTGMNValueSet "Request to set PTGM Mode";
CM_ SG_ 3221225472 CF_AVN_ADrUNValueSet "Request to set Auto Door Unlock Mode";
CM_ SG_ 3221225472 CF_AVN_ADrLNValueSet "Request set the new Auto Door Lock Mode";
CM_ SG_ 3221225472 CF_AVN_EscortHLNValueSet "Request to set Head Lamp Escort Option";
CM_ SG_ 3221225472 CF_AVN_PSMNValueSet "This signal is used for a request to set the value of UMS Menus. This signal requests to set Seat Easy Access Mode. When this signal change, the message is sent 3 times.";
CM_ SG_ 3221225472 C_HfreeTrunkTgNValueSet "Request to set Smart Trunk/Tailgate Mode";
CM_ SG_ 3221225472 CF_AVN_TrfChgSet "This signal is used for a request to set the value of UMS Menus. This signal requests to set Traffic Change Mode. When this signal change, the message is sent 3 times.";
CM_ SG_ 3221225472 CF_AVN_SCMNValueSet "Request to set Steering Easy Access mode";
CM_ SG_ 3221225472 CF_AVN_OTTurnNValueSet "This signal is used for a request current setting value of USM Menus. When this signal change, the message is sent 3 times.";
CM_ SG_ 3221225472 CF_Gway_WPCNValueSet "Request to set Wireless Phone Charging mode";
CM_ SG_ 3221225472 C_AVN_RearWiperNValueSet "Request to set Rear Wiper operation in reverse";
CM_ SG_ 3221225472 C_UnlockWelocomeNValueSet "Request to set Door Unlock Welcome Setting Option";
CM_ SG_ 3221225472 C_SmartWelocomeNValueSet "Request to set Smart Key Welcome Setting Option";
CM_ SG_ 3221225472 CF_AVN_PTGSpeedNValueSet "Setting Value For Power Tailgate Speed";
CM_ SG_ 3221225472 CR_Datc_DRSeatWheel_USM_Set "SteeringWheel USM Set";
CM_ SG_ 3221225472 CF_AVN_TTUnlockNValueSet "Setting Value for Two Turn Unlock";
CM_ SG_ 3221225472 CF_Avn_BolsterNValueSet "USM Request for Seatback bolster adjustment in Drive mode";
CM_ SG_ 3221225472 C_StrWheelAutoHeatNValueSet "USM Request for Steering Wheel Auto Heat function";
CM_ SG_ 3221225472 CF_Avn_HAPTICWARNINGNValueSet "USM request for Steering Wheel Haptic Warning";
CM_ SG_ 3221225472 CR_Datc_DRSeatHeat_USM_Set "Driver Seat Heat/Ventl USM Set";
CM_ SG_ 3221225472 C_WALNValueSet "USM Function for Walk Away Lock(WAL)";
CM_ SG_ 3221225472 CF_AVN_RrSeatRemindNValueSet "Request to set Rear Occupant Alert mode";
CM_ SG_ 3221225472 CF_AVN_TunnelWindowNvalueSet "USM for auto window control when entering a tunnel";
CM_ SG_ 3221225472 CF_AVN_MoodLpRedNValueSet "Request for mood lamp color(Red)";
CM_ SG_ 3221225472 CF_AVN_MoodLpGreenNValueSet "Request for mood lamp color(Green)";
CM_ SG_ 3221225472 CF_AVN_MoodLpBlueNValueSet "Request for mood lamp color(Blue)";
CM_ SG_ 3221225472 CF_AVN_MoodLpBrightNValueSet "Request for mood lamp bright";
CM_ SG_ 3221225472 C_MoodLpDrivingNValue "USM Request value for mood lamp drivng interlock";
CM_ SG_ 3221225472 C_HCIMSWeightNValueSet "This signal is used for Healthcare IMS to input user's weight";
CM_ SG_ 3221225472 C_HCIMSHeightNvalueSet "This signal is used for Healthcare IMS to input user's height";
CM_ SG_ 3221225472 CF_AVN_HCIMSButtonCommand "User's input value in healthcare IMS mode";
CM_ SG_ 3221225472 C_HCIMSSitHeightNValueSet "This signal is used for Healthcare IMS to input user's sitting height";
CM_ SG_ 3221225472 CF_AVN_SeatDrvModNValueSet "Request for seat driver mode (USM setting)";
CM_ SG_ 3221225472 CF_AVN_AirSptStrNValueSet "Request for air support strength set";
CM_ SG_ 3221225472 CF_AVN_AirSptTimeNValueSet "Request for seat air support mode running time set";
CM_ SG_ 3221225472 CF_AVN_CushSoftNValueSet "Request for seat cushion softness set";
CM_ SG_ 3221225472 DoorLock_DrvrDrUnLkPsvAcsReq "DoorLock_DriverDoorUnLockPassiveAccessRequest ##2G## -  - C_PassiveDRVUnlockCmd";
CM_ SG_ 3221225472 DoorLock_RmtKeyDrvrDrUnLkReq "DoorLock_RkeDriverDoorUnLockRequest ##2G## -  - C_RKEDRVUnlockCmd";
CM_ SG_ 3221225472 ENG_Ack4EngStpSta "ENG_AcknowledgeForEngineStopStatus ##2G##EMS - EMS12 - ACK_ES";
CM_ SG_ 3221225472 ENG_OverDrvOffReq "ENG_OverDriveOffRequest ##2G##EMS - EMS12 - OD_OFF_REQ";
CM_ SG_ 3221225472 ENG_AccActSta "ENG_AutoCruiseControlActiveStatus ##2G##EMS - EMS12 - ACC_ACT";
CM_ SG_ 3221225472 ENG_CltchOpSta "ENG_ClutchStatus ##2G##EMS - EMS12 - CLU_ACK";
CM_ SG_ 3221225472 DSL_GlowCtrlReq "DSL_GlowControlRequest ##2G##EMS - EMS12 - GP_CTL";
CM_ SG_ 3221225472 ENG_GlowLmpSta "ENG_GlowLampStatus ##2G##EMS - EMS16 - GLOW_STAT";
CM_ SG_ 3221225472 ENG_ThrPosVal "ENG_ThrottlePositionValue ##2G##EMS - EMS12 - TPS";
CM_ SG_ 3221225472 ENG_AccelPdlVal "ENG_AcceleratorPedalValue ##2G##EMS - EMS12 - PV_AV_CAN";
CM_ SG_ 3221225472 ACC_CrsMainSwLmpSta "ACC_CruiseMainSwLampStatus ##2G##EMS - EMS16 - CRUISE_LAMP_M";
CM_ SG_ 3221225472 ACC_CrsSetSwLmpSta "ACC_CruiseSetSwLampStatus ##2G##EMS - EMS16 - CRUISE_LAMP_S";
CM_ SG_ 3221225472 ENG_PreFuelCutInSta "ENG_PreFuelCutInStatus ##2G##EMS - EMS16 - PRE_FUEL_CUT_IN";
CM_ SG_ 3221225472 ENG_SoakTimeErrSta "ENG_SoakTimeErrorStatus ##2G##EMS - EMS16 - SOAK_TIME_ERROR";
CM_ SG_ 3221225472 ENG_SoakTimeVal "ENG_SoakTimeValue ##2G##EMS - EMS16 - SOAK_TIME";
CM_ SG_ 3221225472 ENG_SprkTimeVal "ENG_SparkTimeValue ##2G##EMS - EMS16 - SPK_TIME_CUR";
CM_ SG_ 3221225472 ENG_MinIndTqVal "ENG_MinimumIndicatedTorqueValue ##2G##EMS - EMS16 - TQI_MIN";
CM_ SG_ 3221225472 ENG_TrgtTqVal "ENG_TargetTorqueValue ##2G##EMS - EMS16 - TQI_TARGET";
CM_ SG_ 3221225472 ENG_MaxIndTqVal "ENG_MaximumIndicatedTorqueValue ##2G##EMS - EMS16 - TQI_MAX";
CM_ SG_ 3221225472 ENG_AppAccelPdlSta "ENG_AppliedAcceleratorPedalStatus ##2G##EMS - EMS16 - CF_Ems_AclAct";
CM_ SG_ 3221225472 ENG_BrkCtrlReq "ENG_BrakeControlRequest ##2G##EMS - EMS19 - CF_Ems_BrkReq";
CM_ SG_ 3221225472 ACC_DnShftCtrlReq "ACC_DownShiftControlRequest ##2G##EMS - EMS19 - CF_Ems_DnShftReq";
CM_ SG_ 3221225472 ENG_ReprgmModRdySta "ENG_ReprogrammingModeReadyStatus ##2G##EMS - EMS19 - CF_Ems_RepModChk";
CM_ SG_ 3221225472 ENG_AafOpnReq "ENG_ActiveAirFlapOpenRequest ##2G##EMS - EMS19 - CF_Ems_AAFOpenReq";
CM_ SG_ 3221225472 EMS_Crc2Val "EMS_CyclicRedundancyCheck2Value";
CM_ SG_ 3221225472 EMS_AlvCnt2Val "EMS_AliveCounter2Value";
CM_ SG_ 3221225472 ENG_BrkSwSta "ENG_BrakeSwitchStatus ##2G##EMS - EMS12 - BRAKE_ACT";
CM_ SG_ 3221225472 ENG_ObdFrzFrmSta "ENG_ObdFreezeFrameStatus ##2G##EMS - EMS12 - OBD_FRF_ACK";
CM_ SG_ 3221225472 ENG_EngClntTempVal "ENG_EngineCoolantTemperatureValue ##2G##EMS - EMS12 - TEMP_ENG";
CM_ SG_ 3221225472 ENG_MafCrctVal "ENG_MassAirFlowCorrectionValue ##2G##EMS - EMS12 - MAF_FAC_ALTI_MMV";
CM_ SG_ 3221225472 ENG_BattDscnctSta "ENG_BatteryDisconnectStatus ##2G##EMS - EMS12 - VB_OFF_ACT";
CM_ SG_ 3221225472 OBD_MilConfgVal "OBD_MalfunctionIndicationLampConfigurationValue ##2G##EMS - EMS12 - CONF_MIL_FMY";
CM_ SG_ 3221225472 ENG_EngSta "ENG_EngineStatus ##2G##EMS - EMS16 - ENG_STAT";
CM_ SG_ 3221225472 ENG_DclBrkCntrlReq "ENG_DecelerationBrakeControlRequest ##2G##EMS - EMS19 - CF_Ems_DecelReq";
CM_ SG_ 3221225472 ENG_BstPrsrVal "ENG_BoostPressureValue ##2G##EMS - EMS19 - CR_Ems_BstPre";
CM_ SG_ 3221225472 ENG_EngOilTempVal "ENG_EngineOilTemperatureValue ##2G##EMS - EMS19 - CR_Ems_EngOilTemp";
CM_ SG_ 3221225472 ENG_AmbtTempModelVal "ENG_AmbientTemperatureModelValue ##2G##EMS - EMS19 - CF_Ems_ModeledAmbTemp";
CM_ SG_ 3221225472 ENG_DpfWrngSta "ENG_DpfWarningStatus ##2G##EMS - EMS19 - DPF_LAMP_STAT";
CM_ SG_ 3221225472 ENG_BattWrngLmpSta "ENG_BatteryWarningLampStatus ##2G##EMS - EMS19 - BAT_LAMP_STAT";
CM_ SG_ 3221225472 ENG_OilPrsrWrngLmpSta "ENG_OilPressureWarningLampStatus ##2G##EMS - EMS19 - CF_Ems_OPSFail";
CM_ SG_ 3221225472 ENG_IsgInhbtLmpSta "ENG_IsgInhibitLampStatus ##2G##EMS - EMS19 - ISG_INHIBIT_LAMP_STAT";
CM_ SG_ 3221225472 SAS_Crc1Val "SAS_CyclicRedundancyCheck1Value";
CM_ SG_ 3221225472 SAS_AlvCnt1Val "SAS_AliveCounter1Value";
CM_ SG_ 3221225472 SAS_AnglVal "SAS_AngleValue";
CM_ SG_ 3221225472 SAS_SpdVal "SAS_SpeedValue";
CM_ SG_ 3221225472 SAS_IntSta "SAS_InternalStatus";
CM_ SG_ 3221225472 ADAS_CMD_Crc30Val "ADAS_CMD_CyclicRedundancyCheck30Value";
CM_ SG_ 3221225472 ADAS_CMD_AlvCnt30Val "ADAS_CMD_AliveCounter30Value";
CM_ SG_ 3221225472 LKA_OptUsmSta "LKA_OptionUsmStatus ##2G##LDW_LKA - LKA11 - CF_LKA_Opt_USM";
CM_ SG_ 3221225472 LKA_RcgSta "LKA_RecognitionStatus ##2G##LDW_LKA - LKA11 - CF_LKA_LaneRecogState";
CM_ SG_ 3221225472 LKA_LHLnWrnSta "LKA_LHLaneWarningStatus ##2G##LDW_LKA - LKA11 - CF_LKA_LHWarning";
CM_ SG_ 3221225472 LKA_RHLnWrnSta "LKA_RHLaneWarningStatus ##2G##LDW_LKA - LKA11 - CF_LKA_RHWarning";
CM_ SG_ 3221225472 LKA_HndsoffSnd "LKA_HandsoffSound ##2G##LDW_LKA - LKA11 - CF_LKA_HandsOff_Snd";
CM_ SG_ 3221225472 LKA_StrSnd "LKA_SteeringSound ##2G##LDW_LKA - LKA11 - CF_LKA_Steer_Snd";
CM_ SG_ 3221225472 LKA_SysIndReq "LKA_SystemIndicatorRequest ##2G##LDW_LKA - LKA11 - CF_LKA_SymbolState";
CM_ SG_ 3221225472 LKA_StrTqReqVal "LKA_SteeringTorqueRequestValue ##2G##LDW_LKA - LKA11 - CR_LKA_StrToqReq";
CM_ SG_ 3221225472 LKA_ActToiSta "LKA_ActiveTorqueOverlayInterfaceStatus ##2G##LDW_LKA - LKA11 - CF_LKA_ActToi";
CM_ SG_ 3221225472 LKA_ToiFltSta "LKA_TorqueOverlayInterfaceFaultStatus ##2G##LDW_LKA - LKA11 - CF_LKA_ToiFlt";
CM_ SG_ 3221225472 BCA_Rear_WrnSta "BCA_Rear_WarningStatus";
CM_ SG_ 3221225472 FCA_LO_WrnSta "FCA_LO_WarningStatus";
CM_ SG_ 3221225472 FCA_LS_WrnSta "FCA_LS_WarningStatus";
CM_ SG_ 3221225472 BCAref_FrCmrSta "BCAref_FrontViewCameraStatus ##2G##LDW_LKA-LKA12-CF_FrCmr_BCAStat";
CM_ SG_ 3221225472 BCA_WrngSta "BCA_WarningStatus ##2G##LDW_LKA-LKA12-CF_FrCmr_BCAWarn";
CM_ SG_ 3221225472 LKA_UsmMod "LKA_USM Mode ##2G##LDW_LKA-LKA11-CF_LKA_USM_Mode";
CM_ SG_ 3221225472 Info_PedtrnDst "Distance of the nearest pedestrian ##2G##LDW_LKA-LKA12-CF_Vess_ref_Ped_Distance";
CM_ SG_ 3221225472 ACU_APSB_Crc1Val "ACU_APSB_CyclicRedundancyCheck1Value";
CM_ SG_ 3221225472 ACU_APSB_AlvCnt1Val "ACU_APSB_AliveCounter1Value";
CM_ SG_ 3221225472 APSB_ConfTbl "APSB_ConfigurationTable";
CM_ SG_ 3221225472 APSB_CrashActvSta "APSB_CrashActiveStatus";
CM_ SG_ 3221225472 APSB_RRDrvImpt "APSB RoughRoadDrvingImpact";
CM_ SG_ 3221225472 APSB_FCAFrImpt "APSB FCAFrontImpact";
CM_ SG_ 3221225472 APSB_MinFrImpt "APSB MinorFrontImpact";
CM_ SG_ 3221225472 APSB_MinSidImpt "APSB MinorSideImpact";
CM_ SG_ 3221225472 APSB_MinRollDetn "APSB MinorRollDetection";
CM_ SG_ 3221225472 APSB_MinRearImpt "APSB MinorRearImpact";
CM_ SG_ 3221225472 DATC_Crc1Val "DATC_CyclicRedundancyCheck1Value";
CM_ SG_ 3221225472 DATC_AlvCnt1Val "DATC_AliveCounter1Value";
CM_ SG_ 3221225472 DATC_PtcRlySta "DATC_PtcRelayStatus";
CM_ SG_ 3221225472 DATC_ManufacturerTyp "DATC_ManufacturerType";
CM_ SG_ 3221225472 DATC_AcnCompTyp "DATC_AirconCompressorType";
CM_ SG_ 3221225472 DATC_AcnReq "DATC_AirconRequest";
CM_ SG_ 3221225472 DATC_BlwSta "DATC_BlowerStatus";
CM_ SG_ 3221225472 DATC_BlwMaxSta "DATC_BlowerMaxStatus";
CM_ SG_ 3221225472 DATC_EngStrtReq "DATC_EngineStartRequest";
CM_ SG_ 3221225472 DATC_IsgInhbtReq "DATC_IsgInhibitRequset";
CM_ SG_ 3221225472 DATC_AcnCompOnReq "DATC_AirconCompressorOnRequest";
CM_ SG_ 3221225472 DATC_EngIdlRpmUpReq "DATC_EngineIdleRpmUpRequest";
CM_ SG_ 3221225472 DATC_EcvFltSta "DATC_EcvFaultStatus";
CM_ SG_ 3221225472 DATC_CalcAcnCompTqVal "DATC_CalculatedAirconCompressortorqueValue";
CM_ SG_ 3221225472 DATC_OutTempSnsrVal "DATC_OutsideTemperatureSensorValue";
CM_ SG_ 3221225472 DATC_DfgSw "DATC_DefogSwitch";
CM_ SG_ 3221225472 ADAS_PRK_Crc1Val "ADAS_PRK_CyclicRedundancyCheck1Value";
CM_ SG_ 3221225472 ADAS_PRK_AlvCnt1Val "ADAs_PRK_AliveCounter1Value";
CM_ SG_ 3221225472 PCA_SysSta "PCA_SystemStatus";
CM_ SG_ 3221225472 PCA_EquipSta "PCA_EquipmentStatus";
CM_ SG_ 3221225472 PCA_WrngLvlSta "PCA_WarningLevelStatus";
CM_ SG_ 3221225472 PCA_WrngMsgSta "PCA_WarningMessageStatus";
CM_ SG_ 3221225472 PCA_WrngSndCtrSta "PCA_WarningSoundCenterStatus";
CM_ SG_ 3221225472 PCA_WrngSndLftSta "PCA_WarningSoundLeftStatus";
CM_ SG_ 3221225472 PCA_WrngSndRtSta "PCA_WarningSoundRightStatus";
CM_ SG_ 3221225472 PCA_BrkReq "PCA_BrakeRequest";
CM_ SG_ 3221225472 PCA_DclTrgtVal "PCA_DecelerationTargetValue";
CM_ SG_ 3221225472 PCA_DgrSta "PCA_DegreeStatus";
CM_ SG_ 3221225472 ADAS_CMD_Crc10Val "ADAS_CMD_CyclicRedundancyCheck10Value ##2G##FCA - FCA11 - CR_FCA_ChkSum";
CM_ SG_ 3221225472 ADAS_CMD_AlvCnt10Val "ADAS_CMD_AliveCounter10Value ##2G##FCA - FCA11 - CR_FCA_Alive";
CM_ SG_ 3221225472 FCA_OnOffEquipSta "FCA_OnOffEquipmentStatus ##2G##FCA - FCA12 - FCA_USM";
CM_ SG_ 3221225472 FCA_SysFlrSta "FCA_SystemFailureStatus ##2G##FCA - FCA11 - FCA_Failinfo";
CM_ SG_ 3221225472 FCA_WrngLvlSta "FCA_WarningLevelStatus ##2G##FCA - FCA11 - CF_VSM_Warn";
CM_ SG_ 3221225472 FCA_VehStpReq "FCA_VehicleStopRequest ##2G##FCA - FCA11 - FCA_StopReq";
CM_ SG_ 3221225472 FCA_StbltActvReq "FCA_SeatBeltActivateRequest ##2G##FCA - FCA11 - CF_VSM_BeltCmd";
CM_ SG_ 3221225472 FCA_HydrlcBstAsstReq "FCA_HydraulicBoostAssistRequest ##2G##FCA - FCA11 - CF_VSM_HBACmd";
CM_ SG_ 3221225472 FCA_DclReqVal "FCA_DecelerationRequestValue ##2G##FCA - FCA11 - CR_VSM_DecCmd";
CM_ SG_ 3221225472 FCA_PrefillActvReq "FCA_PrefillActivateRequest ##2G##FCA - FCA11 - CF_VSM_Prefill";
CM_ SG_ 3221225472 FCA_PartialActvReq "FCA_PartialActivateRequest";
BA_DEF_ BO_  "UsrMsgIDSforwardDeviation" INT 0 100;
BA_DEF_ BO_  "UsrMsgIDSbackwardDeviation" INT 50 1000;
BA_DEF_ BO_  "GenMsgCycleTime" INT 0 2000;
BA_DEF_ BO_  "GenMsgStartDelayTime" INT 0 2000;
BA_DEF_ BO_  "GenMsgSendType" ENUM  "Cyclic ","NotUsed ","NotUsed ","NotUsed ","NotUsed ","NotUsed ","NotUsed ","IfActive ","NoMsgSendType ","NotUsed","vector_leerstring";
BA_DEF_ BO_  "GenMsgCycleTimeFast" INT 0 500;
BA_DEF_ BO_  "GenMsgILSupport" ENUM  "No","Yes";
BA_DEF_ BO_  "GenMsgNrOfRepetition" INT 0 3;
BA_DEF_ BO_  "VFrameFormat" ENUM  "StandardCAN","ExtendedCAN","reserved","reserved","reserved","reserved","reserved","reserved","reserved","reserved","reserved","reserved","reserved","reserved","StandardCAN_FD","ExtendedCAN_FD";
BA_DEF_ SG_  "UserSigValidity" ENUM  "B+","ACC","IG","IG1","IG2","IG3","IG1 or IG2","IG1 or IG3","Undef";
BA_DEF_ SG_  "GenSigTimeoutTime" INT 0 7000;
BA_DEF_ SG_  "UsrSigTimeoutValue" STRING ;
BA_DEF_ SG_  "UsrSigPurpose" ENUM  "Undef","FN","DIAG","DEV","NM";
BA_DEF_ SG_  "GenSigStartValue" INT 0 1215752192;
BA_DEF_ SG_  "NetworkRequest" ENUM  "Yes","No";
BA_DEF_ SG_  "NetworkRequestHoldingTime" INT 0 65535;
BA_DEF_ SG_  "Description" STRING ;
BA_DEF_ SG_  "Version" STRING ;
BA_DEF_ SG_  "GenSigEnvVarType" ENUM  "Int","Float","Undef";
BA_DEF_ SG_  "GenSigSendType" ENUM  "Cyclic			","OnWrite			","OnWriteWithRepetition			","OnChange			","OnChangeWithRepetition			","IfActive			","IfActiveWithRepetition			","NoSigSendType			","OnChangeAndIfActive			","OnChangeAndIfActiveWithRepetition";
BA_DEF_ SG_  "GwSigLatencyTime" INT 0 65536;
BA_DEF_ SG_  "GwSigMissingSourceType" ENUM  "Undef","OldValue","DefaultValue","InitialValue";
BA_DEF_ SG_  "NWM-WakeupAllowed" ENUM  "<n.a.>";
BA_DEF_ SG_  "RoutingFactor" INT 1 1215752192;
BA_DEF_DEF_  "UsrMsgIDSforwardDeviation" 10;
BA_DEF_DEF_  "UsrMsgIDSbackwardDeviation" 100;
BA_DEF_DEF_  "GenMsgCycleTime" 200;
BA_DEF_DEF_  "GenMsgStartDelayTime" 0;
BA_DEF_DEF_  "GenMsgSendType" "NoMsgSendType ";
BA_DEF_DEF_  "GenMsgCycleTimeFast" 40;
BA_DEF_DEF_  "GenMsgILSupport" "Yes";
BA_DEF_DEF_  "GenMsgNrOfRepetition" 3;
BA_DEF_DEF_  "VFrameFormat" "StandardCAN";
BA_DEF_DEF_  "UserSigValidity" "IG";
BA_DEF_DEF_  "GenSigTimeoutTime" 500;
BA_DEF_DEF_  "UsrSigTimeoutValue" "Undef";
BA_DEF_DEF_  "UsrSigPurpose" "FN";
BA_DEF_DEF_  "GenSigStartValue" 0;
BA_DEF_DEF_  "NetworkRequest" "No";
BA_DEF_DEF_  "NetworkRequestHoldingTime" 0;
BA_DEF_DEF_  "Description" "";
BA_DEF_DEF_  "Version" "";
BA_DEF_DEF_  "GenSigEnvVarType" "Undef";
BA_DEF_DEF_  "GenSigSendType" "NoSigSendType			";
BA_DEF_DEF_  "GwSigLatencyTime" 40;
BA_DEF_DEF_  "GwSigMissingSourceType" "Undef";
BA_DEF_DEF_  "NWM-WakeupAllowed" "<n.a.>";
BA_DEF_DEF_  "RoutingFactor" 1;
BA_ "Description" SG_ 3221225472 ENG_AirconPrsrSnsrVal "An EMS senses A/C pitot-tube pressure (between compressor & evaporator) directly with APT sensor.

This signal offered to A/C ECU only in case of the external variable A/C system installed vehicle.";
BA_ "UserSigValidity" SG_ 3221225472 ENG_AirconPrsrSnsrVal 3;
BA_ "RoutingFactor" SG_ 3221225472 ENG_AirconPrsrSnsrVal 5;
BA_ "Version" SG_ 3221225472 ENG_AirconPrsrSnsrVal "17.12.00";
BA_ "Description" SG_ 3221225472 ENG_CadModSta "‘EMS’ send this signal to ‘Active ENG MTG controller’, and ‘Active ENG MTG controller’ recognizes the current state of CDA Mode. 

Based on this information, ‘Active ENG MTG controller’ operates ‘Actuator’ to improve NVH performance.";
BA_ "UserSigValidity" SG_ 3221225472 ENG_CadModSta 3;
BA_ "RoutingFactor" SG_ 3221225472 ENG_CadModSta 5;
BA_ "Version" SG_ 3221225472 ENG_CadModSta "17.12.00";
BA_ "Description" SG_ 3221225472 ENG_IsgSta "1. ISG Status expressing CAN message divided by CF_EMS_IsgStat and CF_EMS_IsgStat2 

2. In EMS , CF_EMS_IsgStat and CF_EMS_IsgStat2 do not duplicate the output condition

(EX: If CF_EMS_IsgStat is 01h~07h, CF_EMS_IsgStat2 is 00h)



0x0:ISG is not operat";
BA_ "UserSigValidity" SG_ 3221225472 ENG_IsgSta 3;
BA_ "RoutingFactor" SG_ 3221225472 ENG_IsgSta 5;
BA_ "Version" SG_ 3221225472 ENG_IsgSta "17.12.02";
BA_ "Description" SG_ 3221225472 ENG_OilLvlSta "This signal indicates the replace time of engine oil.";
BA_ "UserSigValidity" SG_ 3221225472 ENG_OilLvlSta 3;
BA_ "RoutingFactor" SG_ 3221225472 ENG_OilLvlSta 5;
BA_ "Version" SG_ 3221225472 ENG_OilLvlSta "17.12.00";
BA_ "Description" SG_ 3221225472 ODS_Crc1Val "The CRC checking process calculates the CRC over the entire data block, including the CRC result.

- CRC Polynomial (0x1021) , Initial Value : 0xFFFF, XOR value : 0x0000

- The mathematical expression to 16 bit CRC polynomial is given here. G(x) = x16 + ";
BA_ "GenSigStartValue" SG_ 3221225472 ODS_Crc1Val 65535;
BA_ "UserSigValidity" SG_ 3221225472 ODS_Crc1Val 3;
BA_ "GenSigTimeoutTime" SG_ 3221225472 ODS_Crc1Val 5000;
BA_ "Version" SG_ 3221225472 ODS_Crc1Val "17.12.03";
BA_ "Description" SG_ 3221225472 ODS_AlvCnt1Val "For the first transmission request for a data element the counter shall be initialized with 0 and shall be incremented by 1

for every subsequent send request. When the counter reaches the maximum value(0xFF), then it shall restart with ? for the next se";
BA_ "UserSigValidity" SG_ 3221225472 ODS_AlvCnt1Val 3;
BA_ "GenSigTimeoutTime" SG_ 3221225472 ODS_AlvCnt1Val 5000;
BA_ "Version" SG_ 3221225472 ODS_AlvCnt1Val "17.12.03";
BA_ "Description" SG_ 3221225472 ODS_IdVal "Information of Vehicle seat ID as defined by customer.



※ Initial Value 값(0x0) 무시 (전산 시스템 등록 차 임의로 0x0값 등록)

: Initial(Start) Value : Current Value";
BA_ "UserSigValidity" SG_ 3221225472 ODS_IdVal 3;
BA_ "GenSigTimeoutTime" SG_ 3221225472 ODS_IdVal 5000;
BA_ "Version" SG_ 3221225472 ODS_IdVal "17.12.02";
BA_ "Description" SG_ 3221225472 ODS_OccClassSta "Signal Value Table : reference with ODS Communiction instruction";
BA_ "GenSigStartValue" SG_ 3221225472 ODS_OccClassSta 4;
BA_ "UserSigValidity" SG_ 3221225472 ODS_OccClassSta 3;
BA_ "GenSigTimeoutTime" SG_ 3221225472 ODS_OccClassSta 5000;
BA_ "Version" SG_ 3221225472 ODS_OccClassSta "17.12.02";
BA_ "Description" SG_ 3221225472 ODS_DiagSta "CR_WCS_Errstat signal describes PODS-G & BOSE system error that is diagnosed by itself. Each Type set Diagnostic Status explains 3 kinds of fault.

[PODS-G]

Bit 1 : If ODS Have some errors, ODS set the bit, sends the ALR Defect signal to ACU and notifie";
BA_ "UserSigValidity" SG_ 3221225472 ODS_DiagSta 3;
BA_ "GenSigTimeoutTime" SG_ 3221225472 ODS_DiagSta 5000;
BA_ "Version" SG_ 3221225472 ODS_DiagSta "17.12.02";
BA_ "Description" SG_ 3221225472 FL_SHVU_SeatOptSta "LH 시트에 적용된 히터/통풍 옵션 사양";
BA_ "GenSigSendType" SG_ 3221225472 FL_SHVU_SeatOptSta 4;
BA_ "UserSigValidity" SG_ 3221225472 FL_SHVU_SeatOptSta 3;
BA_ "GenSigTimeoutTime" SG_ 3221225472 FL_SHVU_SeatOptSta 1500;
BA_ "NetworkRequest" SG_ 3221225472 FL_SHVU_SeatOptSta 0;
BA_ "NetworkRequestHoldingTime" SG_ 3221225472 FL_SHVU_SeatOptSta 5000;
BA_ "Version" SG_ 3221225472 FL_SHVU_SeatOptSta "17.12.03";
BA_ "Description" SG_ 3221225472 FL_SHVU_SeatHtOperSta "LH 시트 현재 작동 중인 히터/통풍 단수 상태";
BA_ "GenSigSendType" SG_ 3221225472 FL_SHVU_SeatHtOperSta 4;
BA_ "UserSigValidity" SG_ 3221225472 FL_SHVU_SeatHtOperSta 3;
BA_ "GenSigTimeoutTime" SG_ 3221225472 FL_SHVU_SeatHtOperSta 1500;
BA_ "NetworkRequest" SG_ 3221225472 FL_SHVU_SeatHtOperSta 0;
BA_ "NetworkRequestHoldingTime" SG_ 3221225472 FL_SHVU_SeatHtOperSta 5000;
BA_ "Version" SG_ 3221225472 FL_SHVU_SeatHtOperSta "17.12.03";
BA_ "Description" SG_ 3221225472 FL_SHVU_HtSwHiIndSta "LH 시트 열선 스위치 High Indicator 정보";
BA_ "GenSigSendType" SG_ 3221225472 FL_SHVU_HtSwHiIndSta 4;
BA_ "UserSigValidity" SG_ 3221225472 FL_SHVU_HtSwHiIndSta 3;
BA_ "GenSigTimeoutTime" SG_ 3221225472 FL_SHVU_HtSwHiIndSta 1500;
BA_ "NetworkRequest" SG_ 3221225472 FL_SHVU_HtSwHiIndSta 0;
BA_ "NetworkRequestHoldingTime" SG_ 3221225472 FL_SHVU_HtSwHiIndSta 5000;
BA_ "Version" SG_ 3221225472 FL_SHVU_HtSwHiIndSta "17.12.03";
BA_ "Description" SG_ 3221225472 FL_SHVU_HtSwMidIndSta "LH 시트 열선 스위치 Mid Indicator 정보";
BA_ "GenSigSendType" SG_ 3221225472 FL_SHVU_HtSwMidIndSta 4;
BA_ "UserSigValidity" SG_ 3221225472 FL_SHVU_HtSwMidIndSta 3;
BA_ "GenSigTimeoutTime" SG_ 3221225472 FL_SHVU_HtSwMidIndSta 1500;
BA_ "NetworkRequest" SG_ 3221225472 FL_SHVU_HtSwMidIndSta 0;
BA_ "NetworkRequestHoldingTime" SG_ 3221225472 FL_SHVU_HtSwMidIndSta 5000;
BA_ "Version" SG_ 3221225472 FL_SHVU_HtSwMidIndSta "17.12.03";
BA_ "Description" SG_ 3221225472 FL_SHVU_HtSwLowIndSta "LH 시트 열선 스위치 Low Indicator 정보";
BA_ "GenSigSendType" SG_ 3221225472 FL_SHVU_HtSwLowIndSta 4;
BA_ "UserSigValidity" SG_ 3221225472 FL_SHVU_HtSwLowIndSta 3;
BA_ "GenSigTimeoutTime" SG_ 3221225472 FL_SHVU_HtSwLowIndSta 1500;
BA_ "NetworkRequest" SG_ 3221225472 FL_SHVU_HtSwLowIndSta 0;
BA_ "NetworkRequestHoldingTime" SG_ 3221225472 FL_SHVU_HtSwLowIndSta 5000;
BA_ "Version" SG_ 3221225472 FL_SHVU_HtSwLowIndSta "17.12.03";
BA_ "Description" SG_ 3221225472 FL_SHVU_VntSwHiIndSta "LH 시트 통풍 스위치 High Indicator 정보";
BA_ "GenSigSendType" SG_ 3221225472 FL_SHVU_VntSwHiIndSta 4;
BA_ "UserSigValidity" SG_ 3221225472 FL_SHVU_VntSwHiIndSta 3;
BA_ "GenSigTimeoutTime" SG_ 3221225472 FL_SHVU_VntSwHiIndSta 1500;
BA_ "NetworkRequest" SG_ 3221225472 FL_SHVU_VntSwHiIndSta 0;
BA_ "NetworkRequestHoldingTime" SG_ 3221225472 FL_SHVU_VntSwHiIndSta 5000;
BA_ "Version" SG_ 3221225472 FL_SHVU_VntSwHiIndSta "17.12.03";
BA_ "Description" SG_ 3221225472 FL_SHVU_VntSwMidIndSta "LH 시트 통풍 스위치 Mid Indicator 정보";
BA_ "GenSigSendType" SG_ 3221225472 FL_SHVU_VntSwMidIndSta 4;
BA_ "UserSigValidity" SG_ 3221225472 FL_SHVU_VntSwMidIndSta 3;
BA_ "GenSigTimeoutTime" SG_ 3221225472 FL_SHVU_VntSwMidIndSta 1500;
BA_ "NetworkRequest" SG_ 3221225472 FL_SHVU_VntSwMidIndSta 0;
BA_ "NetworkRequestHoldingTime" SG_ 3221225472 FL_SHVU_VntSwMidIndSta 5000;
BA_ "Version" SG_ 3221225472 FL_SHVU_VntSwMidIndSta "17.12.03";
BA_ "Description" SG_ 3221225472 FL_SHVU_VntSwLowIndSta "LH 시트 통풍 스위치 Low Indicator 정보";
BA_ "GenSigSendType" SG_ 3221225472 FL_SHVU_VntSwLowIndSta 4;
BA_ "UserSigValidity" SG_ 3221225472 FL_SHVU_VntSwLowIndSta 3;
BA_ "GenSigTimeoutTime" SG_ 3221225472 FL_SHVU_VntSwLowIndSta 1500;
BA_ "NetworkRequest" SG_ 3221225472 FL_SHVU_VntSwLowIndSta 0;
BA_ "NetworkRequestHoldingTime" SG_ 3221225472 FL_SHVU_VntSwLowIndSta 5000;
BA_ "Version" SG_ 3221225472 FL_SHVU_VntSwLowIndSta "17.12.03";
BA_ "Description" SG_ 3221225472 C_HazardFromIBOX "Remote Control message";
BA_ "GenSigSendType" SG_ 3221225472 C_HazardFromIBOX 4;
BA_ "UserSigValidity" SG_ 3221225472 C_HazardFromIBOX 0;
BA_ "GenSigTimeoutTime" SG_ 3221225472 C_HazardFromIBOX 0;
BA_ "NetworkRequest" SG_ 3221225472 C_HazardFromIBOX 0;
BA_ "NetworkRequestHoldingTime" SG_ 3221225472 C_HazardFromIBOX 2000;
BA_ "Version" SG_ 3221225472 C_HazardFromIBOX "17.11.00";
BA_ "Description" SG_ 3221225472 C_PanicFromIBOX "Remote Control message";
BA_ "GenSigSendType" SG_ 3221225472 C_PanicFromIBOX 4;
BA_ "UserSigValidity" SG_ 3221225472 C_PanicFromIBOX 0;
BA_ "GenSigTimeoutTime" SG_ 3221225472 C_PanicFromIBOX 0;
BA_ "NetworkRequest" SG_ 3221225472 C_PanicFromIBOX 0;
BA_ "NetworkRequestHoldingTime" SG_ 3221225472 C_PanicFromIBOX 2000;
BA_ "Version" SG_ 3221225472 C_PanicFromIBOX "17.11.00";
BA_ "Description" SG_ 3221225472 C_CtrlDrUnlockRlyIBOX "Remote Control message";
BA_ "GenSigSendType" SG_ 3221225472 C_CtrlDrUnlockRlyIBOX 4;
BA_ "UserSigValidity" SG_ 3221225472 C_CtrlDrUnlockRlyIBOX 0;
BA_ "GenSigTimeoutTime" SG_ 3221225472 C_CtrlDrUnlockRlyIBOX 0;
BA_ "NetworkRequest" SG_ 3221225472 C_CtrlDrUnlockRlyIBOX 0;
BA_ "NetworkRequestHoldingTime" SG_ 3221225472 C_CtrlDrUnlockRlyIBOX 2000;
BA_ "Version" SG_ 3221225472 C_CtrlDrUnlockRlyIBOX "17.11.00";
BA_ "Description" SG_ 3221225472 C_CtrlDrLockRlyIBOX "Remote Control message";
BA_ "GenSigSendType" SG_ 3221225472 C_CtrlDrLockRlyIBOX 4;
BA_ "UserSigValidity" SG_ 3221225472 C_CtrlDrLockRlyIBOX 0;
BA_ "GenSigTimeoutTime" SG_ 3221225472 C_CtrlDrLockRlyIBOX 0;
BA_ "NetworkRequest" SG_ 3221225472 C_CtrlDrLockRlyIBOX 0;
BA_ "NetworkRequestHoldingTime" SG_ 3221225472 C_CtrlDrLockRlyIBOX 2000;
BA_ "Version" SG_ 3221225472 C_CtrlDrLockRlyIBOX "17.11.00";
BA_ "GenSigSendType" SG_ 3221225472 C_TeleHeatingCmdIBOX 4;
BA_ "GenSigStartValue" SG_ 3221225472 C_TeleHeatingCmdIBOX 3;
BA_ "UserSigValidity" SG_ 3221225472 C_TeleHeatingCmdIBOX 0;
BA_ "GenSigTimeoutTime" SG_ 3221225472 C_TeleHeatingCmdIBOX 0;
BA_ "NetworkRequest" SG_ 3221225472 C_TeleHeatingCmdIBOX 0;
BA_ "Version" SG_ 3221225472 C_TeleHeatingCmdIBOX "17.11.00";
BA_ "Description" SG_ 3221225472 C_TeleStrgWhlHeatingCmdIBOX "18.02.01_";
BA_ "GenSigSendType" SG_ 3221225472 C_TeleStrgWhlHeatingCmdIBOX 4;
BA_ "GenSigStartValue" SG_ 3221225472 C_TeleStrgWhlHeatingCmdIBOX 3;
BA_ "UserSigValidity" SG_ 3221225472 C_TeleStrgWhlHeatingCmdIBOX 0;
BA_ "GenSigTimeoutTime" SG_ 3221225472 C_TeleStrgWhlHeatingCmdIBOX 0;
BA_ "NetworkRequest" SG_ 3221225472 C_TeleStrgWhlHeatingCmdIBOX 0;
BA_ "Version" SG_ 3221225472 C_TeleStrgWhlHeatingCmdIBOX "18.05.01";
BA_ "Description" SG_ 3221225472 C_TeleDefoggerHeatingCmdIBOX "18.02.01_";
BA_ "GenSigSendType" SG_ 3221225472 C_TeleDefoggerHeatingCmdIBOX 4;
BA_ "GenSigStartValue" SG_ 3221225472 C_TeleDefoggerHeatingCmdIBOX 3;
BA_ "UserSigValidity" SG_ 3221225472 C_TeleDefoggerHeatingCmdIBOX 0;
BA_ "GenSigTimeoutTime" SG_ 3221225472 C_TeleDefoggerHeatingCmdIBOX 0;
BA_ "NetworkRequest" SG_ 3221225472 C_TeleDefoggerHeatingCmdIBOX 0;
BA_ "Version" SG_ 3221225472 C_TeleDefoggerHeatingCmdIBOX "18.05.01";
BA_ "Description" SG_ 3221225472 C_TeleAstSeatOpCmdIBOX "Remote Control message";
BA_ "GenSigSendType" SG_ 3221225472 C_TeleAstSeatOpCmdIBOX 4;
BA_ "UserSigValidity" SG_ 3221225472 C_TeleAstSeatOpCmdIBOX 3;
BA_ "GenSigTimeoutTime" SG_ 3221225472 C_TeleAstSeatOpCmdIBOX 0;
BA_ "Version" SG_ 3221225472 C_TeleAstSeatOpCmdIBOX "17.11.00";
BA_ "Description" SG_ 3221225472 C_TeleDrvSeatOpCmdIBOX "Remote Control message";
BA_ "GenSigSendType" SG_ 3221225472 C_TeleDrvSeatOpCmdIBOX 4;
BA_ "UserSigValidity" SG_ 3221225472 C_TeleDrvSeatOpCmdIBOX 3;
BA_ "GenSigTimeoutTime" SG_ 3221225472 C_TeleDrvSeatOpCmdIBOX 0;
BA_ "Version" SG_ 3221225472 C_TeleDrvSeatOpCmdIBOX "17.11.00";
BA_ "Description" SG_ 3221225472 C_TeleRRSeatOpCmdIBOX "Remote Control message";
BA_ "GenSigSendType" SG_ 3221225472 C_TeleRRSeatOpCmdIBOX 4;
BA_ "UserSigValidity" SG_ 3221225472 C_TeleRRSeatOpCmdIBOX 3;
BA_ "GenSigTimeoutTime" SG_ 3221225472 C_TeleRRSeatOpCmdIBOX 0;
BA_ "Version" SG_ 3221225472 C_TeleRRSeatOpCmdIBOX "17.11.00";
BA_ "Description" SG_ 3221225472 C_TeleRLSeatOpCmdIBOX "Remote Control message";
BA_ "GenSigSendType" SG_ 3221225472 C_TeleRLSeatOpCmdIBOX 4;
BA_ "UserSigValidity" SG_ 3221225472 C_TeleRLSeatOpCmdIBOX 3;
BA_ "GenSigTimeoutTime" SG_ 3221225472 C_TeleRLSeatOpCmdIBOX 0;
BA_ "Version" SG_ 3221225472 C_TeleRLSeatOpCmdIBOX "17.11.00";
BA_ "GenSigSendType" SG_ 3221225472 CF_AVN_CluWelcomeSnd 4;
BA_ "UserSigValidity" SG_ 3221225472 CF_AVN_CluWelcomeSnd 3;
BA_ "GenSigTimeoutTime" SG_ 3221225472 CF_AVN_CluWelcomeSnd 0;
BA_ "Version" SG_ 3221225472 CF_AVN_CluWelcomeSnd "17.11.00";
BA_ "GenSigSendType" SG_ 3221225472 CF_AVN_CluAutoInitFuelEconomy 4;
BA_ "UserSigValidity" SG_ 3221225472 CF_AVN_CluAutoInitFuelEconomy 3;
BA_ "GenSigTimeoutTime" SG_ 3221225472 CF_AVN_CluAutoInitFuelEconomy 0;
BA_ "Version" SG_ 3221225472 CF_AVN_CluAutoInitFuelEconomy "17.11.00";
BA_ "GenSigSendType" SG_ 3221225472 CF_AVN_CluVoiceVolume 4;
BA_ "UserSigValidity" SG_ 3221225472 CF_AVN_CluVoiceVolume 3;
BA_ "GenSigTimeoutTime" SG_ 3221225472 CF_AVN_CluVoiceVolume 0;
BA_ "Version" SG_ 3221225472 CF_AVN_CluVoiceVolume "17.11.00";
BA_ "GenSigSendType" SG_ 3221225472 CF_AVN_CluServiceReminderSet 4;
BA_ "UserSigValidity" SG_ 3221225472 CF_AVN_CluServiceReminderSet 3;
BA_ "GenSigTimeoutTime" SG_ 3221225472 CF_AVN_CluServiceReminderSet 0;
BA_ "Version" SG_ 3221225472 CF_AVN_CluServiceReminderSet "17.11.00";
BA_ "GenSigSendType" SG_ 3221225472 CF_AVN_CluTransmissionDisp 4;
BA_ "UserSigValidity" SG_ 3221225472 CF_AVN_CluTransmissionDisp 3;
BA_ "GenSigTimeoutTime" SG_ 3221225472 CF_AVN_CluTransmissionDisp 0;
BA_ "Version" SG_ 3221225472 CF_AVN_CluTransmissionDisp "17.11.00";
BA_ "GenSigSendType" SG_ 3221225472 CF_AVN_CluWiperLight 4;
BA_ "UserSigValidity" SG_ 3221225472 CF_AVN_CluWiperLight 3;
BA_ "GenSigTimeoutTime" SG_ 3221225472 CF_AVN_CluWiperLight 0;
BA_ "Version" SG_ 3221225472 CF_AVN_CluWiperLight "17.11.00";
BA_ "GenSigSendType" SG_ 3221225472 CF_AVN_CluRoadInfoGuide 4;
BA_ "UserSigValidity" SG_ 3221225472 CF_AVN_CluRoadInfoGuide 3;
BA_ "GenSigTimeoutTime" SG_ 3221225472 CF_AVN_CluRoadInfoGuide 0;
BA_ "Version" SG_ 3221225472 CF_AVN_CluRoadInfoGuide "17.11.00";
BA_ "GenSigSendType" SG_ 3221225472 CF_AVN_CluUserSettingPeriod 4;
BA_ "UserSigValidity" SG_ 3221225472 CF_AVN_CluUserSettingPeriod 3;
BA_ "GenSigTimeoutTime" SG_ 3221225472 CF_AVN_CluUserSettingPeriod 0;
BA_ "Version" SG_ 3221225472 CF_AVN_CluUserSettingPeriod "17.11.00";
BA_ "GenSigSendType" SG_ 3221225472 CF_AVN_CluSubspeedOdometerDisp 4;
BA_ "UserSigValidity" SG_ 3221225472 CF_AVN_CluSubspeedOdometerDisp 3;
BA_ "GenSigTimeoutTime" SG_ 3221225472 CF_AVN_CluSubspeedOdometerDisp 0;
BA_ "Version" SG_ 3221225472 CF_AVN_CluSubspeedOdometerDisp "17.11.00";
BA_ "GenSigSendType" SG_ 3221225472 CF_AVN_CluFuelEconUnit_mi 4;
BA_ "UserSigValidity" SG_ 3221225472 CF_AVN_CluFuelEconUnit_mi 3;
BA_ "GenSigTimeoutTime" SG_ 3221225472 CF_AVN_CluFuelEconUnit_mi 0;
BA_ "Version" SG_ 3221225472 CF_AVN_CluFuelEconUnit_mi "17.11.00";
BA_ "GenSigSendType" SG_ 3221225472 CF_AVN_CluFuelEconUnit_km 4;
BA_ "UserSigValidity" SG_ 3221225472 CF_AVN_CluFuelEconUnit_km 3;
BA_ "GenSigTimeoutTime" SG_ 3221225472 CF_AVN_CluFuelEconUnit_km 0;
BA_ "Version" SG_ 3221225472 CF_AVN_CluFuelEconUnit_km "17.11.00";
BA_ "GenSigSendType" SG_ 3221225472 CF_AVN_CluUserSettingDistance 4;
BA_ "UserSigValidity" SG_ 3221225472 CF_AVN_CluUserSettingDistance 3;
BA_ "GenSigTimeoutTime" SG_ 3221225472 CF_AVN_CluUserSettingDistance 0;
BA_ "Version" SG_ 3221225472 CF_AVN_CluUserSettingDistance "17.11.00";
BA_ "GenSigSendType" SG_ 3221225472 CF_AVN_UnitReset 4;
BA_ "UserSigValidity" SG_ 3221225472 CF_AVN_UnitReset 3;
BA_ "GenSigTimeoutTime" SG_ 3221225472 CF_AVN_UnitReset 0;
BA_ "Version" SG_ 3221225472 CF_AVN_UnitReset "17.11.00";
BA_ "GenSigSendType" SG_ 3221225472 CF_AVN_IcyRoadWarn 4;
BA_ "UserSigValidity" SG_ 3221225472 CF_AVN_IcyRoadWarn 3;
BA_ "GenSigTimeoutTime" SG_ 3221225472 CF_AVN_IcyRoadWarn 0;
BA_ "Version" SG_ 3221225472 CF_AVN_IcyRoadWarn "17.11.00";
BA_ "GenSigSendType" SG_ 3221225472 CF_AVN_CluServiceReminderReset 4;
BA_ "UserSigValidity" SG_ 3221225472 CF_AVN_CluServiceReminderReset 3;
BA_ "GenSigTimeoutTime" SG_ 3221225472 CF_AVN_CluServiceReminderReset 0;
BA_ "Version" SG_ 3221225472 CF_AVN_CluServiceReminderReset "17.11.00";
BA_ "GenSigSendType" SG_ 3221225472 CF_AVN_CluUSMReset 4;
BA_ "UserSigValidity" SG_ 3221225472 CF_AVN_CluUSMReset 3;
BA_ "GenSigTimeoutTime" SG_ 3221225472 CF_AVN_CluUSMReset 0;
BA_ "Version" SG_ 3221225472 CF_AVN_CluUSMReset "17.11.00";
BA_ "GenSigSendType" SG_ 3221225472 C_PTGMNValueSet 4;
BA_ "UserSigValidity" SG_ 3221225472 C_PTGMNValueSet 3;
BA_ "GenSigTimeoutTime" SG_ 3221225472 C_PTGMNValueSet 0;
BA_ "Version" SG_ 3221225472 C_PTGMNValueSet "17.11.00";
BA_ "GenSigSendType" SG_ 3221225472 CF_AVN_ADrUNValueSet 4;
BA_ "UserSigValidity" SG_ 3221225472 CF_AVN_ADrUNValueSet 3;
BA_ "GenSigTimeoutTime" SG_ 3221225472 CF_AVN_ADrUNValueSet 0;
BA_ "Version" SG_ 3221225472 CF_AVN_ADrUNValueSet "17.11.00";
BA_ "GenSigSendType" SG_ 3221225472 CF_AVN_ADrLNValueSet 4;
BA_ "UserSigValidity" SG_ 3221225472 CF_AVN_ADrLNValueSet 3;
BA_ "GenSigTimeoutTime" SG_ 3221225472 CF_AVN_ADrLNValueSet 0;
BA_ "Version" SG_ 3221225472 CF_AVN_ADrLNValueSet "17.11.00";
BA_ "GenSigSendType" SG_ 3221225472 CF_AVN_EscortHLNValueSet 4;
BA_ "UserSigValidity" SG_ 3221225472 CF_AVN_EscortHLNValueSet 3;
BA_ "GenSigTimeoutTime" SG_ 3221225472 CF_AVN_EscortHLNValueSet 0;
BA_ "Version" SG_ 3221225472 CF_AVN_EscortHLNValueSet "17.11.00";
BA_ "GenSigSendType" SG_ 3221225472 CF_AVN_PSMNValueSet 4;
BA_ "UserSigValidity" SG_ 3221225472 CF_AVN_PSMNValueSet 3;
BA_ "GenSigTimeoutTime" SG_ 3221225472 CF_AVN_PSMNValueSet 0;
BA_ "Version" SG_ 3221225472 CF_AVN_PSMNValueSet "17.11.00";
BA_ "GenSigSendType" SG_ 3221225472 C_HfreeTrunkTgNValueSet 4;
BA_ "UserSigValidity" SG_ 3221225472 C_HfreeTrunkTgNValueSet 3;
BA_ "GenSigTimeoutTime" SG_ 3221225472 C_HfreeTrunkTgNValueSet 0;
BA_ "Version" SG_ 3221225472 C_HfreeTrunkTgNValueSet "17.11.00";
BA_ "GenSigSendType" SG_ 3221225472 CF_AVN_TrfChgSet 4;
BA_ "UserSigValidity" SG_ 3221225472 CF_AVN_TrfChgSet 3;
BA_ "GenSigTimeoutTime" SG_ 3221225472 CF_AVN_TrfChgSet 0;
BA_ "Version" SG_ 3221225472 CF_AVN_TrfChgSet "17.11.00";
BA_ "GenSigSendType" SG_ 3221225472 CF_AVN_SCMNValueSet 4;
BA_ "UserSigValidity" SG_ 3221225472 CF_AVN_SCMNValueSet 3;
BA_ "GenSigTimeoutTime" SG_ 3221225472 CF_AVN_SCMNValueSet 0;
BA_ "Version" SG_ 3221225472 CF_AVN_SCMNValueSet "17.11.00";
BA_ "GenSigSendType" SG_ 3221225472 CF_AVN_OTTurnNValueSet 4;
BA_ "UserSigValidity" SG_ 3221225472 CF_AVN_OTTurnNValueSet 3;
BA_ "GenSigTimeoutTime" SG_ 3221225472 CF_AVN_OTTurnNValueSet 0;
BA_ "Version" SG_ 3221225472 CF_AVN_OTTurnNValueSet "17.11.00";
BA_ "GenSigSendType" SG_ 3221225472 CF_Gway_WPCNValueSet 4;
BA_ "UserSigValidity" SG_ 3221225472 CF_Gway_WPCNValueSet 3;
BA_ "GenSigTimeoutTime" SG_ 3221225472 CF_Gway_WPCNValueSet 0;
BA_ "Version" SG_ 3221225472 CF_Gway_WPCNValueSet "17.11.00";
BA_ "GenSigSendType" SG_ 3221225472 C_AVN_RearWiperNValueSet 4;
BA_ "UserSigValidity" SG_ 3221225472 C_AVN_RearWiperNValueSet 3;
BA_ "GenSigTimeoutTime" SG_ 3221225472 C_AVN_RearWiperNValueSet 0;
BA_ "Version" SG_ 3221225472 C_AVN_RearWiperNValueSet "17.11.00";
BA_ "GenSigSendType" SG_ 3221225472 C_UnlockWelocomeNValueSet 4;
BA_ "UserSigValidity" SG_ 3221225472 C_UnlockWelocomeNValueSet 3;
BA_ "GenSigTimeoutTime" SG_ 3221225472 C_UnlockWelocomeNValueSet 0;
BA_ "Version" SG_ 3221225472 C_UnlockWelocomeNValueSet "17.11.00";
BA_ "GenSigSendType" SG_ 3221225472 C_SmartWelocomeNValueSet 4;
BA_ "UserSigValidity" SG_ 3221225472 C_SmartWelocomeNValueSet 3;
BA_ "GenSigTimeoutTime" SG_ 3221225472 C_SmartWelocomeNValueSet 0;
BA_ "Version" SG_ 3221225472 C_SmartWelocomeNValueSet "17.11.00";
BA_ "GenSigSendType" SG_ 3221225472 CF_AVN_PTGSpeedNValueSet 4;
BA_ "UserSigValidity" SG_ 3221225472 CF_AVN_PTGSpeedNValueSet 3;
BA_ "GenSigTimeoutTime" SG_ 3221225472 CF_AVN_PTGSpeedNValueSet 0;
BA_ "Version" SG_ 3221225472 CF_AVN_PTGSpeedNValueSet "17.11.00";
BA_ "GenSigSendType" SG_ 3221225472 CR_Datc_DRSeatWheel_USM_Set 4;
BA_ "UserSigValidity" SG_ 3221225472 CR_Datc_DRSeatWheel_USM_Set 3;
BA_ "GenSigTimeoutTime" SG_ 3221225472 CR_Datc_DRSeatWheel_USM_Set 0;
BA_ "Version" SG_ 3221225472 CR_Datc_DRSeatWheel_USM_Set "17.11.00";
BA_ "GenSigSendType" SG_ 3221225472 CF_AVN_TTUnlockNValueSet 4;
BA_ "GenSigStartValue" SG_ 3221225472 CF_AVN_TTUnlockNValueSet 3;
BA_ "UserSigValidity" SG_ 3221225472 CF_AVN_TTUnlockNValueSet 3;
BA_ "GenSigTimeoutTime" SG_ 3221225472 CF_AVN_TTUnlockNValueSet 0;
BA_ "Version" SG_ 3221225472 CF_AVN_TTUnlockNValueSet "17.11.00";
BA_ "GenSigSendType" SG_ 3221225472 CF_Avn_BolsterNValueSet 4;
BA_ "UserSigValidity" SG_ 3221225472 CF_Avn_BolsterNValueSet 3;
BA_ "GenSigTimeoutTime" SG_ 3221225472 CF_Avn_BolsterNValueSet 0;
BA_ "Version" SG_ 3221225472 CF_Avn_BolsterNValueSet "17.11.00";
BA_ "GenSigSendType" SG_ 3221225472 C_StrWheelAutoHeatNValueSet 4;
BA_ "UserSigValidity" SG_ 3221225472 C_StrWheelAutoHeatNValueSet 3;
BA_ "GenSigTimeoutTime" SG_ 3221225472 C_StrWheelAutoHeatNValueSet 0;
BA_ "Version" SG_ 3221225472 C_StrWheelAutoHeatNValueSet "17.11.00";
BA_ "GenSigSendType" SG_ 3221225472 CF_Avn_HAPTICWARNINGNValueSet 4;
BA_ "UserSigValidity" SG_ 3221225472 CF_Avn_HAPTICWARNINGNValueSet 3;
BA_ "GenSigTimeoutTime" SG_ 3221225472 CF_Avn_HAPTICWARNINGNValueSet 0;
BA_ "Version" SG_ 3221225472 CF_Avn_HAPTICWARNINGNValueSet "17.11.00";
BA_ "GenSigSendType" SG_ 3221225472 CR_Datc_DRSeatHeat_USM_Set 4;
BA_ "UserSigValidity" SG_ 3221225472 CR_Datc_DRSeatHeat_USM_Set 3;
BA_ "GenSigTimeoutTime" SG_ 3221225472 CR_Datc_DRSeatHeat_USM_Set 0;
BA_ "Version" SG_ 3221225472 CR_Datc_DRSeatHeat_USM_Set "17.11.00";
BA_ "GenSigSendType" SG_ 3221225472 C_WALNValueSet 4;
BA_ "UserSigValidity" SG_ 3221225472 C_WALNValueSet 3;
BA_ "GenSigTimeoutTime" SG_ 3221225472 C_WALNValueSet 0;
BA_ "Version" SG_ 3221225472 C_WALNValueSet "17.11.00";
BA_ "GenSigSendType" SG_ 3221225472 CF_AVN_RrSeatRemindNValueSet 4;
BA_ "UserSigValidity" SG_ 3221225472 CF_AVN_RrSeatRemindNValueSet 3;
BA_ "GenSigTimeoutTime" SG_ 3221225472 CF_AVN_RrSeatRemindNValueSet 0;
BA_ "Version" SG_ 3221225472 CF_AVN_RrSeatRemindNValueSet "17.11.00";
BA_ "GenSigSendType" SG_ 3221225472 CF_AVN_TunnelWindowNvalueSet 4;
BA_ "UserSigValidity" SG_ 3221225472 CF_AVN_TunnelWindowNvalueSet 3;
BA_ "GenSigTimeoutTime" SG_ 3221225472 CF_AVN_TunnelWindowNvalueSet 0;
BA_ "Version" SG_ 3221225472 CF_AVN_TunnelWindowNvalueSet "17.11.00";
BA_ "GenSigSendType" SG_ 3221225472 CF_AVN_MoodLpRedNValueSet 4;
BA_ "GenSigStartValue" SG_ 3221225472 CF_AVN_MoodLpRedNValueSet 512;
BA_ "UserSigValidity" SG_ 3221225472 CF_AVN_MoodLpRedNValueSet 3;
BA_ "GenSigTimeoutTime" SG_ 3221225472 CF_AVN_MoodLpRedNValueSet 0;
BA_ "Version" SG_ 3221225472 CF_AVN_MoodLpRedNValueSet "17.11.00";
BA_ "GenSigSendType" SG_ 3221225472 CF_AVN_MoodLpGreenNValueSet 4;
BA_ "GenSigStartValue" SG_ 3221225472 CF_AVN_MoodLpGreenNValueSet 512;
BA_ "UserSigValidity" SG_ 3221225472 CF_AVN_MoodLpGreenNValueSet 3;
BA_ "GenSigTimeoutTime" SG_ 3221225472 CF_AVN_MoodLpGreenNValueSet 0;
BA_ "Version" SG_ 3221225472 CF_AVN_MoodLpGreenNValueSet "17.11.00";
BA_ "GenSigSendType" SG_ 3221225472 CF_AVN_MoodLpBlueNValueSet 4;
BA_ "GenSigStartValue" SG_ 3221225472 CF_AVN_MoodLpBlueNValueSet 512;
BA_ "UserSigValidity" SG_ 3221225472 CF_AVN_MoodLpBlueNValueSet 3;
BA_ "GenSigTimeoutTime" SG_ 3221225472 CF_AVN_MoodLpBlueNValueSet 0;
BA_ "Version" SG_ 3221225472 CF_AVN_MoodLpBlueNValueSet "17.11.00";
BA_ "GenSigSendType" SG_ 3221225472 CF_AVN_MoodLpBrightNValueSet 4;
BA_ "UserSigValidity" SG_ 3221225472 CF_AVN_MoodLpBrightNValueSet 3;
BA_ "GenSigTimeoutTime" SG_ 3221225472 CF_AVN_MoodLpBrightNValueSet 0;
BA_ "Version" SG_ 3221225472 CF_AVN_MoodLpBrightNValueSet "17.11.00";
BA_ "GenSigSendType" SG_ 3221225472 C_MoodLpDrivingNValue 4;
BA_ "UserSigValidity" SG_ 3221225472 C_MoodLpDrivingNValue 3;
BA_ "GenSigTimeoutTime" SG_ 3221225472 C_MoodLpDrivingNValue 0;
BA_ "Version" SG_ 3221225472 C_MoodLpDrivingNValue "17.11.00";
BA_ "GenSigSendType" SG_ 3221225472 C_HCIMSWeightNValueSet 4;
BA_ "UserSigValidity" SG_ 3221225472 C_HCIMSWeightNValueSet 3;
BA_ "GenSigTimeoutTime" SG_ 3221225472 C_HCIMSWeightNValueSet 0;
BA_ "Version" SG_ 3221225472 C_HCIMSWeightNValueSet "17.11.00";
BA_ "GenSigSendType" SG_ 3221225472 C_HCIMSHeightNvalueSet 4;
BA_ "UserSigValidity" SG_ 3221225472 C_HCIMSHeightNvalueSet 3;
BA_ "GenSigTimeoutTime" SG_ 3221225472 C_HCIMSHeightNvalueSet 0;
BA_ "Version" SG_ 3221225472 C_HCIMSHeightNvalueSet "17.11.00";
BA_ "GenSigSendType" SG_ 3221225472 CF_AVN_HCIMSButtonCommand 4;
BA_ "UserSigValidity" SG_ 3221225472 CF_AVN_HCIMSButtonCommand 3;
BA_ "GenSigTimeoutTime" SG_ 3221225472 CF_AVN_HCIMSButtonCommand 0;
BA_ "Version" SG_ 3221225472 CF_AVN_HCIMSButtonCommand "17.11.00";
BA_ "GenSigSendType" SG_ 3221225472 C_HCIMSSitHeightNValueSet 4;
BA_ "UserSigValidity" SG_ 3221225472 C_HCIMSSitHeightNValueSet 3;
BA_ "GenSigTimeoutTime" SG_ 3221225472 C_HCIMSSitHeightNValueSet 0;
BA_ "Version" SG_ 3221225472 C_HCIMSSitHeightNValueSet "17.11.00";
BA_ "Description" SG_ 3221225472 CF_AVN_SeatDrvModNValueSet "시트 스포츠모드 연동 USM";
BA_ "GenSigSendType" SG_ 3221225472 CF_AVN_SeatDrvModNValueSet 4;
BA_ "UserSigValidity" SG_ 3221225472 CF_AVN_SeatDrvModNValueSet 3;
BA_ "GenSigTimeoutTime" SG_ 3221225472 CF_AVN_SeatDrvModNValueSet 0;
BA_ "Version" SG_ 3221225472 CF_AVN_SeatDrvModNValueSet "18.03.07";
BA_ "Description" SG_ 3221225472 CF_AVN_AirSptStrNValueSet "에어서포트 강도 설정";
BA_ "GenSigSendType" SG_ 3221225472 CF_AVN_AirSptStrNValueSet 4;
BA_ "UserSigValidity" SG_ 3221225472 CF_AVN_AirSptStrNValueSet 3;
BA_ "GenSigTimeoutTime" SG_ 3221225472 CF_AVN_AirSptStrNValueSet 0;
BA_ "Version" SG_ 3221225472 CF_AVN_AirSptStrNValueSet "18.03.07";
BA_ "Description" SG_ 3221225472 CF_AVN_AirSptTimeNValueSet "에어서포트 모드 재생 시간 설정";
BA_ "GenSigSendType" SG_ 3221225472 CF_AVN_AirSptTimeNValueSet 4;
BA_ "UserSigValidity" SG_ 3221225472 CF_AVN_AirSptTimeNValueSet 3;
BA_ "GenSigTimeoutTime" SG_ 3221225472 CF_AVN_AirSptTimeNValueSet 0;
BA_ "Version" SG_ 3221225472 CF_AVN_AirSptTimeNValueSet "18.03.07";
BA_ "Description" SG_ 3221225472 CF_AVN_CushSoftNValueSet "쿠션 소프트니스 설정";
BA_ "GenSigSendType" SG_ 3221225472 CF_AVN_CushSoftNValueSet 4;
BA_ "UserSigValidity" SG_ 3221225472 CF_AVN_CushSoftNValueSet 3;
BA_ "GenSigTimeoutTime" SG_ 3221225472 CF_AVN_CushSoftNValueSet 0;
BA_ "Version" SG_ 3221225472 CF_AVN_CushSoftNValueSet "18.03.07";
BA_ "Description" SG_ 3221225472 DoorLock_DrvrDrUnLkPsvAcsReq "Unlock only driver door by passive access (two turn unlock option)";
BA_ "GenSigSendType" SG_ 3221225472 DoorLock_DrvrDrUnLkPsvAcsReq 4;
BA_ "UserSigValidity" SG_ 3221225472 DoorLock_DrvrDrUnLkPsvAcsReq 0;
BA_ "GenSigTimeoutTime" SG_ 3221225472 DoorLock_DrvrDrUnLkPsvAcsReq 0;
BA_ "NetworkRequest" SG_ 3221225472 DoorLock_DrvrDrUnLkPsvAcsReq 0;
BA_ "NetworkRequestHoldingTime" SG_ 3221225472 DoorLock_DrvrDrUnLkPsvAcsReq 5000;
BA_ "Version" SG_ 3221225472 DoorLock_DrvrDrUnLkPsvAcsReq "17.12.00";
BA_ "Description" SG_ 3221225472 DoorLock_RmtKeyDrvrDrUnLkReq "Unlock only driver door by RKE (two turn unlock option)";
BA_ "GenSigSendType" SG_ 3221225472 DoorLock_RmtKeyDrvrDrUnLkReq 4;
BA_ "UserSigValidity" SG_ 3221225472 DoorLock_RmtKeyDrvrDrUnLkReq 0;
BA_ "GenSigTimeoutTime" SG_ 3221225472 DoorLock_RmtKeyDrvrDrUnLkReq 0;
BA_ "NetworkRequest" SG_ 3221225472 DoorLock_RmtKeyDrvrDrUnLkReq 0;
BA_ "NetworkRequestHoldingTime" SG_ 3221225472 DoorLock_RmtKeyDrvrDrUnLkReq 5000;
BA_ "Version" SG_ 3221225472 DoorLock_RmtKeyDrvrDrUnLkReq "17.12.00";
BA_ "UsrSigPurpose" SG_ 3221225472 PTGM_GST_Byte0 2;
BA_ "GenSigSendType" SG_ 3221225472 PTGM_GST_Byte0 2;
BA_ "UserSigValidity" SG_ 3221225472 PTGM_GST_Byte0 0;
BA_ "GenSigTimeoutTime" SG_ 3221225472 PTGM_GST_Byte0 0;
BA_ "NetworkRequest" SG_ 3221225472 PTGM_GST_Byte0 0;
BA_ "NetworkRequestHoldingTime" SG_ 3221225472 PTGM_GST_Byte0 5000;
BA_ "Version" SG_ 3221225472 PTGM_GST_Byte0 "18.01.09";
BA_ "UsrSigPurpose" SG_ 3221225472 PTGM_GST_Byte1 2;
BA_ "GenSigSendType" SG_ 3221225472 PTGM_GST_Byte1 2;
BA_ "UserSigValidity" SG_ 3221225472 PTGM_GST_Byte1 0;
BA_ "GenSigTimeoutTime" SG_ 3221225472 PTGM_GST_Byte1 0;
BA_ "NetworkRequest" SG_ 3221225472 PTGM_GST_Byte1 0;
BA_ "NetworkRequestHoldingTime" SG_ 3221225472 PTGM_GST_Byte1 5000;
BA_ "Version" SG_ 3221225472 PTGM_GST_Byte1 "18.01.09";
BA_ "UsrSigPurpose" SG_ 3221225472 PTGM_GST_Byte2 2;
BA_ "GenSigSendType" SG_ 3221225472 PTGM_GST_Byte2 2;
BA_ "UserSigValidity" SG_ 3221225472 PTGM_GST_Byte2 0;
BA_ "GenSigTimeoutTime" SG_ 3221225472 PTGM_GST_Byte2 0;
BA_ "NetworkRequest" SG_ 3221225472 PTGM_GST_Byte2 0;
BA_ "NetworkRequestHoldingTime" SG_ 3221225472 PTGM_GST_Byte2 5000;
BA_ "Version" SG_ 3221225472 PTGM_GST_Byte2 "18.01.09";
BA_ "UsrSigPurpose" SG_ 3221225472 PTGM_GST_Byte3 2;
BA_ "GenSigSendType" SG_ 3221225472 PTGM_GST_Byte3 2;
BA_ "UserSigValidity" SG_ 3221225472 PTGM_GST_Byte3 0;
BA_ "GenSigTimeoutTime" SG_ 3221225472 PTGM_GST_Byte3 0;
BA_ "NetworkRequest" SG_ 3221225472 PTGM_GST_Byte3 0;
BA_ "NetworkRequestHoldingTime" SG_ 3221225472 PTGM_GST_Byte3 5000;
BA_ "Version" SG_ 3221225472 PTGM_GST_Byte3 "18.01.09";
BA_ "UsrSigPurpose" SG_ 3221225472 PTGM_GST_Byte4 2;
BA_ "GenSigSendType" SG_ 3221225472 PTGM_GST_Byte4 2;
BA_ "UserSigValidity" SG_ 3221225472 PTGM_GST_Byte4 0;
BA_ "GenSigTimeoutTime" SG_ 3221225472 PTGM_GST_Byte4 0;
BA_ "NetworkRequest" SG_ 3221225472 PTGM_GST_Byte4 0;
BA_ "NetworkRequestHoldingTime" SG_ 3221225472 PTGM_GST_Byte4 5000;
BA_ "Version" SG_ 3221225472 PTGM_GST_Byte4 "18.01.09";
BA_ "UsrSigPurpose" SG_ 3221225472 PTGM_GST_Byte5 2;
BA_ "GenSigSendType" SG_ 3221225472 PTGM_GST_Byte5 2;
BA_ "UserSigValidity" SG_ 3221225472 PTGM_GST_Byte5 0;
BA_ "GenSigTimeoutTime" SG_ 3221225472 PTGM_GST_Byte5 0;
BA_ "NetworkRequest" SG_ 3221225472 PTGM_GST_Byte5 0;
BA_ "NetworkRequestHoldingTime" SG_ 3221225472 PTGM_GST_Byte5 5000;
BA_ "Version" SG_ 3221225472 PTGM_GST_Byte5 "18.01.09";
BA_ "UsrSigPurpose" SG_ 3221225472 PTGM_GST_Byte6 2;
BA_ "GenSigSendType" SG_ 3221225472 PTGM_GST_Byte6 2;
BA_ "UserSigValidity" SG_ 3221225472 PTGM_GST_Byte6 0;
BA_ "GenSigTimeoutTime" SG_ 3221225472 PTGM_GST_Byte6 0;
BA_ "NetworkRequest" SG_ 3221225472 PTGM_GST_Byte6 0;
BA_ "NetworkRequestHoldingTime" SG_ 3221225472 PTGM_GST_Byte6 5000;
BA_ "Version" SG_ 3221225472 PTGM_GST_Byte6 "18.01.09";
BA_ "UsrSigPurpose" SG_ 3221225472 PTGM_GST_Byte7 2;
BA_ "GenSigSendType" SG_ 3221225472 PTGM_GST_Byte7 2;
BA_ "UserSigValidity" SG_ 3221225472 PTGM_GST_Byte7 0;
BA_ "GenSigTimeoutTime" SG_ 3221225472 PTGM_GST_Byte7 0;
BA_ "NetworkRequest" SG_ 3221225472 PTGM_GST_Byte7 0;
BA_ "NetworkRequestHoldingTime" SG_ 3221225472 PTGM_GST_Byte7 5000;
BA_ "Version" SG_ 3221225472 PTGM_GST_Byte7 "18.01.09";
BA_ "UsrSigPurpose" SG_ 3221225472 GST_PTGM_Byte0 2;
BA_ "GenSigSendType" SG_ 3221225472 GST_PTGM_Byte0 2;
BA_ "UserSigValidity" SG_ 3221225472 GST_PTGM_Byte0 0;
BA_ "GenSigTimeoutTime" SG_ 3221225472 GST_PTGM_Byte0 0;
BA_ "NetworkRequest" SG_ 3221225472 GST_PTGM_Byte0 0;
BA_ "NetworkRequestHoldingTime" SG_ 3221225472 GST_PTGM_Byte0 5000;
BA_ "Version" SG_ 3221225472 GST_PTGM_Byte0 "18.01.09";
BA_ "UsrSigPurpose" SG_ 3221225472 GST_PTGM_Byte1 2;
BA_ "GenSigSendType" SG_ 3221225472 GST_PTGM_Byte1 2;
BA_ "UserSigValidity" SG_ 3221225472 GST_PTGM_Byte1 0;
BA_ "GenSigTimeoutTime" SG_ 3221225472 GST_PTGM_Byte1 0;
BA_ "NetworkRequest" SG_ 3221225472 GST_PTGM_Byte1 0;
BA_ "NetworkRequestHoldingTime" SG_ 3221225472 GST_PTGM_Byte1 5000;
BA_ "Version" SG_ 3221225472 GST_PTGM_Byte1 "18.01.09";
BA_ "UsrSigPurpose" SG_ 3221225472 GST_PTGM_Byte2 2;
BA_ "GenSigSendType" SG_ 3221225472 GST_PTGM_Byte2 2;
BA_ "UserSigValidity" SG_ 3221225472 GST_PTGM_Byte2 0;
BA_ "GenSigTimeoutTime" SG_ 3221225472 GST_PTGM_Byte2 0;
BA_ "NetworkRequest" SG_ 3221225472 GST_PTGM_Byte2 0;
BA_ "NetworkRequestHoldingTime" SG_ 3221225472 GST_PTGM_Byte2 5000;
BA_ "Version" SG_ 3221225472 GST_PTGM_Byte2 "18.01.09";
BA_ "UsrSigPurpose" SG_ 3221225472 GST_PTGM_Byte3 2;
BA_ "GenSigSendType" SG_ 3221225472 GST_PTGM_Byte3 2;
BA_ "UserSigValidity" SG_ 3221225472 GST_PTGM_Byte3 0;
BA_ "GenSigTimeoutTime" SG_ 3221225472 GST_PTGM_Byte3 0;
BA_ "NetworkRequest" SG_ 3221225472 GST_PTGM_Byte3 0;
BA_ "NetworkRequestHoldingTime" SG_ 3221225472 GST_PTGM_Byte3 5000;
BA_ "Version" SG_ 3221225472 GST_PTGM_Byte3 "18.01.09";
BA_ "UsrSigPurpose" SG_ 3221225472 GST_PTGM_Byte4 2;
BA_ "GenSigSendType" SG_ 3221225472 GST_PTGM_Byte4 2;
BA_ "UserSigValidity" SG_ 3221225472 GST_PTGM_Byte4 0;
BA_ "GenSigTimeoutTime" SG_ 3221225472 GST_PTGM_Byte4 0;
BA_ "NetworkRequest" SG_ 3221225472 GST_PTGM_Byte4 0;
BA_ "NetworkRequestHoldingTime" SG_ 3221225472 GST_PTGM_Byte4 5000;
BA_ "Version" SG_ 3221225472 GST_PTGM_Byte4 "18.01.09";
BA_ "UsrSigPurpose" SG_ 3221225472 GST_PTGM_Byte5 2;
BA_ "GenSigSendType" SG_ 3221225472 GST_PTGM_Byte5 2;
BA_ "UserSigValidity" SG_ 3221225472 GST_PTGM_Byte5 0;
BA_ "GenSigTimeoutTime" SG_ 3221225472 GST_PTGM_Byte5 0;
BA_ "NetworkRequest" SG_ 3221225472 GST_PTGM_Byte5 0;
BA_ "NetworkRequestHoldingTime" SG_ 3221225472 GST_PTGM_Byte5 5000;
BA_ "Version" SG_ 3221225472 GST_PTGM_Byte5 "18.01.09";
BA_ "UsrSigPurpose" SG_ 3221225472 GST_PTGM_Byte6 2;
BA_ "GenSigSendType" SG_ 3221225472 GST_PTGM_Byte6 2;
BA_ "UserSigValidity" SG_ 3221225472 GST_PTGM_Byte6 0;
BA_ "GenSigTimeoutTime" SG_ 3221225472 GST_PTGM_Byte6 0;
BA_ "NetworkRequest" SG_ 3221225472 GST_PTGM_Byte6 0;
BA_ "NetworkRequestHoldingTime" SG_ 3221225472 GST_PTGM_Byte6 5000;
BA_ "Version" SG_ 3221225472 GST_PTGM_Byte6 "18.01.09";
BA_ "UsrSigPurpose" SG_ 3221225472 GST_PTGM_Byte7 2;
BA_ "GenSigSendType" SG_ 3221225472 GST_PTGM_Byte7 2;
BA_ "UserSigValidity" SG_ 3221225472 GST_PTGM_Byte7 0;
BA_ "GenSigTimeoutTime" SG_ 3221225472 GST_PTGM_Byte7 0;
BA_ "NetworkRequest" SG_ 3221225472 GST_PTGM_Byte7 0;
BA_ "NetworkRequestHoldingTime" SG_ 3221225472 GST_PTGM_Byte7 5000;
BA_ "Version" SG_ 3221225472 GST_PTGM_Byte7 "18.01.09";
BA_ "Description" SG_ 3221225472 ENG_Ack4EngStpSta "The signal specifies the acknowledgement of the request for the operating state 'engine stopped'.";
BA_ "UserSigValidity" SG_ 3221225472 ENG_Ack4EngStpSta 3;
BA_ "RoutingFactor" SG_ 3221225472 ENG_Ack4EngStpSta 5;
BA_ "Version" SG_ 3221225472 ENG_Ack4EngStpSta "17.12.00";
BA_ "Description" SG_ 3221225472 ENG_OverDrvOffReq "This signal indicates that auto cruise control function requests over drive off of TCU. 

In general, the over drive off request is done by hardware. (i.e. line-to-line signal between an EMS and a TCU). However, some systems may not have external over dr";
BA_ "UserSigValidity" SG_ 3221225472 ENG_OverDrvOffReq 3;
BA_ "RoutingFactor" SG_ 3221225472 ENG_OverDrvOffReq 5;
BA_ "Version" SG_ 3221225472 ENG_OverDrvOffReq "17.12.00";
BA_ "Description" SG_ 3221225472 ENG_AccActSta "EMS sends the state of the cruise control via the signal ACC_ACT. 

If the EMS does not support this signal the value is 00H



If the cruise control is activated then ACC_ACT = 1. In this period, vehicle speed control (cruise control) is performed by th";
BA_ "UserSigValidity" SG_ 3221225472 ENG_AccActSta 3;
BA_ "RoutingFactor" SG_ 3221225472 ENG_AccActSta 5;
BA_ "Version" SG_ 3221225472 ENG_AccActSta "17.12.00";
BA_ "Description" SG_ 3221225472 ENG_CltchOpSta "This signal indicates that ECU has detected an operation of a clutch. Using this signal an ISG (Idle Stop & Go) system acts as an alternator or a starter.



If the EMS does not support this signal the value is 00H";
BA_ "UserSigValidity" SG_ 3221225472 ENG_CltchOpSta 3;
BA_ "RoutingFactor" SG_ 3221225472 ENG_CltchOpSta 5;
BA_ "Version" SG_ 3221225472 ENG_CltchOpSta "17.12.00";
BA_ "Description" SG_ 3221225472 DSL_GlowCtrlReq "This signal indicates that a diesel ECU requests ISS system to control glow plugs. 



If the EMS does not support this signal the value is 00H";
BA_ "UserSigValidity" SG_ 3221225472 DSL_GlowCtrlReq 3;
BA_ "RoutingFactor" SG_ 3221225472 DSL_GlowCtrlReq 5;
BA_ "Version" SG_ 3221225472 DSL_GlowCtrlReq "17.12.00";
BA_ "Description" SG_ 3221225472 ENG_GlowLmpSta "This signal indicates that a status of glow lamp.



This signal is used for a Diesel or LPI Engine alternatively.";
BA_ "GenSigStartValue" SG_ 3221225472 ENG_GlowLmpSta 1;
BA_ "UserSigValidity" SG_ 3221225472 ENG_GlowLmpSta 3;
BA_ "RoutingFactor" SG_ 3221225472 ENG_GlowLmpSta 5;
BA_ "Version" SG_ 3221225472 ENG_GlowLmpSta "17.12.00";
BA_ "Description" SG_ 3221225472 ENG_ThrPosVal "The signal TPS is a measure of the throttle position.

The throttle position is determined via a potentiometer, which is connected mechanically to the throttle shaft. The voltage value, which is adjusted in the port via the voltage divider, is sensed in ";
BA_ "GenSigStartValue" SG_ 3221225472 ENG_ThrPosVal 32;
BA_ "UserSigValidity" SG_ 3221225472 ENG_ThrPosVal 3;
BA_ "RoutingFactor" SG_ 3221225472 ENG_ThrPosVal 5;
BA_ "Version" SG_ 3221225472 ENG_ThrPosVal "17.12.00";
BA_ "Description" SG_ 3221225472 ENG_AccelPdlVal "The signal PV_AV_CAN is a measure of the Accelerator Pedal value.

The accelerator pedal value is determined via 2 pedal sensors, which are connected mechanically to the

accelerator pedal. If the EMS-ECU recognizes that the accelerator pedal is not acti";
BA_ "UserSigValidity" SG_ 3221225472 ENG_AccelPdlVal 3;
BA_ "RoutingFactor" SG_ 3221225472 ENG_AccelPdlVal 5;
BA_ "Version" SG_ 3221225472 ENG_AccelPdlVal "18.01.01";
BA_ "Description" SG_ 3221225472 ACC_CrsMainSwLmpSta "This signal indicates that an ECU requests cluster to turn on/off auto-cruise control “MAIN” switch indication lamp.



This signal is for the CAN-type cluster installed vehicled only.";
BA_ "UserSigValidity" SG_ 3221225472 ACC_CrsMainSwLmpSta 3;
BA_ "RoutingFactor" SG_ 3221225472 ACC_CrsMainSwLmpSta 5;
BA_ "Version" SG_ 3221225472 ACC_CrsMainSwLmpSta "17.12.00";
BA_ "Description" SG_ 3221225472 ACC_CrsSetSwLmpSta "This signal indicates that an ECU requests cluster to turn on/off auto-cruise control “SET” switch indication lamp.



This signal is for the CAN-type cluster installed vehicled only.";
BA_ "UserSigValidity" SG_ 3221225472 ACC_CrsSetSwLmpSta 3;
BA_ "RoutingFactor" SG_ 3221225472 ACC_CrsSetSwLmpSta 5;
BA_ "Version" SG_ 3221225472 ACC_CrsSetSwLmpSta "17.12.00";
BA_ "Description" SG_ 3221225472 ENG_PreFuelCutInSta "During coast lock up control of TCU, if there occur a fuel cut in control suddenly then shift shock can happen. To prevent this, it is needed to inform fuel cut in control previously to TCU to release damper lock up before fuel cut in control start.";
BA_ "UserSigValidity" SG_ 3221225472 ENG_PreFuelCutInSta 3;
BA_ "RoutingFactor" SG_ 3221225472 ENG_PreFuelCutInSta 5;
BA_ "Version" SG_ 3221225472 ENG_PreFuelCutInSta "17.12.00";
BA_ "Description" SG_ 3221225472 ENG_SoakTimeErrSta "This signal indicates that information on soak time error.";
BA_ "UserSigValidity" SG_ 3221225472 ENG_SoakTimeErrSta 3;
BA_ "RoutingFactor" SG_ 3221225472 ENG_SoakTimeErrSta 5;
BA_ "Version" SG_ 3221225472 ENG_SoakTimeErrSta "17.12.00";
BA_ "Description" SG_ 3221225472 ENG_SoakTimeVal "The Signal SOAK_TIME means the duration from Engine Ignition Off to Ignition On.";
BA_ "UserSigValidity" SG_ 3221225472 ENG_SoakTimeVal 3;
BA_ "RoutingFactor" SG_ 3221225472 ENG_SoakTimeVal 5;
BA_ "Version" SG_ 3221225472 ENG_SoakTimeVal "17.12.00";
BA_ "Description" SG_ 3221225472 ENG_SprkTimeVal "This signal indicates output value of final spark timing from ECU which reflects torque intervention requests by ESC(TCS), SCC and TCU.



Physical range:

-35.625˚ … 0˚  =  00H .. 5FH (Retard)

0.375˚ … 60˚  =  60H .. FFH (Advance) 



Conversion:";
BA_ "UserSigValidity" SG_ 3221225472 ENG_SprkTimeVal 3;
BA_ "RoutingFactor" SG_ 3221225472 ENG_SprkTimeVal 5;
BA_ "Version" SG_ 3221225472 ENG_SprkTimeVal "17.12.00";
BA_ "Description" SG_ 3221225472 ENG_MinIndTqVal "The signal TQI_MIN is the minimum engine torque (minimum air charging rate) which can be fired without misfire including compensation factors such as atmospheric pressure and temperature.

It is not enough to keep the engine running without external powe";
BA_ "UserSigValidity" SG_ 3221225472 ENG_MinIndTqVal 3;
BA_ "RoutingFactor" SG_ 3221225472 ENG_MinIndTqVal 5;
BA_ "Version" SG_ 3221225472 ENG_MinIndTqVal "18.01.01";
BA_ "Description" SG_ 3221225472 ENG_TrgtTqVal "The signal TQI_TARGET is determined by an engine torque map with input which consists of  acceleration pedal value, MAF sensor, current RPM and etc. This signal reflects driver’s demand directly. 

But it does not depend on torque interventions realised";
BA_ "UserSigValidity" SG_ 3221225472 ENG_TrgtTqVal 3;
BA_ "RoutingFactor" SG_ 3221225472 ENG_TrgtTqVal 5;
BA_ "Version" SG_ 3221225472 ENG_TrgtTqVal "18.01.01";
BA_ "Description" SG_ 3221225472 ENG_MaxIndTqVal "The signal TQI_MAX is the current maximum indicated engine torque. This signal reflects the maximum engine torque under current conditions (engine speed, etc…).



Note : TQI_MAX must be transmitted actual engine torque including COT, thermal/spark effi";
BA_ "UserSigValidity" SG_ 3221225472 ENG_MaxIndTqVal 3;
BA_ "RoutingFactor" SG_ 3221225472 ENG_MaxIndTqVal 5;
BA_ "Version" SG_ 3221225472 ENG_MaxIndTqVal "18.01.01";
BA_ "Description" SG_ 3221225472 ENG_AppAccelPdlSta "This signal indicates if the driver applies the accelerator pedal. 

The signal always indicates the actual operation of the accelerator pedal, independent from SCC mode.";
BA_ "UserSigValidity" SG_ 3221225472 ENG_AppAccelPdlSta 3;
BA_ "RoutingFactor" SG_ 3221225472 ENG_AppAccelPdlSta 5;
BA_ "Version" SG_ 3221225472 ENG_AppAccelPdlSta "17.12.00";
BA_ "Description" SG_ 3221225472 ENG_BrkCtrlReq "This signal indicates that if brake control request during cruise control or speed limiter is active or not. This signal is for prevention of unwanted vehicle speed increase during cruise control or speed limiter control mode.";
BA_ "UserSigValidity" SG_ 3221225472 ENG_BrkCtrlReq 3;
BA_ "RoutingFactor" SG_ 3221225472 ENG_BrkCtrlReq 5;
BA_ "Version" SG_ 3221225472 ENG_BrkCtrlReq "17.12.00";
BA_ "Description" SG_ 3221225472 ACC_DnShftCtrlReq "This signal indicates target gear for downshift control request during cruise control or speed limiter is active or not. This signal is for prevention of unwanted vehicle speed increase during cruise control or speed limiter control mode.";
BA_ "UserSigValidity" SG_ 3221225472 ACC_DnShftCtrlReq 3;
BA_ "RoutingFactor" SG_ 3221225472 ACC_DnShftCtrlReq 5;
BA_ "Version" SG_ 3221225472 ACC_DnShftCtrlReq "17.12.00";
BA_ "Description" SG_ 3221225472 ENG_ReprgmModRdySta "RepEMS_CHK indicates that the EMS system is ready to enter the reprogramming mode.

When battery voltage and SOC are too low, EMS doesn’t enter the reprogramming ready mode";
BA_ "UserSigValidity" SG_ 3221225472 ENG_ReprgmModRdySta 3;
BA_ "RoutingFactor" SG_ 3221225472 ENG_ReprgmModRdySta 5;
BA_ "Version" SG_ 3221225472 ENG_ReprgmModRdySta "17.12.00";
BA_ "Description" SG_ 3221225472 ENG_AafOpnReq "Active Air Flap open request for Thermostat diagnosis";
BA_ "UserSigValidity" SG_ 3221225472 ENG_AafOpnReq 3;
BA_ "RoutingFactor" SG_ 3221225472 ENG_AafOpnReq 5;
BA_ "Version" SG_ 3221225472 ENG_AafOpnReq "17.12.00";
BA_ "Description" SG_ 3221225472 EMS_Crc2Val "The CRC checking process calculates the CRC over the entire data block, including the CRC result.

- CRC Polynomial (0x1021) , Initial Value : 0xFFFF, XOR value : 0x0000

- The mathematical expression to 16 bit CRC polynomial is given here. G(x) = x16 + ";
BA_ "GenSigStartValue" SG_ 3221225472 EMS_Crc2Val 65535;
BA_ "UserSigValidity" SG_ 3221225472 EMS_Crc2Val 3;
BA_ "RoutingFactor" SG_ 3221225472 EMS_Crc2Val 5;
BA_ "Version" SG_ 3221225472 EMS_Crc2Val "17.11.00";
BA_ "Description" SG_ 3221225472 EMS_AlvCnt2Val "For the first transmission request for a data element the counter shall be initialized with 0 and shall be incremented by 1

for every subsequent send request. When the counter reaches the maximum value(0xFF), then it shall restart with ? for the next se";
BA_ "UserSigValidity" SG_ 3221225472 EMS_AlvCnt2Val 3;
BA_ "RoutingFactor" SG_ 3221225472 EMS_AlvCnt2Val 5;
BA_ "Version" SG_ 3221225472 EMS_AlvCnt2Val "17.12.03";
BA_ "Description" SG_ 3221225472 ENG_BrkSwSta "This signal indicates that a brake switch is activated or not. When the brake switch is activated(pressed) its value is 02H otherwise its value is 01H.

If the EMS does not support this signal the value is 00H.



Physical range : 0 ... 100

Conversion :";
BA_ "GenSigStartValue" SG_ 3221225472 ENG_BrkSwSta 1;
BA_ "UserSigValidity" SG_ 3221225472 ENG_BrkSwSta 3;
BA_ "RoutingFactor" SG_ 3221225472 ENG_BrkSwSta 5;
BA_ "Version" SG_ 3221225472 ENG_BrkSwSta "17.12.00";
BA_ "Description" SG_ 3221225472 ENG_ObdFrzFrmSta "An ECU which detects an OBD fault, requires the EMS to store a set of environmental conditions

(freeze frame). If the EMS follows this requirement it is acknowledged in OBD_FRF_ACK. Also the synchronization of OBD relevant ECUs is made by this signal:

";
BA_ "UserSigValidity" SG_ 3221225472 ENG_ObdFrzFrmSta 3;
BA_ "RoutingFactor" SG_ 3221225472 ENG_ObdFrzFrmSta 5;
BA_ "Version" SG_ 3221225472 ENG_ObdFrzFrmSta "17.12.00";
BA_ "Description" SG_ 3221225472 ENG_EngClntTempVal "Engine coolant temperature in EMS sensed via an A/D converter; converted into degrees centigrade (°C).";
BA_ "GenSigStartValue" SG_ 3221225472 ENG_EngClntTempVal 255;
BA_ "UserSigValidity" SG_ 3221225472 ENG_EngClntTempVal 3;
BA_ "RoutingFactor" SG_ 3221225472 ENG_EngClntTempVal 5;
BA_ "Version" SG_ 3221225472 ENG_EngClntTempVal "17.12.00";
BA_ "Description" SG_ 3221225472 ENG_MafCrctVal "The altitude correction factor MAF_FAC_ALTI_MMV is calculated from division of MAF by MAF_SUB_DIAG (=limp home-value for MAF) or from AMP_AD by 1013 mbar in order to take into account different atmospheric pressures at different altitudes.



The Initial";
BA_ "GenSigStartValue" SG_ 3221225472 ENG_MafCrctVal 128;
BA_ "UserSigValidity" SG_ 3221225472 ENG_MafCrctVal 3;
BA_ "RoutingFactor" SG_ 3221225472 ENG_MafCrctVal 5;
BA_ "Version" SG_ 3221225472 ENG_MafCrctVal "17.12.00";
BA_ "Description" SG_ 3221225472 ENG_BattDscnctSta "The signal specifies that ECU has detected a disconnection of the battery since last driving cycle, and therefore has reset the adaptive values and failure memory.

If the EMS does not support this signal the value is 00H



The failure memory erasure is";
BA_ "UserSigValidity" SG_ 3221225472 ENG_BattDscnctSta 3;
BA_ "RoutingFactor" SG_ 3221225472 ENG_BattDscnctSta 5;
BA_ "Version" SG_ 3221225472 ENG_BattDscnctSta "17.12.00";
BA_ "Description" SG_ 3221225472 OBD_MilConfgVal "The signal specifies the Configuration of the MIL Handling and Failure Memory Management by ECU.";
BA_ "GenSigStartValue" SG_ 3221225472 OBD_MilConfgVal 3;
BA_ "UserSigValidity" SG_ 3221225472 OBD_MilConfgVal 3;
BA_ "RoutingFactor" SG_ 3221225472 OBD_MilConfgVal 5;
BA_ "Version" SG_ 3221225472 OBD_MilConfgVal "17.12.00";
BA_ "Description" SG_ 3221225472 ENG_EngSta "This signal indicates that a status of engine.";
BA_ "UserSigValidity" SG_ 3221225472 ENG_EngSta 3;
BA_ "RoutingFactor" SG_ 3221225472 ENG_EngSta 5;
BA_ "Version" SG_ 3221225472 ENG_EngSta "17.12.00";
BA_ "Description" SG_ 3221225472 ENG_DclBrkCntrlReq "When current vehicle speed goes over set vehicle speed in the downhill during cruise control or speed limiter, ECU requests brake control to TCS with target deceleration. This is function of (Current vehicle speed - Set vehicle speed).";
BA_ "GenSigStartValue" SG_ 3221225472 ENG_DclBrkCntrlReq 4094;
BA_ "UserSigValidity" SG_ 3221225472 ENG_DclBrkCntrlReq 3;
BA_ "RoutingFactor" SG_ 3221225472 ENG_DclBrkCntrlReq 5;
BA_ "Version" SG_ 3221225472 ENG_DclBrkCntrlReq "17.12.00";
BA_ "Description" SG_ 3221225472 ENG_BstPrsrVal "Boost pressure for Turbo engine";
BA_ "UserSigValidity" SG_ 3221225472 ENG_BstPrsrVal 3;
BA_ "RoutingFactor" SG_ 3221225472 ENG_BstPrsrVal 5;
BA_ "Version" SG_ 3221225472 ENG_BstPrsrVal "17.12.00";
BA_ "Description" SG_ 3221225472 ENG_EngOilTempVal "engine oil temperature";
BA_ "GenSigStartValue" SG_ 3221225472 ENG_EngOilTempVal 53;
BA_ "UserSigValidity" SG_ 3221225472 ENG_EngOilTempVal 3;
BA_ "RoutingFactor" SG_ 3221225472 ENG_EngOilTempVal 5;
BA_ "Version" SG_ 3221225472 ENG_EngOilTempVal "17.12.00";
BA_ "Description" SG_ 3221225472 ENG_AmbtTempModelVal "Modeled Ambient temperature";
BA_ "GenSigStartValue" SG_ 3221225472 ENG_AmbtTempModelVal 164;
BA_ "UserSigValidity" SG_ 3221225472 ENG_AmbtTempModelVal 3;
BA_ "RoutingFactor" SG_ 3221225472 ENG_AmbtTempModelVal 5;
BA_ "Version" SG_ 3221225472 ENG_AmbtTempModelVal "17.12.00";
BA_ "Description" SG_ 3221225472 ENG_DpfWrngSta "The signal indicates the status of the 'DPF Warning Level'";
BA_ "UserSigValidity" SG_ 3221225472 ENG_DpfWrngSta 3;
BA_ "RoutingFactor" SG_ 3221225472 ENG_DpfWrngSta 5;
BA_ "Version" SG_ 3221225472 ENG_DpfWrngSta "17.12.00";
BA_ "Description" SG_ 3221225472 ENG_BattWrngLmpSta "The signal indicates the status of the 'Battery Warning Lamp'";
BA_ "UserSigValidity" SG_ 3221225472 ENG_BattWrngLmpSta 3;
BA_ "RoutingFactor" SG_ 3221225472 ENG_BattWrngLmpSta 5;
BA_ "Version" SG_ 3221225472 ENG_BattWrngLmpSta "17.12.00";
BA_ "Description" SG_ 3221225472 ENG_OilPrsrWrngLmpSta "The signal indicates the status of the 'Oil Pressure Warning Lamp'";
BA_ "UserSigValidity" SG_ 3221225472 ENG_OilPrsrWrngLmpSta 3;
BA_ "RoutingFactor" SG_ 3221225472 ENG_OilPrsrWrngLmpSta 5;
BA_ "Version" SG_ 3221225472 ENG_OilPrsrWrngLmpSta "17.12.00";
BA_ "Description" SG_ 3221225472 ENG_IsgInhbtLmpSta "The signal indicates the status of the 'ISG Inhibit Lamp'";
BA_ "UserSigValidity" SG_ 3221225472 ENG_IsgInhbtLmpSta 3;
BA_ "RoutingFactor" SG_ 3221225472 ENG_IsgInhbtLmpSta 5;
BA_ "Version" SG_ 3221225472 ENG_IsgInhbtLmpSta "17.12.00";
BA_ "UsrSigPurpose" SG_ 3221225472 DLBCU_GST_Byte0 2;
BA_ "GenSigSendType" SG_ 3221225472 DLBCU_GST_Byte0 2;
BA_ "UserSigValidity" SG_ 3221225472 DLBCU_GST_Byte0 0;
BA_ "GenSigTimeoutTime" SG_ 3221225472 DLBCU_GST_Byte0 0;
BA_ "NetworkRequest" SG_ 3221225472 DLBCU_GST_Byte0 0;
BA_ "NetworkRequestHoldingTime" SG_ 3221225472 DLBCU_GST_Byte0 5000;
BA_ "Version" SG_ 3221225472 DLBCU_GST_Byte0 "18.03.03";
BA_ "UsrSigPurpose" SG_ 3221225472 DLBCU_GST_Byte1 2;
BA_ "GenSigSendType" SG_ 3221225472 DLBCU_GST_Byte1 2;
BA_ "UserSigValidity" SG_ 3221225472 DLBCU_GST_Byte1 0;
BA_ "GenSigTimeoutTime" SG_ 3221225472 DLBCU_GST_Byte1 0;
BA_ "NetworkRequest" SG_ 3221225472 DLBCU_GST_Byte1 0;
BA_ "NetworkRequestHoldingTime" SG_ 3221225472 DLBCU_GST_Byte1 5000;
BA_ "Version" SG_ 3221225472 DLBCU_GST_Byte1 "18.03.03";
BA_ "UsrSigPurpose" SG_ 3221225472 DLBCU_GST_Byte2 2;
BA_ "GenSigSendType" SG_ 3221225472 DLBCU_GST_Byte2 2;
BA_ "UserSigValidity" SG_ 3221225472 DLBCU_GST_Byte2 0;
BA_ "GenSigTimeoutTime" SG_ 3221225472 DLBCU_GST_Byte2 0;
BA_ "NetworkRequest" SG_ 3221225472 DLBCU_GST_Byte2 0;
BA_ "NetworkRequestHoldingTime" SG_ 3221225472 DLBCU_GST_Byte2 5000;
BA_ "Version" SG_ 3221225472 DLBCU_GST_Byte2 "18.03.03";
BA_ "UsrSigPurpose" SG_ 3221225472 DLBCU_GST_Byte3 2;
BA_ "GenSigSendType" SG_ 3221225472 DLBCU_GST_Byte3 2;
BA_ "UserSigValidity" SG_ 3221225472 DLBCU_GST_Byte3 0;
BA_ "GenSigTimeoutTime" SG_ 3221225472 DLBCU_GST_Byte3 0;
BA_ "NetworkRequest" SG_ 3221225472 DLBCU_GST_Byte3 0;
BA_ "NetworkRequestHoldingTime" SG_ 3221225472 DLBCU_GST_Byte3 5000;
BA_ "Version" SG_ 3221225472 DLBCU_GST_Byte3 "18.03.03";
BA_ "UsrSigPurpose" SG_ 3221225472 DLBCU_GST_Byte4 2;
BA_ "GenSigSendType" SG_ 3221225472 DLBCU_GST_Byte4 2;
BA_ "UserSigValidity" SG_ 3221225472 DLBCU_GST_Byte4 0;
BA_ "GenSigTimeoutTime" SG_ 3221225472 DLBCU_GST_Byte4 0;
BA_ "NetworkRequest" SG_ 3221225472 DLBCU_GST_Byte4 0;
BA_ "NetworkRequestHoldingTime" SG_ 3221225472 DLBCU_GST_Byte4 5000;
BA_ "Version" SG_ 3221225472 DLBCU_GST_Byte4 "18.03.03";
BA_ "UsrSigPurpose" SG_ 3221225472 DLBCU_GST_Byte5 2;
BA_ "GenSigSendType" SG_ 3221225472 DLBCU_GST_Byte5 2;
BA_ "UserSigValidity" SG_ 3221225472 DLBCU_GST_Byte5 0;
BA_ "GenSigTimeoutTime" SG_ 3221225472 DLBCU_GST_Byte5 0;
BA_ "NetworkRequest" SG_ 3221225472 DLBCU_GST_Byte5 0;
BA_ "NetworkRequestHoldingTime" SG_ 3221225472 DLBCU_GST_Byte5 5000;
BA_ "Version" SG_ 3221225472 DLBCU_GST_Byte5 "18.03.03";
BA_ "UsrSigPurpose" SG_ 3221225472 DLBCU_GST_Byte6 2;
BA_ "GenSigSendType" SG_ 3221225472 DLBCU_GST_Byte6 2;
BA_ "UserSigValidity" SG_ 3221225472 DLBCU_GST_Byte6 0;
BA_ "GenSigTimeoutTime" SG_ 3221225472 DLBCU_GST_Byte6 0;
BA_ "NetworkRequest" SG_ 3221225472 DLBCU_GST_Byte6 0;
BA_ "NetworkRequestHoldingTime" SG_ 3221225472 DLBCU_GST_Byte6 5000;
BA_ "Version" SG_ 3221225472 DLBCU_GST_Byte6 "18.03.03";
BA_ "UsrSigPurpose" SG_ 3221225472 DLBCU_GST_Byte7 2;
BA_ "GenSigSendType" SG_ 3221225472 DLBCU_GST_Byte7 2;
BA_ "UserSigValidity" SG_ 3221225472 DLBCU_GST_Byte7 0;
BA_ "GenSigTimeoutTime" SG_ 3221225472 DLBCU_GST_Byte7 0;
BA_ "NetworkRequest" SG_ 3221225472 DLBCU_GST_Byte7 0;
BA_ "NetworkRequestHoldingTime" SG_ 3221225472 DLBCU_GST_Byte7 5000;
BA_ "Version" SG_ 3221225472 DLBCU_GST_Byte7 "18.03.03";
BA_ "UsrSigPurpose" SG_ 3221225472 DPSS_GST_Byte0 2;
BA_ "GenSigSendType" SG_ 3221225472 DPSS_GST_Byte0 2;
BA_ "UserSigValidity" SG_ 3221225472 DPSS_GST_Byte0 0;
BA_ "GenSigTimeoutTime" SG_ 3221225472 DPSS_GST_Byte0 0;
BA_ "NetworkRequest" SG_ 3221225472 DPSS_GST_Byte0 0;
BA_ "NetworkRequestHoldingTime" SG_ 3221225472 DPSS_GST_Byte0 5000;
BA_ "Version" SG_ 3221225472 DPSS_GST_Byte0 "18.03.05";
BA_ "UsrSigPurpose" SG_ 3221225472 DPSS_GST_Byte1 2;
BA_ "GenSigSendType" SG_ 3221225472 DPSS_GST_Byte1 2;
BA_ "UserSigValidity" SG_ 3221225472 DPSS_GST_Byte1 0;
BA_ "GenSigTimeoutTime" SG_ 3221225472 DPSS_GST_Byte1 0;
BA_ "NetworkRequest" SG_ 3221225472 DPSS_GST_Byte1 0;
BA_ "NetworkRequestHoldingTime" SG_ 3221225472 DPSS_GST_Byte1 5000;
BA_ "Version" SG_ 3221225472 DPSS_GST_Byte1 "18.03.05";
BA_ "UsrSigPurpose" SG_ 3221225472 DPSS_GST_Byte2 2;
BA_ "GenSigSendType" SG_ 3221225472 DPSS_GST_Byte2 2;
BA_ "UserSigValidity" SG_ 3221225472 DPSS_GST_Byte2 0;
BA_ "GenSigTimeoutTime" SG_ 3221225472 DPSS_GST_Byte2 0;
BA_ "NetworkRequest" SG_ 3221225472 DPSS_GST_Byte2 0;
BA_ "NetworkRequestHoldingTime" SG_ 3221225472 DPSS_GST_Byte2 5000;
BA_ "Version" SG_ 3221225472 DPSS_GST_Byte2 "18.03.05";
BA_ "UsrSigPurpose" SG_ 3221225472 DPSS_GST_Byte3 2;
BA_ "GenSigSendType" SG_ 3221225472 DPSS_GST_Byte3 2;
BA_ "UserSigValidity" SG_ 3221225472 DPSS_GST_Byte3 0;
BA_ "GenSigTimeoutTime" SG_ 3221225472 DPSS_GST_Byte3 0;
BA_ "NetworkRequest" SG_ 3221225472 DPSS_GST_Byte3 0;
BA_ "NetworkRequestHoldingTime" SG_ 3221225472 DPSS_GST_Byte3 5000;
BA_ "Version" SG_ 3221225472 DPSS_GST_Byte3 "18.03.05";
BA_ "UsrSigPurpose" SG_ 3221225472 DPSS_GST_Byte4 2;
BA_ "GenSigSendType" SG_ 3221225472 DPSS_GST_Byte4 2;
BA_ "UserSigValidity" SG_ 3221225472 DPSS_GST_Byte4 0;
BA_ "GenSigTimeoutTime" SG_ 3221225472 DPSS_GST_Byte4 0;
BA_ "NetworkRequest" SG_ 3221225472 DPSS_GST_Byte4 0;
BA_ "NetworkRequestHoldingTime" SG_ 3221225472 DPSS_GST_Byte4 5000;
BA_ "Version" SG_ 3221225472 DPSS_GST_Byte4 "18.03.05";
BA_ "UsrSigPurpose" SG_ 3221225472 DPSS_GST_Byte5 2;
BA_ "GenSigSendType" SG_ 3221225472 DPSS_GST_Byte5 2;
BA_ "UserSigValidity" SG_ 3221225472 DPSS_GST_Byte5 0;
BA_ "GenSigTimeoutTime" SG_ 3221225472 DPSS_GST_Byte5 0;
BA_ "NetworkRequest" SG_ 3221225472 DPSS_GST_Byte5 0;
BA_ "NetworkRequestHoldingTime" SG_ 3221225472 DPSS_GST_Byte5 5000;
BA_ "Version" SG_ 3221225472 DPSS_GST_Byte5 "18.03.05";
BA_ "UsrSigPurpose" SG_ 3221225472 DPSS_GST_Byte6 2;
BA_ "GenSigSendType" SG_ 3221225472 DPSS_GST_Byte6 2;
BA_ "UserSigValidity" SG_ 3221225472 DPSS_GST_Byte6 0;
BA_ "GenSigTimeoutTime" SG_ 3221225472 DPSS_GST_Byte6 0;
BA_ "NetworkRequest" SG_ 3221225472 DPSS_GST_Byte6 0;
BA_ "NetworkRequestHoldingTime" SG_ 3221225472 DPSS_GST_Byte6 5000;
BA_ "Version" SG_ 3221225472 DPSS_GST_Byte6 "18.03.05";
BA_ "UsrSigPurpose" SG_ 3221225472 DPSS_GST_Byte7 2;
BA_ "GenSigSendType" SG_ 3221225472 DPSS_GST_Byte7 2;
BA_ "UserSigValidity" SG_ 3221225472 DPSS_GST_Byte7 0;
BA_ "GenSigTimeoutTime" SG_ 3221225472 DPSS_GST_Byte7 0;
BA_ "NetworkRequest" SG_ 3221225472 DPSS_GST_Byte7 0;
BA_ "NetworkRequestHoldingTime" SG_ 3221225472 DPSS_GST_Byte7 5000;
BA_ "Version" SG_ 3221225472 DPSS_GST_Byte7 "18.03.05";
BA_ "UsrSigPurpose" SG_ 3221225472 GST_DLBCU_Byte0 2;
BA_ "GenSigSendType" SG_ 3221225472 GST_DLBCU_Byte0 2;
BA_ "UserSigValidity" SG_ 3221225472 GST_DLBCU_Byte0 0;
BA_ "GenSigTimeoutTime" SG_ 3221225472 GST_DLBCU_Byte0 0;
BA_ "NetworkRequest" SG_ 3221225472 GST_DLBCU_Byte0 0;
BA_ "NetworkRequestHoldingTime" SG_ 3221225472 GST_DLBCU_Byte0 5000;
BA_ "Version" SG_ 3221225472 GST_DLBCU_Byte0 "18.03.03";
BA_ "UsrSigPurpose" SG_ 3221225472 GST_DLBCU_Byte1 2;
BA_ "GenSigSendType" SG_ 3221225472 GST_DLBCU_Byte1 2;
BA_ "UserSigValidity" SG_ 3221225472 GST_DLBCU_Byte1 0;
BA_ "GenSigTimeoutTime" SG_ 3221225472 GST_DLBCU_Byte1 0;
BA_ "NetworkRequest" SG_ 3221225472 GST_DLBCU_Byte1 0;
BA_ "NetworkRequestHoldingTime" SG_ 3221225472 GST_DLBCU_Byte1 5000;
BA_ "Version" SG_ 3221225472 GST_DLBCU_Byte1 "18.03.03";
BA_ "UsrSigPurpose" SG_ 3221225472 GST_DLBCU_Byte2 2;
BA_ "GenSigSendType" SG_ 3221225472 GST_DLBCU_Byte2 2;
BA_ "UserSigValidity" SG_ 3221225472 GST_DLBCU_Byte2 0;
BA_ "GenSigTimeoutTime" SG_ 3221225472 GST_DLBCU_Byte2 0;
BA_ "NetworkRequest" SG_ 3221225472 GST_DLBCU_Byte2 0;
BA_ "NetworkRequestHoldingTime" SG_ 3221225472 GST_DLBCU_Byte2 5000;
BA_ "Version" SG_ 3221225472 GST_DLBCU_Byte2 "18.03.03";
BA_ "UsrSigPurpose" SG_ 3221225472 GST_DLBCU_Byte3 2;
BA_ "GenSigSendType" SG_ 3221225472 GST_DLBCU_Byte3 2;
BA_ "UserSigValidity" SG_ 3221225472 GST_DLBCU_Byte3 0;
BA_ "GenSigTimeoutTime" SG_ 3221225472 GST_DLBCU_Byte3 0;
BA_ "NetworkRequest" SG_ 3221225472 GST_DLBCU_Byte3 0;
BA_ "NetworkRequestHoldingTime" SG_ 3221225472 GST_DLBCU_Byte3 5000;
BA_ "Version" SG_ 3221225472 GST_DLBCU_Byte3 "18.03.03";
BA_ "UsrSigPurpose" SG_ 3221225472 GST_DLBCU_Byte4 2;
BA_ "GenSigSendType" SG_ 3221225472 GST_DLBCU_Byte4 2;
BA_ "UserSigValidity" SG_ 3221225472 GST_DLBCU_Byte4 0;
BA_ "GenSigTimeoutTime" SG_ 3221225472 GST_DLBCU_Byte4 0;
BA_ "NetworkRequest" SG_ 3221225472 GST_DLBCU_Byte4 0;
BA_ "NetworkRequestHoldingTime" SG_ 3221225472 GST_DLBCU_Byte4 5000;
BA_ "Version" SG_ 3221225472 GST_DLBCU_Byte4 "18.03.03";
BA_ "UsrSigPurpose" SG_ 3221225472 GST_DLBCU_Byte5 2;
BA_ "GenSigSendType" SG_ 3221225472 GST_DLBCU_Byte5 2;
BA_ "UserSigValidity" SG_ 3221225472 GST_DLBCU_Byte5 0;
BA_ "GenSigTimeoutTime" SG_ 3221225472 GST_DLBCU_Byte5 0;
BA_ "NetworkRequest" SG_ 3221225472 GST_DLBCU_Byte5 0;
BA_ "NetworkRequestHoldingTime" SG_ 3221225472 GST_DLBCU_Byte5 5000;
BA_ "Version" SG_ 3221225472 GST_DLBCU_Byte5 "18.03.03";
BA_ "UsrSigPurpose" SG_ 3221225472 GST_DLBCU_Byte6 2;
BA_ "GenSigSendType" SG_ 3221225472 GST_DLBCU_Byte6 2;
BA_ "UserSigValidity" SG_ 3221225472 GST_DLBCU_Byte6 0;
BA_ "GenSigTimeoutTime" SG_ 3221225472 GST_DLBCU_Byte6 0;
BA_ "NetworkRequest" SG_ 3221225472 GST_DLBCU_Byte6 0;
BA_ "NetworkRequestHoldingTime" SG_ 3221225472 GST_DLBCU_Byte6 5000;
BA_ "Version" SG_ 3221225472 GST_DLBCU_Byte6 "18.03.03";
BA_ "UsrSigPurpose" SG_ 3221225472 GST_DLBCU_Byte7 2;
BA_ "GenSigSendType" SG_ 3221225472 GST_DLBCU_Byte7 2;
BA_ "UserSigValidity" SG_ 3221225472 GST_DLBCU_Byte7 0;
BA_ "GenSigTimeoutTime" SG_ 3221225472 GST_DLBCU_Byte7 0;
BA_ "NetworkRequest" SG_ 3221225472 GST_DLBCU_Byte7 0;
BA_ "NetworkRequestHoldingTime" SG_ 3221225472 GST_DLBCU_Byte7 5000;
BA_ "Version" SG_ 3221225472 GST_DLBCU_Byte7 "18.03.03";
BA_ "UsrSigPurpose" SG_ 3221225472 GST_DPSS_Byte0 2;
BA_ "GenSigSendType" SG_ 3221225472 GST_DPSS_Byte0 2;
BA_ "UserSigValidity" SG_ 3221225472 GST_DPSS_Byte0 0;
BA_ "GenSigTimeoutTime" SG_ 3221225472 GST_DPSS_Byte0 0;
BA_ "NetworkRequest" SG_ 3221225472 GST_DPSS_Byte0 0;
BA_ "NetworkRequestHoldingTime" SG_ 3221225472 GST_DPSS_Byte0 5000;
BA_ "Version" SG_ 3221225472 GST_DPSS_Byte0 "18.03.05";
BA_ "UsrSigPurpose" SG_ 3221225472 GST_DPSS_Byte1 2;
BA_ "GenSigSendType" SG_ 3221225472 GST_DPSS_Byte1 2;
BA_ "UserSigValidity" SG_ 3221225472 GST_DPSS_Byte1 0;
BA_ "GenSigTimeoutTime" SG_ 3221225472 GST_DPSS_Byte1 0;
BA_ "NetworkRequest" SG_ 3221225472 GST_DPSS_Byte1 0;
BA_ "NetworkRequestHoldingTime" SG_ 3221225472 GST_DPSS_Byte1 5000;
BA_ "Version" SG_ 3221225472 GST_DPSS_Byte1 "18.03.05";
BA_ "UsrSigPurpose" SG_ 3221225472 GST_DPSS_Byte2 2;
BA_ "GenSigSendType" SG_ 3221225472 GST_DPSS_Byte2 2;
BA_ "UserSigValidity" SG_ 3221225472 GST_DPSS_Byte2 0;
BA_ "GenSigTimeoutTime" SG_ 3221225472 GST_DPSS_Byte2 0;
BA_ "NetworkRequest" SG_ 3221225472 GST_DPSS_Byte2 0;
BA_ "NetworkRequestHoldingTime" SG_ 3221225472 GST_DPSS_Byte2 5000;
BA_ "Version" SG_ 3221225472 GST_DPSS_Byte2 "18.03.05";
BA_ "UsrSigPurpose" SG_ 3221225472 GST_DPSS_Byte3 2;
BA_ "GenSigSendType" SG_ 3221225472 GST_DPSS_Byte3 2;
BA_ "UserSigValidity" SG_ 3221225472 GST_DPSS_Byte3 0;
BA_ "GenSigTimeoutTime" SG_ 3221225472 GST_DPSS_Byte3 0;
BA_ "NetworkRequest" SG_ 3221225472 GST_DPSS_Byte3 0;
BA_ "NetworkRequestHoldingTime" SG_ 3221225472 GST_DPSS_Byte3 5000;
BA_ "Version" SG_ 3221225472 GST_DPSS_Byte3 "18.03.05";
BA_ "UsrSigPurpose" SG_ 3221225472 GST_DPSS_Byte4 2;
BA_ "GenSigSendType" SG_ 3221225472 GST_DPSS_Byte4 2;
BA_ "UserSigValidity" SG_ 3221225472 GST_DPSS_Byte4 0;
BA_ "GenSigTimeoutTime" SG_ 3221225472 GST_DPSS_Byte4 0;
BA_ "NetworkRequest" SG_ 3221225472 GST_DPSS_Byte4 0;
BA_ "NetworkRequestHoldingTime" SG_ 3221225472 GST_DPSS_Byte4 5000;
BA_ "Version" SG_ 3221225472 GST_DPSS_Byte4 "18.03.05";
BA_ "UsrSigPurpose" SG_ 3221225472 GST_DPSS_Byte5 2;
BA_ "GenSigSendType" SG_ 3221225472 GST_DPSS_Byte5 2;
BA_ "UserSigValidity" SG_ 3221225472 GST_DPSS_Byte5 0;
BA_ "GenSigTimeoutTime" SG_ 3221225472 GST_DPSS_Byte5 0;
BA_ "NetworkRequest" SG_ 3221225472 GST_DPSS_Byte5 0;
BA_ "NetworkRequestHoldingTime" SG_ 3221225472 GST_DPSS_Byte5 5000;
BA_ "Version" SG_ 3221225472 GST_DPSS_Byte5 "18.03.05";
BA_ "UsrSigPurpose" SG_ 3221225472 GST_DPSS_Byte6 2;
BA_ "GenSigSendType" SG_ 3221225472 GST_DPSS_Byte6 2;
BA_ "UserSigValidity" SG_ 3221225472 GST_DPSS_Byte6 0;
BA_ "GenSigTimeoutTime" SG_ 3221225472 GST_DPSS_Byte6 0;
BA_ "NetworkRequest" SG_ 3221225472 GST_DPSS_Byte6 0;
BA_ "NetworkRequestHoldingTime" SG_ 3221225472 GST_DPSS_Byte6 5000;
BA_ "Version" SG_ 3221225472 GST_DPSS_Byte6 "18.03.05";
BA_ "UsrSigPurpose" SG_ 3221225472 GST_DPSS_Byte7 2;
BA_ "GenSigSendType" SG_ 3221225472 GST_DPSS_Byte7 2;
BA_ "UserSigValidity" SG_ 3221225472 GST_DPSS_Byte7 0;
BA_ "GenSigTimeoutTime" SG_ 3221225472 GST_DPSS_Byte7 0;
BA_ "NetworkRequest" SG_ 3221225472 GST_DPSS_Byte7 0;
BA_ "NetworkRequestHoldingTime" SG_ 3221225472 GST_DPSS_Byte7 5000;
BA_ "Version" SG_ 3221225472 GST_DPSS_Byte7 "18.03.05";
BA_ "Description" SG_ 3221225472 SAS_Crc1Val "The CRC checking process calculates the CRC over the entire data block, including the CRC result.

- CRC Polynomial (0x1021) , Initial Value : 0xFFFF, XOR value : 0x0000

- The mathematical expression to 16 bit CRC polynomial is given here. G(x) = x16 + ";
BA_ "GenSigStartValue" SG_ 3221225472 SAS_Crc1Val 65535;
BA_ "UserSigValidity" SG_ 3221225472 SAS_Crc1Val 3;
BA_ "RoutingFactor" SG_ 3221225472 SAS_Crc1Val 5;
BA_ "Version" SG_ 3221225472 SAS_Crc1Val "17.11.00";
BA_ "Description" SG_ 3221225472 SAS_AlvCnt1Val "For the first transmission request for a data element the counter shall be initialized with 0 and shall be incremented by 1

for every subsequent send request. When the counter reaches the maximum value(0xFF), then it shall restart with ? for the next se";
BA_ "UserSigValidity" SG_ 3221225472 SAS_AlvCnt1Val 3;
BA_ "RoutingFactor" SG_ 3221225472 SAS_AlvCnt1Val 5;
BA_ "Version" SG_ 3221225472 SAS_AlvCnt1Val "17.11.00";
BA_ "Description" SG_ 3221225472 SAS_AnglVal "Information regarding the steering wheel angle.  (PH) = (HEX) * 0.1 (0 <  HEX < 7FFFH) or (PH) = (HEX - 65536) * 0.1 (HEX > 7FFFH)";
BA_ "UserSigValidity" SG_ 3221225472 SAS_AnglVal 3;
BA_ "RoutingFactor" SG_ 3221225472 SAS_AnglVal 5;
BA_ "Version" SG_ 3221225472 SAS_AnglVal "17.11.00";
BA_ "Description" SG_ 3221225472 SAS_SpdVal "Information regarding the steering wheel rotation speed 

(PH) = (HEX) * 4 (0 ≤ HEX < 254)";
BA_ "UserSigValidity" SG_ 3221225472 SAS_SpdVal 3;
BA_ "RoutingFactor" SG_ 3221225472 SAS_SpdVal 5;
BA_ "Version" SG_ 3221225472 SAS_SpdVal "17.11.00";
BA_ "Description" SG_ 3221225472 SAS_IntSta "Information regarding the steering angle sensor’s internal state. If SAS_AnglVal value is O.K., SAS_OK flag is set and otherwise SAS_OK flag is cleared. If steering angle sensor has been calibrated, SAS_CAL flag is set and otherwise cleared.

SF1 - SF5 ";
BA_ "GenSigStartValue" SG_ 3221225472 SAS_IntSta 7;
BA_ "UserSigValidity" SG_ 3221225472 SAS_IntSta 3;
BA_ "RoutingFactor" SG_ 3221225472 SAS_IntSta 5;
BA_ "Version" SG_ 3221225472 SAS_IntSta "17.11.00";
BA_ "Description" SG_ 3221225472 ADAS_CMD_Crc30Val "The CRC checking process calculates the CRC over the entire data block, including the CRC result.

- CRC Polynomial (0x1021) , Initial Value : 0xFFFF, XOR value : 0x0000

- The mathematical expression to 16 bit CRC polynomial is given here. G(x) = x16 + ";
BA_ "GenSigStartValue" SG_ 3221225472 ADAS_CMD_Crc30Val 65535;
BA_ "UserSigValidity" SG_ 3221225472 ADAS_CMD_Crc30Val 3;
BA_ "RoutingFactor" SG_ 3221225472 ADAS_CMD_Crc30Val 5;
BA_ "Version" SG_ 3221225472 ADAS_CMD_Crc30Val "17.11.00";
BA_ "Description" SG_ 3221225472 ADAS_CMD_AlvCnt30Val "For the first transmission request for a data element the counter shall be initialized with 0 and shall be incremented by 1

for every subsequent send request. When the counter reaches the maximum value(0xFF), then it shall restart with ? for the next se";
BA_ "UserSigValidity" SG_ 3221225472 ADAS_CMD_AlvCnt30Val 3;
BA_ "RoutingFactor" SG_ 3221225472 ADAS_CMD_AlvCnt30Val 5;
BA_ "Version" SG_ 3221225472 ADAS_CMD_AlvCnt30Val "17.11.00";
BA_ "UserSigValidity" SG_ 3221225472 LKA_OptUsmSta 3;
BA_ "RoutingFactor" SG_ 3221225472 LKA_OptUsmSta 5;
BA_ "Version" SG_ 3221225472 LKA_OptUsmSta "17.12.02";
BA_ "UserSigValidity" SG_ 3221225472 LKA_RcgSta 3;
BA_ "RoutingFactor" SG_ 3221225472 LKA_RcgSta 5;
BA_ "Version" SG_ 3221225472 LKA_RcgSta "17.12.02";
BA_ "UserSigValidity" SG_ 3221225472 LKA_LHLnWrnSta 3;
BA_ "RoutingFactor" SG_ 3221225472 LKA_LHLnWrnSta 5;
BA_ "Version" SG_ 3221225472 LKA_LHLnWrnSta "17.12.02";
BA_ "UserSigValidity" SG_ 3221225472 LKA_RHLnWrnSta 3;
BA_ "RoutingFactor" SG_ 3221225472 LKA_RHLnWrnSta 5;
BA_ "Version" SG_ 3221225472 LKA_RHLnWrnSta "17.12.02";
BA_ "UserSigValidity" SG_ 3221225472 LKA_HndsoffSnd 3;
BA_ "RoutingFactor" SG_ 3221225472 LKA_HndsoffSnd 5;
BA_ "Version" SG_ 3221225472 LKA_HndsoffSnd "17.12.02";
BA_ "UserSigValidity" SG_ 3221225472 LKA_StrSnd 3;
BA_ "RoutingFactor" SG_ 3221225472 LKA_StrSnd 5;
BA_ "Version" SG_ 3221225472 LKA_StrSnd "17.12.02";
BA_ "UserSigValidity" SG_ 3221225472 LKA_SysIndReq 3;
BA_ "RoutingFactor" SG_ 3221225472 LKA_SysIndReq 5;
BA_ "Version" SG_ 3221225472 LKA_SysIndReq "17.12.02";
BA_ "Description" SG_ 3221225472 LKA_StrTqReqVal "This is the driver torque overlay demand value. A negative value represents a torque that would accelerate the steering wheel in a clockwise direction. This signal is always zero whilst the TOI is inactive.";
BA_ "GenSigStartValue" SG_ 3221225472 LKA_StrTqReqVal 1024;
BA_ "UserSigValidity" SG_ 3221225472 LKA_StrTqReqVal 3;
BA_ "RoutingFactor" SG_ 3221225472 LKA_StrTqReqVal 5;
BA_ "Version" SG_ 3221225472 LKA_StrTqReqVal "17.12.02";
BA_ "Description" SG_ 3221225472 LKA_ActToiSta "This is a flag that is set to 1 when requesting the steering to activate the torque overlay interface (TOI).  This must be done before an attempt is made to request non-zero steering torque overlay.";
BA_ "UserSigValidity" SG_ 3221225472 LKA_ActToiSta 3;
BA_ "RoutingFactor" SG_ 3221225472 LKA_ActToiSta 5;
BA_ "Version" SG_ 3221225472 LKA_ActToiSta "17.12.02";
BA_ "Description" SG_ 3221225472 LKA_ToiFltSta "This fault flag is set when a fault in the LKA system has been detected by the LKA ECU such that LKA can no longer function. CAN failures, internal video ECU failures, hard-wired component (e.g. master switch) failures and other system logic failures are";
BA_ "UserSigValidity" SG_ 3221225472 LKA_ToiFltSta 3;
BA_ "RoutingFactor" SG_ 3221225472 LKA_ToiFltSta 5;
BA_ "Version" SG_ 3221225472 LKA_ToiFltSta "17.12.02";
BA_ "Description" SG_ 3221225472 BCA_Rear_WrnSta "This signal indicates BCA-Rear warning for display and sound.";
BA_ "UserSigValidity" SG_ 3221225472 BCA_Rear_WrnSta 3;
BA_ "RoutingFactor" SG_ 3221225472 BCA_Rear_WrnSta 5;
BA_ "Version" SG_ 3221225472 BCA_Rear_WrnSta "17.11.00";
BA_ "Description" SG_ 3221225472 FCA_LO_WrnSta "This signal indicates FCA-LO warning for display and sound.";
BA_ "UserSigValidity" SG_ 3221225472 FCA_LO_WrnSta 3;
BA_ "RoutingFactor" SG_ 3221225472 FCA_LO_WrnSta 5;
BA_ "Version" SG_ 3221225472 FCA_LO_WrnSta "17.11.00";
BA_ "Description" SG_ 3221225472 FCA_LS_WrnSta "This signal indicates FCA-LS warning for display and sound.";
BA_ "UserSigValidity" SG_ 3221225472 FCA_LS_WrnSta 3;
BA_ "RoutingFactor" SG_ 3221225472 FCA_LS_WrnSta 5;
BA_ "Version" SG_ 3221225472 FCA_LS_WrnSta "17.11.00";
BA_ "Description" SG_ 3221225472 BCAref_FrCmrSta "This signal indicates Front View Camera status for BCA System.";
BA_ "UserSigValidity" SG_ 3221225472 BCAref_FrCmrSta 3;
BA_ "RoutingFactor" SG_ 3221225472 BCAref_FrCmrSta 5;
BA_ "Version" SG_ 3221225472 BCAref_FrCmrSta "18.01.08";
BA_ "Description" SG_ 3221225472 BCA_WrngSta "This signal indicates BCA warning for display  and sound.";
BA_ "UserSigValidity" SG_ 3221225472 BCA_WrngSta 3;
BA_ "RoutingFactor" SG_ 3221225472 BCA_WrngSta 5;
BA_ "Version" SG_ 3221225472 BCA_WrngSta "18.01.07";
BA_ "Description" SG_ 3221225472 LKA_UsmMod "This signal indicates LKA USM Mode";
BA_ "UserSigValidity" SG_ 3221225472 LKA_UsmMod 3;
BA_ "RoutingFactor" SG_ 3221225472 LKA_UsmMod 5;
BA_ "Version" SG_ 3221225472 LKA_UsmMod "18.01.08";
BA_ "Description" SG_ 3221225472 Info_PedtrnDst "Distance of the nearest pedestrian";
BA_ "UserSigValidity" SG_ 3221225472 Info_PedtrnDst 3;
BA_ "RoutingFactor" SG_ 3221225472 Info_PedtrnDst 5;
BA_ "Version" SG_ 3221225472 Info_PedtrnDst "18.01.08";
BA_ "Description" SG_ 3221225472 ACU_APSB_Crc1Val "The CRC checking process calculates the CRC over the entire data block, including the CRC result.

- CRC Polynomial (0x1021) , Initial Value : 0xFFFF, XOR value : 0x0000

- The mathematical expression to 16 bit CRC polynomial is given here. G(x) = x16 + ";
BA_ "GenSigStartValue" SG_ 3221225472 ACU_APSB_Crc1Val 65535;
BA_ "UserSigValidity" SG_ 3221225472 ACU_APSB_Crc1Val 3;
BA_ "RoutingFactor" SG_ 3221225472 ACU_APSB_Crc1Val 5;
BA_ "Version" SG_ 3221225472 ACU_APSB_Crc1Val "18.02.02";
BA_ "Description" SG_ 3221225472 ACU_APSB_AlvCnt1Val "For the first transmission request for a data element the counter shall be initialized with 0 and shall be incremented by 1

for every subsequent send request. When the counter reaches the maximum value(0xFF), then it shall restart with ? for the next se";
BA_ "UserSigValidity" SG_ 3221225472 ACU_APSB_AlvCnt1Val 3;
BA_ "RoutingFactor" SG_ 3221225472 ACU_APSB_AlvCnt1Val 5;
BA_ "Version" SG_ 3221225472 ACU_APSB_AlvCnt1Val "18.02.02";
BA_ "Description" SG_ 3221225472 APSB_ConfTbl "This signal indicates supported signals that are correspond to detection type.

000000B : Not supported, 

xxxxx1B : Rough Road Impact 

xxxx1xB : FCA Impact

xxx1xxB : Minor Front Impact

xx1xxxB : Minor Side Impact

x1xxxxB : Minor Roll Detection

1xxx";
BA_ "UserSigValidity" SG_ 3221225472 APSB_ConfTbl 3;
BA_ "RoutingFactor" SG_ 3221225472 APSB_ConfTbl 5;
BA_ "Version" SG_ 3221225472 APSB_ConfTbl "18.02.03";
BA_ "Description" SG_ 3221225472 APSB_CrashActvSta "This signal indicates status of APSB activation by ACU.";
BA_ "UserSigValidity" SG_ 3221225472 APSB_CrashActvSta 3;
BA_ "RoutingFactor" SG_ 3221225472 APSB_CrashActvSta 5;
BA_ "Version" SG_ 3221225472 APSB_CrashActvSta "18.02.03";
BA_ "Description" SG_ 3221225472 APSB_RRDrvImpt "This signal indicates commends of APSB activation in case of rough road impact.";
BA_ "UserSigValidity" SG_ 3221225472 APSB_RRDrvImpt 3;
BA_ "RoutingFactor" SG_ 3221225472 APSB_RRDrvImpt 5;
BA_ "Version" SG_ 3221225472 APSB_RRDrvImpt "18.02.03";
BA_ "Description" SG_ 3221225472 APSB_FCAFrImpt "This signal indicates commends of APSB activation in case of FCA impact.";
BA_ "UserSigValidity" SG_ 3221225472 APSB_FCAFrImpt 3;
BA_ "RoutingFactor" SG_ 3221225472 APSB_FCAFrImpt 5;
BA_ "Version" SG_ 3221225472 APSB_FCAFrImpt "18.02.03";
BA_ "Description" SG_ 3221225472 APSB_MinFrImpt "This signal indicates commends of APSB activation in case of minor frontal  impact.";
BA_ "UserSigValidity" SG_ 3221225472 APSB_MinFrImpt 3;
BA_ "RoutingFactor" SG_ 3221225472 APSB_MinFrImpt 5;
BA_ "Version" SG_ 3221225472 APSB_MinFrImpt "18.02.03";
BA_ "Description" SG_ 3221225472 APSB_MinSidImpt "This signal indicates commends of APSB activation in case of minor side  impact.";
BA_ "UserSigValidity" SG_ 3221225472 APSB_MinSidImpt 3;
BA_ "RoutingFactor" SG_ 3221225472 APSB_MinSidImpt 5;
BA_ "Version" SG_ 3221225472 APSB_MinSidImpt "18.02.03";
BA_ "Description" SG_ 3221225472 APSB_MinRollDetn "This signal indicates commends of APSB activation in case of minor rollover detection.";
BA_ "UserSigValidity" SG_ 3221225472 APSB_MinRollDetn 3;
BA_ "RoutingFactor" SG_ 3221225472 APSB_MinRollDetn 5;
BA_ "Version" SG_ 3221225472 APSB_MinRollDetn "18.02.03";
BA_ "Description" SG_ 3221225472 APSB_MinRearImpt "This signal indicates commends of APSB activation in case of minor rear impact.";
BA_ "UserSigValidity" SG_ 3221225472 APSB_MinRearImpt 3;
BA_ "RoutingFactor" SG_ 3221225472 APSB_MinRearImpt 5;
BA_ "Version" SG_ 3221225472 APSB_MinRearImpt "18.02.03";
BA_ "UsrSigPurpose" SG_ 3221225472 RRPSU_GST_Byte0 2;
BA_ "GenSigSendType" SG_ 3221225472 RRPSU_GST_Byte0 2;
BA_ "UserSigValidity" SG_ 3221225472 RRPSU_GST_Byte0 0;
BA_ "GenSigTimeoutTime" SG_ 3221225472 RRPSU_GST_Byte0 0;
BA_ "NetworkRequest" SG_ 3221225472 RRPSU_GST_Byte0 0;
BA_ "NetworkRequestHoldingTime" SG_ 3221225472 RRPSU_GST_Byte0 5000;
BA_ "Version" SG_ 3221225472 RRPSU_GST_Byte0 "18.03.05";
BA_ "UsrSigPurpose" SG_ 3221225472 RRPSU_GST_Byte1 2;
BA_ "GenSigSendType" SG_ 3221225472 RRPSU_GST_Byte1 2;
BA_ "UserSigValidity" SG_ 3221225472 RRPSU_GST_Byte1 0;
BA_ "GenSigTimeoutTime" SG_ 3221225472 RRPSU_GST_Byte1 0;
BA_ "NetworkRequest" SG_ 3221225472 RRPSU_GST_Byte1 0;
BA_ "NetworkRequestHoldingTime" SG_ 3221225472 RRPSU_GST_Byte1 5000;
BA_ "Version" SG_ 3221225472 RRPSU_GST_Byte1 "18.03.05";
BA_ "UsrSigPurpose" SG_ 3221225472 RRPSU_GST_Byte2 2;
BA_ "GenSigSendType" SG_ 3221225472 RRPSU_GST_Byte2 2;
BA_ "UserSigValidity" SG_ 3221225472 RRPSU_GST_Byte2 0;
BA_ "GenSigTimeoutTime" SG_ 3221225472 RRPSU_GST_Byte2 0;
BA_ "NetworkRequest" SG_ 3221225472 RRPSU_GST_Byte2 0;
BA_ "NetworkRequestHoldingTime" SG_ 3221225472 RRPSU_GST_Byte2 5000;
BA_ "Version" SG_ 3221225472 RRPSU_GST_Byte2 "18.03.05";
BA_ "UsrSigPurpose" SG_ 3221225472 RRPSU_GST_Byte3 2;
BA_ "GenSigSendType" SG_ 3221225472 RRPSU_GST_Byte3 2;
BA_ "UserSigValidity" SG_ 3221225472 RRPSU_GST_Byte3 0;
BA_ "GenSigTimeoutTime" SG_ 3221225472 RRPSU_GST_Byte3 0;
BA_ "NetworkRequest" SG_ 3221225472 RRPSU_GST_Byte3 0;
BA_ "NetworkRequestHoldingTime" SG_ 3221225472 RRPSU_GST_Byte3 5000;
BA_ "Version" SG_ 3221225472 RRPSU_GST_Byte3 "18.03.05";
BA_ "UsrSigPurpose" SG_ 3221225472 RRPSU_GST_Byte4 2;
BA_ "GenSigSendType" SG_ 3221225472 RRPSU_GST_Byte4 2;
BA_ "UserSigValidity" SG_ 3221225472 RRPSU_GST_Byte4 0;
BA_ "GenSigTimeoutTime" SG_ 3221225472 RRPSU_GST_Byte4 0;
BA_ "NetworkRequest" SG_ 3221225472 RRPSU_GST_Byte4 0;
BA_ "NetworkRequestHoldingTime" SG_ 3221225472 RRPSU_GST_Byte4 5000;
BA_ "Version" SG_ 3221225472 RRPSU_GST_Byte4 "18.03.05";
BA_ "UsrSigPurpose" SG_ 3221225472 RRPSU_GST_Byte5 2;
BA_ "GenSigSendType" SG_ 3221225472 RRPSU_GST_Byte5 2;
BA_ "UserSigValidity" SG_ 3221225472 RRPSU_GST_Byte5 0;
BA_ "GenSigTimeoutTime" SG_ 3221225472 RRPSU_GST_Byte5 0;
BA_ "NetworkRequest" SG_ 3221225472 RRPSU_GST_Byte5 0;
BA_ "NetworkRequestHoldingTime" SG_ 3221225472 RRPSU_GST_Byte5 5000;
BA_ "Version" SG_ 3221225472 RRPSU_GST_Byte5 "18.03.05";
BA_ "UsrSigPurpose" SG_ 3221225472 RRPSU_GST_Byte6 2;
BA_ "GenSigSendType" SG_ 3221225472 RRPSU_GST_Byte6 2;
BA_ "UserSigValidity" SG_ 3221225472 RRPSU_GST_Byte6 0;
BA_ "GenSigTimeoutTime" SG_ 3221225472 RRPSU_GST_Byte6 0;
BA_ "NetworkRequest" SG_ 3221225472 RRPSU_GST_Byte6 0;
BA_ "NetworkRequestHoldingTime" SG_ 3221225472 RRPSU_GST_Byte6 5000;
BA_ "Version" SG_ 3221225472 RRPSU_GST_Byte6 "18.03.05";
BA_ "UsrSigPurpose" SG_ 3221225472 RRPSU_GST_Byte7 2;
BA_ "GenSigSendType" SG_ 3221225472 RRPSU_GST_Byte7 2;
BA_ "UserSigValidity" SG_ 3221225472 RRPSU_GST_Byte7 0;
BA_ "GenSigTimeoutTime" SG_ 3221225472 RRPSU_GST_Byte7 0;
BA_ "NetworkRequest" SG_ 3221225472 RRPSU_GST_Byte7 0;
BA_ "NetworkRequestHoldingTime" SG_ 3221225472 RRPSU_GST_Byte7 5000;
BA_ "Version" SG_ 3221225472 RRPSU_GST_Byte7 "18.03.05";
BA_ "UsrSigPurpose" SG_ 3221225472 RLPSU_GST_Byte0 2;
BA_ "GenSigSendType" SG_ 3221225472 RLPSU_GST_Byte0 2;
BA_ "UserSigValidity" SG_ 3221225472 RLPSU_GST_Byte0 0;
BA_ "GenSigTimeoutTime" SG_ 3221225472 RLPSU_GST_Byte0 0;
BA_ "NetworkRequest" SG_ 3221225472 RLPSU_GST_Byte0 0;
BA_ "NetworkRequestHoldingTime" SG_ 3221225472 RLPSU_GST_Byte0 5000;
BA_ "Version" SG_ 3221225472 RLPSU_GST_Byte0 "18.05.01";
BA_ "UsrSigPurpose" SG_ 3221225472 RLPSU_GST_Byte1 2;
BA_ "GenSigSendType" SG_ 3221225472 RLPSU_GST_Byte1 2;
BA_ "UserSigValidity" SG_ 3221225472 RLPSU_GST_Byte1 0;
BA_ "GenSigTimeoutTime" SG_ 3221225472 RLPSU_GST_Byte1 0;
BA_ "NetworkRequest" SG_ 3221225472 RLPSU_GST_Byte1 0;
BA_ "NetworkRequestHoldingTime" SG_ 3221225472 RLPSU_GST_Byte1 5000;
BA_ "Version" SG_ 3221225472 RLPSU_GST_Byte1 "18.05.01";
BA_ "UsrSigPurpose" SG_ 3221225472 RLPSU_GST_Byte2 2;
BA_ "GenSigSendType" SG_ 3221225472 RLPSU_GST_Byte2 2;
BA_ "UserSigValidity" SG_ 3221225472 RLPSU_GST_Byte2 0;
BA_ "GenSigTimeoutTime" SG_ 3221225472 RLPSU_GST_Byte2 0;
BA_ "NetworkRequest" SG_ 3221225472 RLPSU_GST_Byte2 0;
BA_ "NetworkRequestHoldingTime" SG_ 3221225472 RLPSU_GST_Byte2 5000;
BA_ "Version" SG_ 3221225472 RLPSU_GST_Byte2 "18.05.01";
BA_ "UsrSigPurpose" SG_ 3221225472 RLPSU_GST_Byte3 2;
BA_ "GenSigSendType" SG_ 3221225472 RLPSU_GST_Byte3 2;
BA_ "UserSigValidity" SG_ 3221225472 RLPSU_GST_Byte3 0;
BA_ "GenSigTimeoutTime" SG_ 3221225472 RLPSU_GST_Byte3 0;
BA_ "NetworkRequest" SG_ 3221225472 RLPSU_GST_Byte3 0;
BA_ "NetworkRequestHoldingTime" SG_ 3221225472 RLPSU_GST_Byte3 5000;
BA_ "Version" SG_ 3221225472 RLPSU_GST_Byte3 "18.05.01";
BA_ "UsrSigPurpose" SG_ 3221225472 RLPSU_GST_Byte4 2;
BA_ "GenSigSendType" SG_ 3221225472 RLPSU_GST_Byte4 2;
BA_ "UserSigValidity" SG_ 3221225472 RLPSU_GST_Byte4 0;
BA_ "GenSigTimeoutTime" SG_ 3221225472 RLPSU_GST_Byte4 0;
BA_ "NetworkRequest" SG_ 3221225472 RLPSU_GST_Byte4 0;
BA_ "NetworkRequestHoldingTime" SG_ 3221225472 RLPSU_GST_Byte4 5000;
BA_ "Version" SG_ 3221225472 RLPSU_GST_Byte4 "18.05.01";
BA_ "UsrSigPurpose" SG_ 3221225472 RLPSU_GST_Byte5 2;
BA_ "GenSigSendType" SG_ 3221225472 RLPSU_GST_Byte5 2;
BA_ "UserSigValidity" SG_ 3221225472 RLPSU_GST_Byte5 0;
BA_ "GenSigTimeoutTime" SG_ 3221225472 RLPSU_GST_Byte5 0;
BA_ "NetworkRequest" SG_ 3221225472 RLPSU_GST_Byte5 0;
BA_ "NetworkRequestHoldingTime" SG_ 3221225472 RLPSU_GST_Byte5 5000;
BA_ "Version" SG_ 3221225472 RLPSU_GST_Byte5 "18.05.01";
BA_ "UsrSigPurpose" SG_ 3221225472 RLPSU_GST_Byte6 2;
BA_ "GenSigSendType" SG_ 3221225472 RLPSU_GST_Byte6 2;
BA_ "UserSigValidity" SG_ 3221225472 RLPSU_GST_Byte6 0;
BA_ "GenSigTimeoutTime" SG_ 3221225472 RLPSU_GST_Byte6 0;
BA_ "NetworkRequest" SG_ 3221225472 RLPSU_GST_Byte6 0;
BA_ "NetworkRequestHoldingTime" SG_ 3221225472 RLPSU_GST_Byte6 5000;
BA_ "Version" SG_ 3221225472 RLPSU_GST_Byte6 "18.05.01";
BA_ "UsrSigPurpose" SG_ 3221225472 RLPSU_GST_Byte7 2;
BA_ "GenSigSendType" SG_ 3221225472 RLPSU_GST_Byte7 2;
BA_ "UserSigValidity" SG_ 3221225472 RLPSU_GST_Byte7 0;
BA_ "GenSigTimeoutTime" SG_ 3221225472 RLPSU_GST_Byte7 0;
BA_ "NetworkRequest" SG_ 3221225472 RLPSU_GST_Byte7 0;
BA_ "NetworkRequestHoldingTime" SG_ 3221225472 RLPSU_GST_Byte7 5000;
BA_ "Version" SG_ 3221225472 RLPSU_GST_Byte7 "18.05.01";
BA_ "UsrSigPurpose" SG_ 3221225472 GST_RRPSU_Byte0 2;
BA_ "GenSigSendType" SG_ 3221225472 GST_RRPSU_Byte0 2;
BA_ "UserSigValidity" SG_ 3221225472 GST_RRPSU_Byte0 0;
BA_ "GenSigTimeoutTime" SG_ 3221225472 GST_RRPSU_Byte0 0;
BA_ "NetworkRequest" SG_ 3221225472 GST_RRPSU_Byte0 0;
BA_ "NetworkRequestHoldingTime" SG_ 3221225472 GST_RRPSU_Byte0 5000;
BA_ "Version" SG_ 3221225472 GST_RRPSU_Byte0 "18.03.05";
BA_ "UsrSigPurpose" SG_ 3221225472 GST_RRPSU_Byte1 2;
BA_ "GenSigSendType" SG_ 3221225472 GST_RRPSU_Byte1 2;
BA_ "UserSigValidity" SG_ 3221225472 GST_RRPSU_Byte1 0;
BA_ "GenSigTimeoutTime" SG_ 3221225472 GST_RRPSU_Byte1 0;
BA_ "NetworkRequest" SG_ 3221225472 GST_RRPSU_Byte1 0;
BA_ "NetworkRequestHoldingTime" SG_ 3221225472 GST_RRPSU_Byte1 5000;
BA_ "Version" SG_ 3221225472 GST_RRPSU_Byte1 "18.03.05";
BA_ "UsrSigPurpose" SG_ 3221225472 GST_RRPSU_Byte2 2;
BA_ "GenSigSendType" SG_ 3221225472 GST_RRPSU_Byte2 2;
BA_ "UserSigValidity" SG_ 3221225472 GST_RRPSU_Byte2 0;
BA_ "GenSigTimeoutTime" SG_ 3221225472 GST_RRPSU_Byte2 0;
BA_ "NetworkRequest" SG_ 3221225472 GST_RRPSU_Byte2 0;
BA_ "NetworkRequestHoldingTime" SG_ 3221225472 GST_RRPSU_Byte2 5000;
BA_ "Version" SG_ 3221225472 GST_RRPSU_Byte2 "18.03.05";
BA_ "UsrSigPurpose" SG_ 3221225472 GST_RRPSU_Byte3 2;
BA_ "GenSigSendType" SG_ 3221225472 GST_RRPSU_Byte3 2;
BA_ "UserSigValidity" SG_ 3221225472 GST_RRPSU_Byte3 0;
BA_ "GenSigTimeoutTime" SG_ 3221225472 GST_RRPSU_Byte3 0;
BA_ "NetworkRequest" SG_ 3221225472 GST_RRPSU_Byte3 0;
BA_ "NetworkRequestHoldingTime" SG_ 3221225472 GST_RRPSU_Byte3 5000;
BA_ "Version" SG_ 3221225472 GST_RRPSU_Byte3 "18.03.05";
BA_ "UsrSigPurpose" SG_ 3221225472 GST_RRPSU_Byte4 2;
BA_ "GenSigSendType" SG_ 3221225472 GST_RRPSU_Byte4 2;
BA_ "UserSigValidity" SG_ 3221225472 GST_RRPSU_Byte4 0;
BA_ "GenSigTimeoutTime" SG_ 3221225472 GST_RRPSU_Byte4 0;
BA_ "NetworkRequest" SG_ 3221225472 GST_RRPSU_Byte4 0;
BA_ "NetworkRequestHoldingTime" SG_ 3221225472 GST_RRPSU_Byte4 5000;
BA_ "Version" SG_ 3221225472 GST_RRPSU_Byte4 "18.03.05";
BA_ "UsrSigPurpose" SG_ 3221225472 GST_RRPSU_Byte5 2;
BA_ "GenSigSendType" SG_ 3221225472 GST_RRPSU_Byte5 2;
BA_ "UserSigValidity" SG_ 3221225472 GST_RRPSU_Byte5 0;
BA_ "GenSigTimeoutTime" SG_ 3221225472 GST_RRPSU_Byte5 0;
BA_ "NetworkRequest" SG_ 3221225472 GST_RRPSU_Byte5 0;
BA_ "NetworkRequestHoldingTime" SG_ 3221225472 GST_RRPSU_Byte5 5000;
BA_ "Version" SG_ 3221225472 GST_RRPSU_Byte5 "18.03.05";
BA_ "UsrSigPurpose" SG_ 3221225472 GST_RRPSU_Byte6 2;
BA_ "GenSigSendType" SG_ 3221225472 GST_RRPSU_Byte6 2;
BA_ "UserSigValidity" SG_ 3221225472 GST_RRPSU_Byte6 0;
BA_ "GenSigTimeoutTime" SG_ 3221225472 GST_RRPSU_Byte6 0;
BA_ "NetworkRequest" SG_ 3221225472 GST_RRPSU_Byte6 0;
BA_ "NetworkRequestHoldingTime" SG_ 3221225472 GST_RRPSU_Byte6 5000;
BA_ "Version" SG_ 3221225472 GST_RRPSU_Byte6 "18.03.05";
BA_ "UsrSigPurpose" SG_ 3221225472 GST_RRPSU_Byte7 2;
BA_ "GenSigSendType" SG_ 3221225472 GST_RRPSU_Byte7 2;
BA_ "UserSigValidity" SG_ 3221225472 GST_RRPSU_Byte7 0;
BA_ "GenSigTimeoutTime" SG_ 3221225472 GST_RRPSU_Byte7 0;
BA_ "NetworkRequest" SG_ 3221225472 GST_RRPSU_Byte7 0;
BA_ "NetworkRequestHoldingTime" SG_ 3221225472 GST_RRPSU_Byte7 5000;
BA_ "Version" SG_ 3221225472 GST_RRPSU_Byte7 "18.03.05";
BA_ "UsrSigPurpose" SG_ 3221225472 GST_RLPSU_Byte0 2;
BA_ "GenSigSendType" SG_ 3221225472 GST_RLPSU_Byte0 2;
BA_ "UserSigValidity" SG_ 3221225472 GST_RLPSU_Byte0 0;
BA_ "GenSigTimeoutTime" SG_ 3221225472 GST_RLPSU_Byte0 0;
BA_ "NetworkRequest" SG_ 3221225472 GST_RLPSU_Byte0 0;
BA_ "NetworkRequestHoldingTime" SG_ 3221225472 GST_RLPSU_Byte0 5000;
BA_ "Version" SG_ 3221225472 GST_RLPSU_Byte0 "18.05.01";
BA_ "UsrSigPurpose" SG_ 3221225472 GST_RLPSU_Byte1 2;
BA_ "GenSigSendType" SG_ 3221225472 GST_RLPSU_Byte1 2;
BA_ "UserSigValidity" SG_ 3221225472 GST_RLPSU_Byte1 0;
BA_ "GenSigTimeoutTime" SG_ 3221225472 GST_RLPSU_Byte1 0;
BA_ "NetworkRequest" SG_ 3221225472 GST_RLPSU_Byte1 0;
BA_ "NetworkRequestHoldingTime" SG_ 3221225472 GST_RLPSU_Byte1 5000;
BA_ "Version" SG_ 3221225472 GST_RLPSU_Byte1 "18.05.01";
BA_ "UsrSigPurpose" SG_ 3221225472 GST_RLPSU_Byte2 2;
BA_ "GenSigSendType" SG_ 3221225472 GST_RLPSU_Byte2 2;
BA_ "UserSigValidity" SG_ 3221225472 GST_RLPSU_Byte2 0;
BA_ "GenSigTimeoutTime" SG_ 3221225472 GST_RLPSU_Byte2 0;
BA_ "NetworkRequest" SG_ 3221225472 GST_RLPSU_Byte2 0;
BA_ "NetworkRequestHoldingTime" SG_ 3221225472 GST_RLPSU_Byte2 5000;
BA_ "Version" SG_ 3221225472 GST_RLPSU_Byte2 "18.05.01";
BA_ "UsrSigPurpose" SG_ 3221225472 GST_RLPSU_Byte3 2;
BA_ "GenSigSendType" SG_ 3221225472 GST_RLPSU_Byte3 2;
BA_ "UserSigValidity" SG_ 3221225472 GST_RLPSU_Byte3 0;
BA_ "GenSigTimeoutTime" SG_ 3221225472 GST_RLPSU_Byte3 0;
BA_ "NetworkRequest" SG_ 3221225472 GST_RLPSU_Byte3 0;
BA_ "NetworkRequestHoldingTime" SG_ 3221225472 GST_RLPSU_Byte3 5000;
BA_ "Version" SG_ 3221225472 GST_RLPSU_Byte3 "18.05.01";
BA_ "UsrSigPurpose" SG_ 3221225472 GST_RLPSU_Byte4 2;
BA_ "GenSigSendType" SG_ 3221225472 GST_RLPSU_Byte4 2;
BA_ "UserSigValidity" SG_ 3221225472 GST_RLPSU_Byte4 0;
BA_ "GenSigTimeoutTime" SG_ 3221225472 GST_RLPSU_Byte4 0;
BA_ "NetworkRequest" SG_ 3221225472 GST_RLPSU_Byte4 0;
BA_ "NetworkRequestHoldingTime" SG_ 3221225472 GST_RLPSU_Byte4 5000;
BA_ "Version" SG_ 3221225472 GST_RLPSU_Byte4 "18.05.01";
BA_ "UsrSigPurpose" SG_ 3221225472 GST_RLPSU_Byte5 2;
BA_ "GenSigSendType" SG_ 3221225472 GST_RLPSU_Byte5 2;
BA_ "UserSigValidity" SG_ 3221225472 GST_RLPSU_Byte5 0;
BA_ "GenSigTimeoutTime" SG_ 3221225472 GST_RLPSU_Byte5 0;
BA_ "NetworkRequest" SG_ 3221225472 GST_RLPSU_Byte5 0;
BA_ "NetworkRequestHoldingTime" SG_ 3221225472 GST_RLPSU_Byte5 5000;
BA_ "Version" SG_ 3221225472 GST_RLPSU_Byte5 "18.05.01";
BA_ "UsrSigPurpose" SG_ 3221225472 GST_RLPSU_Byte6 2;
BA_ "GenSigSendType" SG_ 3221225472 GST_RLPSU_Byte6 2;
BA_ "UserSigValidity" SG_ 3221225472 GST_RLPSU_Byte6 0;
BA_ "GenSigTimeoutTime" SG_ 3221225472 GST_RLPSU_Byte6 0;
BA_ "NetworkRequest" SG_ 3221225472 GST_RLPSU_Byte6 0;
BA_ "NetworkRequestHoldingTime" SG_ 3221225472 GST_RLPSU_Byte6 5000;
BA_ "Version" SG_ 3221225472 GST_RLPSU_Byte6 "18.05.01";
BA_ "UsrSigPurpose" SG_ 3221225472 GST_RLPSU_Byte7 2;
BA_ "GenSigSendType" SG_ 3221225472 GST_RLPSU_Byte7 2;
BA_ "UserSigValidity" SG_ 3221225472 GST_RLPSU_Byte7 0;
BA_ "GenSigTimeoutTime" SG_ 3221225472 GST_RLPSU_Byte7 0;
BA_ "NetworkRequest" SG_ 3221225472 GST_RLPSU_Byte7 0;
BA_ "NetworkRequestHoldingTime" SG_ 3221225472 GST_RLPSU_Byte7 5000;
BA_ "Version" SG_ 3221225472 GST_RLPSU_Byte7 "18.05.01";
BA_ "Description" SG_ 3221225472 DATC_Crc1Val "The CRC checking process calculates the CRC over the entire data block, including the CRC result.

- CRC Polynomial (0x1021) , Initial Value : 0xFFFF, XOR value : 0x0000

- The mathematical expression to 16 bit CRC polynomial is given here. G(x) = x16 + ";
BA_ "GenSigStartValue" SG_ 3221225472 DATC_Crc1Val 65535;
BA_ "UserSigValidity" SG_ 3221225472 DATC_Crc1Val 7;
BA_ "GenSigTimeoutTime" SG_ 3221225472 DATC_Crc1Val 1500;
BA_ "RoutingFactor" SG_ 3221225472 DATC_Crc1Val 5;
BA_ "Version" SG_ 3221225472 DATC_Crc1Val "17.12.03";
BA_ "Description" SG_ 3221225472 DATC_AlvCnt1Val "For the first transmission request for a data element the counter shall be initialized with 0 and shall be incremented by 1

for every subsequent send request. When the counter reaches the maximum value(0xFF), then it shall restart with ? for the next se";
BA_ "UserSigValidity" SG_ 3221225472 DATC_AlvCnt1Val 7;
BA_ "GenSigTimeoutTime" SG_ 3221225472 DATC_AlvCnt1Val 1500;
BA_ "RoutingFactor" SG_ 3221225472 DATC_AlvCnt1Val 5;
BA_ "Version" SG_ 3221225472 DATC_AlvCnt1Val "17.12.03";
BA_ "Description" SG_ 3221225472 DATC_PtcRlySta "This signal indicates PTC relay operation condition of gasoline engine. This signal is used for EMS to decide engine RPM up.";
BA_ "UserSigValidity" SG_ 3221225472 DATC_PtcRlySta 7;
BA_ "GenSigTimeoutTime" SG_ 3221225472 DATC_PtcRlySta 1500;
BA_ "RoutingFactor" SG_ 3221225472 DATC_PtcRlySta 5;
BA_ "Version" SG_ 3221225472 DATC_PtcRlySta "17.11.00";
BA_ "Description" SG_ 3221225472 DATC_ManufacturerTyp "This signal FATC_ID identifies FATC Maker.";
BA_ "UserSigValidity" SG_ 3221225472 DATC_ManufacturerTyp 3;
BA_ "GenSigTimeoutTime" SG_ 3221225472 DATC_ManufacturerTyp 1500;
BA_ "RoutingFactor" SG_ 3221225472 DATC_ManufacturerTyp 5;
BA_ "Version" SG_ 3221225472 DATC_ManufacturerTyp "17.11.00";
BA_ "Description" SG_ 3221225472 DATC_AcnCompTyp "Heater Control(FATC/MTC) information generated by HVAC Compressor type.";
BA_ "UserSigValidity" SG_ 3221225472 DATC_AcnCompTyp 3;
BA_ "GenSigTimeoutTime" SG_ 3221225472 DATC_AcnCompTyp 1500;
BA_ "RoutingFactor" SG_ 3221225472 DATC_AcnCompTyp 5;
BA_ "Version" SG_ 3221225472 DATC_AcnCompTyp "17.11.00";
BA_ "Description" SG_ 3221225472 DATC_AcnReq "This signal indicates A/C request switch by FATC

This signal occurs when A/C switch(button) is selected either manually or automatically.

EMS decides the torque compensation value to avoid torque shortage while A/C on";
BA_ "UserSigValidity" SG_ 3221225472 DATC_AcnReq 7;
BA_ "GenSigTimeoutTime" SG_ 3221225472 DATC_AcnReq 1500;
BA_ "RoutingFactor" SG_ 3221225472 DATC_AcnReq 5;
BA_ "Version" SG_ 3221225472 DATC_AcnReq "17.11.00";
BA_ "Description" SG_ 3221225472 DATC_BlwSta "This signal indicates HVAC blower motor operation condition.

The signal is used for EMS to decide PTC on or manage battery level.";
BA_ "UserSigValidity" SG_ 3221225472 DATC_BlwSta 7;
BA_ "GenSigTimeoutTime" SG_ 3221225472 DATC_BlwSta 1500;
BA_ "RoutingFactor" SG_ 3221225472 DATC_BlwSta 5;
BA_ "Version" SG_ 3221225472 DATC_BlwSta "17.11.00";
BA_ "Description" SG_ 3221225472 DATC_BlwMaxSta "This signal indicates that FATC operates HVAC blower by maximum speed.";
BA_ "UserSigValidity" SG_ 3221225472 DATC_BlwMaxSta 7;
BA_ "GenSigTimeoutTime" SG_ 3221225472 DATC_BlwMaxSta 1500;
BA_ "RoutingFactor" SG_ 3221225472 DATC_BlwMaxSta 5;
BA_ "Version" SG_ 3221225472 DATC_BlwMaxSta "17.11.00";
BA_ "Description" SG_ 3221225472 DATC_EngStrtReq "FATC requests Engine Auto Start to EMS by this signal during idle stop.";
BA_ "UserSigValidity" SG_ 3221225472 DATC_EngStrtReq 3;
BA_ "GenSigTimeoutTime" SG_ 3221225472 DATC_EngStrtReq 1500;
BA_ "RoutingFactor" SG_ 3221225472 DATC_EngStrtReq 5;
BA_ "Version" SG_ 3221225472 DATC_EngStrtReq "17.11.00";
BA_ "Description" SG_ 3221225472 DATC_IsgInhbtReq "FATC requests EMS that ISG is prohibited (ISG function is not operating) by this signal.

FATC send the disable signal in the condition, for example HVAC Blower is Max.";
BA_ "UserSigValidity" SG_ 3221225472 DATC_IsgInhbtReq 3;
BA_ "GenSigTimeoutTime" SG_ 3221225472 DATC_IsgInhbtReq 1500;
BA_ "RoutingFactor" SG_ 3221225472 DATC_IsgInhbtReq 5;
BA_ "Version" SG_ 3221225472 DATC_IsgInhbtReq "17.11.00";
BA_ "Description" SG_ 3221225472 DATC_AcnCompOnReq "FATC requests A/C compressor clutch on or off to EMS by this signal

This signal is off to maintain a/c refrigerant flow and air flow smoothly and avoid abnormal a/c compressor torque rising even though A/C request switch on, if the surface temperature o";
BA_ "UserSigValidity" SG_ 3221225472 DATC_AcnCompOnReq 3;
BA_ "GenSigTimeoutTime" SG_ 3221225472 DATC_AcnCompOnReq 1500;
BA_ "RoutingFactor" SG_ 3221225472 DATC_AcnCompOnReq 5;
BA_ "Version" SG_ 3221225472 DATC_AcnCompOnReq "17.11.00";
BA_ "Description" SG_ 3221225472 DATC_EngIdlRpmUpReq "This signal is information of A/C Comp_Load by FATC.";
BA_ "UserSigValidity" SG_ 3221225472 DATC_EngIdlRpmUpReq 3;
BA_ "GenSigTimeoutTime" SG_ 3221225472 DATC_EngIdlRpmUpReq 1500;
BA_ "RoutingFactor" SG_ 3221225472 DATC_EngIdlRpmUpReq 5;
BA_ "Version" SG_ 3221225472 DATC_EngIdlRpmUpReq "17.11.00";
BA_ "Description" SG_ 3221225472 DATC_EcvFltSta "This signal indicates ECV control fault.

The detailed fault state is in the error identifiers of CR_Fatc_TqAcnOut signal";
BA_ "UserSigValidity" SG_ 3221225472 DATC_EcvFltSta 3;
BA_ "GenSigTimeoutTime" SG_ 3221225472 DATC_EcvFltSta 1500;
BA_ "RoutingFactor" SG_ 3221225472 DATC_EcvFltSta 5;
BA_ "Version" SG_ 3221225472 DATC_EcvFltSta "17.11.00";
BA_ "Description" SG_ 3221225472 DATC_CalcAcnCompTqVal "This signal indicates the torque output of A/C compressor calculated by FATC.

EMS decides the torque compensation value or A/C compressor clutch disengagement (off) by receiving of this signal.";
BA_ "UserSigValidity" SG_ 3221225472 DATC_CalcAcnCompTqVal 3;
BA_ "GenSigTimeoutTime" SG_ 3221225472 DATC_CalcAcnCompTqVal 1500;
BA_ "RoutingFactor" SG_ 3221225472 DATC_CalcAcnCompTqVal 5;
BA_ "Version" SG_ 3221225472 DATC_CalcAcnCompTqVal "17.11.00";
BA_ "UsrSigPurpose" SG_ 3221225472 WPC_GST_Byte0 2;
BA_ "GenSigSendType" SG_ 3221225472 WPC_GST_Byte0 2;
BA_ "UserSigValidity" SG_ 3221225472 WPC_GST_Byte0 0;
BA_ "GenSigTimeoutTime" SG_ 3221225472 WPC_GST_Byte0 0;
BA_ "NetworkRequest" SG_ 3221225472 WPC_GST_Byte0 0;
BA_ "NetworkRequestHoldingTime" SG_ 3221225472 WPC_GST_Byte0 5000;
BA_ "Version" SG_ 3221225472 WPC_GST_Byte0 "18.01.09";
BA_ "UsrSigPurpose" SG_ 3221225472 WPC_GST_Byte1 2;
BA_ "GenSigSendType" SG_ 3221225472 WPC_GST_Byte1 2;
BA_ "UserSigValidity" SG_ 3221225472 WPC_GST_Byte1 0;
BA_ "GenSigTimeoutTime" SG_ 3221225472 WPC_GST_Byte1 0;
BA_ "NetworkRequest" SG_ 3221225472 WPC_GST_Byte1 0;
BA_ "NetworkRequestHoldingTime" SG_ 3221225472 WPC_GST_Byte1 5000;
BA_ "Version" SG_ 3221225472 WPC_GST_Byte1 "18.01.09";
BA_ "UsrSigPurpose" SG_ 3221225472 WPC_GST_Byte2 2;
BA_ "GenSigSendType" SG_ 3221225472 WPC_GST_Byte2 2;
BA_ "UserSigValidity" SG_ 3221225472 WPC_GST_Byte2 0;
BA_ "GenSigTimeoutTime" SG_ 3221225472 WPC_GST_Byte2 0;
BA_ "NetworkRequest" SG_ 3221225472 WPC_GST_Byte2 0;
BA_ "NetworkRequestHoldingTime" SG_ 3221225472 WPC_GST_Byte2 5000;
BA_ "Version" SG_ 3221225472 WPC_GST_Byte2 "18.01.09";
BA_ "UsrSigPurpose" SG_ 3221225472 WPC_GST_Byte3 2;
BA_ "GenSigSendType" SG_ 3221225472 WPC_GST_Byte3 2;
BA_ "UserSigValidity" SG_ 3221225472 WPC_GST_Byte3 0;
BA_ "GenSigTimeoutTime" SG_ 3221225472 WPC_GST_Byte3 0;
BA_ "NetworkRequest" SG_ 3221225472 WPC_GST_Byte3 0;
BA_ "NetworkRequestHoldingTime" SG_ 3221225472 WPC_GST_Byte3 5000;
BA_ "Version" SG_ 3221225472 WPC_GST_Byte3 "18.01.09";
BA_ "UsrSigPurpose" SG_ 3221225472 WPC_GST_Byte4 2;
BA_ "GenSigSendType" SG_ 3221225472 WPC_GST_Byte4 2;
BA_ "UserSigValidity" SG_ 3221225472 WPC_GST_Byte4 0;
BA_ "GenSigTimeoutTime" SG_ 3221225472 WPC_GST_Byte4 0;
BA_ "NetworkRequest" SG_ 3221225472 WPC_GST_Byte4 0;
BA_ "NetworkRequestHoldingTime" SG_ 3221225472 WPC_GST_Byte4 5000;
BA_ "Version" SG_ 3221225472 WPC_GST_Byte4 "18.01.09";
BA_ "UsrSigPurpose" SG_ 3221225472 WPC_GST_Byte5 2;
BA_ "GenSigSendType" SG_ 3221225472 WPC_GST_Byte5 2;
BA_ "UserSigValidity" SG_ 3221225472 WPC_GST_Byte5 0;
BA_ "GenSigTimeoutTime" SG_ 3221225472 WPC_GST_Byte5 0;
BA_ "NetworkRequest" SG_ 3221225472 WPC_GST_Byte5 0;
BA_ "NetworkRequestHoldingTime" SG_ 3221225472 WPC_GST_Byte5 5000;
BA_ "Version" SG_ 3221225472 WPC_GST_Byte5 "18.01.09";
BA_ "UsrSigPurpose" SG_ 3221225472 WPC_GST_Byte6 2;
BA_ "GenSigSendType" SG_ 3221225472 WPC_GST_Byte6 2;
BA_ "UserSigValidity" SG_ 3221225472 WPC_GST_Byte6 0;
BA_ "GenSigTimeoutTime" SG_ 3221225472 WPC_GST_Byte6 0;
BA_ "NetworkRequest" SG_ 3221225472 WPC_GST_Byte6 0;
BA_ "NetworkRequestHoldingTime" SG_ 3221225472 WPC_GST_Byte6 5000;
BA_ "Version" SG_ 3221225472 WPC_GST_Byte6 "18.01.09";
BA_ "UsrSigPurpose" SG_ 3221225472 WPC_GST_Byte7 2;
BA_ "GenSigSendType" SG_ 3221225472 WPC_GST_Byte7 2;
BA_ "UserSigValidity" SG_ 3221225472 WPC_GST_Byte7 0;
BA_ "GenSigTimeoutTime" SG_ 3221225472 WPC_GST_Byte7 0;
BA_ "NetworkRequest" SG_ 3221225472 WPC_GST_Byte7 0;
BA_ "NetworkRequestHoldingTime" SG_ 3221225472 WPC_GST_Byte7 5000;
BA_ "Version" SG_ 3221225472 WPC_GST_Byte7 "18.01.09";
BA_ "UsrSigPurpose" SG_ 3221225472 GST_WPC_Byte0 2;
BA_ "GenSigSendType" SG_ 3221225472 GST_WPC_Byte0 2;
BA_ "UserSigValidity" SG_ 3221225472 GST_WPC_Byte0 0;
BA_ "GenSigTimeoutTime" SG_ 3221225472 GST_WPC_Byte0 0;
BA_ "NetworkRequest" SG_ 3221225472 GST_WPC_Byte0 0;
BA_ "NetworkRequestHoldingTime" SG_ 3221225472 GST_WPC_Byte0 5000;
BA_ "Version" SG_ 3221225472 GST_WPC_Byte0 "18.01.09";
BA_ "UsrSigPurpose" SG_ 3221225472 GST_WPC_Byte1 2;
BA_ "GenSigSendType" SG_ 3221225472 GST_WPC_Byte1 2;
BA_ "UserSigValidity" SG_ 3221225472 GST_WPC_Byte1 0;
BA_ "GenSigTimeoutTime" SG_ 3221225472 GST_WPC_Byte1 0;
BA_ "NetworkRequest" SG_ 3221225472 GST_WPC_Byte1 0;
BA_ "NetworkRequestHoldingTime" SG_ 3221225472 GST_WPC_Byte1 5000;
BA_ "Version" SG_ 3221225472 GST_WPC_Byte1 "18.01.09";
BA_ "UsrSigPurpose" SG_ 3221225472 GST_WPC_Byte2 2;
BA_ "GenSigSendType" SG_ 3221225472 GST_WPC_Byte2 2;
BA_ "UserSigValidity" SG_ 3221225472 GST_WPC_Byte2 0;
BA_ "GenSigTimeoutTime" SG_ 3221225472 GST_WPC_Byte2 0;
BA_ "NetworkRequest" SG_ 3221225472 GST_WPC_Byte2 0;
BA_ "NetworkRequestHoldingTime" SG_ 3221225472 GST_WPC_Byte2 5000;
BA_ "Version" SG_ 3221225472 GST_WPC_Byte2 "18.01.09";
BA_ "UsrSigPurpose" SG_ 3221225472 GST_WPC_Byte3 2;
BA_ "GenSigSendType" SG_ 3221225472 GST_WPC_Byte3 2;
BA_ "UserSigValidity" SG_ 3221225472 GST_WPC_Byte3 0;
BA_ "GenSigTimeoutTime" SG_ 3221225472 GST_WPC_Byte3 0;
BA_ "NetworkRequest" SG_ 3221225472 GST_WPC_Byte3 0;
BA_ "NetworkRequestHoldingTime" SG_ 3221225472 GST_WPC_Byte3 5000;
BA_ "Version" SG_ 3221225472 GST_WPC_Byte3 "18.01.09";
BA_ "UsrSigPurpose" SG_ 3221225472 GST_WPC_Byte4 2;
BA_ "GenSigSendType" SG_ 3221225472 GST_WPC_Byte4 2;
BA_ "UserSigValidity" SG_ 3221225472 GST_WPC_Byte4 0;
BA_ "GenSigTimeoutTime" SG_ 3221225472 GST_WPC_Byte4 0;
BA_ "NetworkRequest" SG_ 3221225472 GST_WPC_Byte4 0;
BA_ "NetworkRequestHoldingTime" SG_ 3221225472 GST_WPC_Byte4 5000;
BA_ "Version" SG_ 3221225472 GST_WPC_Byte4 "18.01.09";
BA_ "UsrSigPurpose" SG_ 3221225472 GST_WPC_Byte5 2;
BA_ "GenSigSendType" SG_ 3221225472 GST_WPC_Byte5 2;
BA_ "UserSigValidity" SG_ 3221225472 GST_WPC_Byte5 0;
BA_ "GenSigTimeoutTime" SG_ 3221225472 GST_WPC_Byte5 0;
BA_ "NetworkRequest" SG_ 3221225472 GST_WPC_Byte5 0;
BA_ "NetworkRequestHoldingTime" SG_ 3221225472 GST_WPC_Byte5 5000;
BA_ "Version" SG_ 3221225472 GST_WPC_Byte5 "18.01.09";
BA_ "UsrSigPurpose" SG_ 3221225472 GST_WPC_Byte6 2;
BA_ "GenSigSendType" SG_ 3221225472 GST_WPC_Byte6 2;
BA_ "UserSigValidity" SG_ 3221225472 GST_WPC_Byte6 0;
BA_ "GenSigTimeoutTime" SG_ 3221225472 GST_WPC_Byte6 0;
BA_ "NetworkRequest" SG_ 3221225472 GST_WPC_Byte6 0;
BA_ "NetworkRequestHoldingTime" SG_ 3221225472 GST_WPC_Byte6 5000;
BA_ "Version" SG_ 3221225472 GST_WPC_Byte6 "18.01.09";
BA_ "UsrSigPurpose" SG_ 3221225472 GST_WPC_Byte7 2;
BA_ "GenSigSendType" SG_ 3221225472 GST_WPC_Byte7 2;
BA_ "UserSigValidity" SG_ 3221225472 GST_WPC_Byte7 0;
BA_ "GenSigTimeoutTime" SG_ 3221225472 GST_WPC_Byte7 0;
BA_ "NetworkRequest" SG_ 3221225472 GST_WPC_Byte7 0;
BA_ "NetworkRequestHoldingTime" SG_ 3221225472 GST_WPC_Byte7 5000;
BA_ "Version" SG_ 3221225472 GST_WPC_Byte7 "18.01.09";
BA_ "Description" SG_ 3221225472 DATC_OutTempSnsrVal "Actual temperature of Ambient Sensor via an A/D converter; converted into degrees

centigrade (℃).

This is raw data of ambient sensor; just transferred from Ambient Sensor Voltage.";
BA_ "UserSigValidity" SG_ 3221225472 DATC_OutTempSnsrVal 7;
BA_ "GenSigTimeoutTime" SG_ 3221225472 DATC_OutTempSnsrVal 1500;
BA_ "RoutingFactor" SG_ 3221225472 DATC_OutTempSnsrVal 5;
BA_ "Version" SG_ 3221225472 DATC_OutTempSnsrVal "17.11.00";
BA_ "Description" SG_ 3221225472 DATC_DfgSw "This signal indicates whether FRONT DEF switch is selected or not.";
BA_ "UserSigValidity" SG_ 3221225472 DATC_DfgSw 7;
BA_ "GenSigTimeoutTime" SG_ 3221225472 DATC_DfgSw 1500;
BA_ "RoutingFactor" SG_ 3221225472 DATC_DfgSw 5;
BA_ "Version" SG_ 3221225472 DATC_DfgSw "17.11.00";
BA_ "Description" SG_ 3221225472 ADAS_PRK_Crc1Val "The CRC checking process calculates the CRC over the entire data block, including the CRC result.

- CRC Polynomial (0x1021) , Initial Value : 0xFFFF, XOR value : 0x0000

- The mathematical expression to 16 bit CRC polynomial is given here. G(x) = x16 + ";
BA_ "GenSigStartValue" SG_ 3221225472 ADAS_PRK_Crc1Val 65535;
BA_ "UserSigValidity" SG_ 3221225472 ADAS_PRK_Crc1Val 3;
BA_ "GenSigTimeoutTime" SG_ 3221225472 ADAS_PRK_Crc1Val 1500;
BA_ "RoutingFactor" SG_ 3221225472 ADAS_PRK_Crc1Val 5;
BA_ "Version" SG_ 3221225472 ADAS_PRK_Crc1Val "17.12.03";
BA_ "Description" SG_ 3221225472 ADAS_PRK_AlvCnt1Val "For the first transmission request for a data element the counter shall be initialized with 0 and shall be incremented by 1

for every subsequent send request. When the counter reaches the maximum value(0xFF), then it shall restart with ? for the next se";
BA_ "UserSigValidity" SG_ 3221225472 ADAS_PRK_AlvCnt1Val 3;
BA_ "GenSigTimeoutTime" SG_ 3221225472 ADAS_PRK_AlvCnt1Val 1500;
BA_ "RoutingFactor" SG_ 3221225472 ADAS_PRK_AlvCnt1Val 5;
BA_ "Version" SG_ 3221225472 ADAS_PRK_AlvCnt1Val "17.12.03";
BA_ "Description" SG_ 3221225472 PCA_SysSta "PCA System status";
BA_ "UserSigValidity" SG_ 3221225472 PCA_SysSta 3;
BA_ "GenSigTimeoutTime" SG_ 3221225472 PCA_SysSta 1500;
BA_ "RoutingFactor" SG_ 3221225472 PCA_SysSta 5;
BA_ "Version" SG_ 3221225472 PCA_SysSta "17.12.00";
BA_ "Description" SG_ 3221225472 PCA_EquipSta "PCA Failure status";
BA_ "UserSigValidity" SG_ 3221225472 PCA_EquipSta 3;
BA_ "GenSigTimeoutTime" SG_ 3221225472 PCA_EquipSta 1500;
BA_ "RoutingFactor" SG_ 3221225472 PCA_EquipSta 5;
BA_ "Version" SG_ 3221225472 PCA_EquipSta "17.12.00";
BA_ "Description" SG_ 3221225472 PCA_WrngLvlSta "PCA Warning level status";
BA_ "UserSigValidity" SG_ 3221225472 PCA_WrngLvlSta 3;
BA_ "GenSigTimeoutTime" SG_ 3221225472 PCA_WrngLvlSta 1500;
BA_ "RoutingFactor" SG_ 3221225472 PCA_WrngLvlSta 5;
BA_ "Version" SG_ 3221225472 PCA_WrngLvlSta "17.12.00";
BA_ "Description" SG_ 3221225472 PCA_WrngMsgSta "Warning message status";
BA_ "UserSigValidity" SG_ 3221225472 PCA_WrngMsgSta 3;
BA_ "GenSigTimeoutTime" SG_ 3221225472 PCA_WrngMsgSta 1500;
BA_ "RoutingFactor" SG_ 3221225472 PCA_WrngMsgSta 5;
BA_ "Version" SG_ 3221225472 PCA_WrngMsgSta "17.12.00";
BA_ "Description" SG_ 3221225472 PCA_WrngSndCtrSta "Warning sound center status";
BA_ "UserSigValidity" SG_ 3221225472 PCA_WrngSndCtrSta 3;
BA_ "GenSigTimeoutTime" SG_ 3221225472 PCA_WrngSndCtrSta 1500;
BA_ "RoutingFactor" SG_ 3221225472 PCA_WrngSndCtrSta 5;
BA_ "Version" SG_ 3221225472 PCA_WrngSndCtrSta "17.12.00";
BA_ "Description" SG_ 3221225472 PCA_WrngSndLftSta "Warning sound left status";
BA_ "UserSigValidity" SG_ 3221225472 PCA_WrngSndLftSta 3;
BA_ "GenSigTimeoutTime" SG_ 3221225472 PCA_WrngSndLftSta 1500;
BA_ "RoutingFactor" SG_ 3221225472 PCA_WrngSndLftSta 5;
BA_ "Version" SG_ 3221225472 PCA_WrngSndLftSta "17.12.00";
BA_ "Description" SG_ 3221225472 PCA_WrngSndRtSta "Warning sound right status";
BA_ "UserSigValidity" SG_ 3221225472 PCA_WrngSndRtSta 3;
BA_ "GenSigTimeoutTime" SG_ 3221225472 PCA_WrngSndRtSta 1500;
BA_ "RoutingFactor" SG_ 3221225472 PCA_WrngSndRtSta 5;
BA_ "Version" SG_ 3221225472 PCA_WrngSndRtSta "17.12.00";
BA_ "Description" SG_ 3221225472 PCA_BrkReq "Brake request";
BA_ "UserSigValidity" SG_ 3221225472 PCA_BrkReq 3;
BA_ "GenSigTimeoutTime" SG_ 3221225472 PCA_BrkReq 1500;
BA_ "RoutingFactor" SG_ 3221225472 PCA_BrkReq 5;
BA_ "Version" SG_ 3221225472 PCA_BrkReq "17.12.00";
BA_ "Description" SG_ 3221225472 PCA_DclTrgtVal "Deceleration target value";
BA_ "UserSigValidity" SG_ 3221225472 PCA_DclTrgtVal 3;
BA_ "GenSigTimeoutTime" SG_ 3221225472 PCA_DclTrgtVal 1500;
BA_ "RoutingFactor" SG_ 3221225472 PCA_DclTrgtVal 5;
BA_ "Version" SG_ 3221225472 PCA_DclTrgtVal "17.12.00";
BA_ "Description" SG_ 3221225472 PCA_DgrSta "Warning timing status";
BA_ "UserSigValidity" SG_ 3221225472 PCA_DgrSta 3;
BA_ "GenSigTimeoutTime" SG_ 3221225472 PCA_DgrSta 1500;
BA_ "RoutingFactor" SG_ 3221225472 PCA_DgrSta 5;
BA_ "Version" SG_ 3221225472 PCA_DgrSta "17.12.03";
BA_ "UsrSigPurpose" SG_ 3221225472 RRHVU_GST_Byte0 2;
BA_ "GenSigSendType" SG_ 3221225472 RRHVU_GST_Byte0 2;
BA_ "UserSigValidity" SG_ 3221225472 RRHVU_GST_Byte0 0;
BA_ "GenSigTimeoutTime" SG_ 3221225472 RRHVU_GST_Byte0 0;
BA_ "NetworkRequest" SG_ 3221225472 RRHVU_GST_Byte0 0;
BA_ "NetworkRequestHoldingTime" SG_ 3221225472 RRHVU_GST_Byte0 5000;
BA_ "Version" SG_ 3221225472 RRHVU_GST_Byte0 "18.03.03";
BA_ "UsrSigPurpose" SG_ 3221225472 RRHVU_GST_Byte1 2;
BA_ "GenSigSendType" SG_ 3221225472 RRHVU_GST_Byte1 2;
BA_ "UserSigValidity" SG_ 3221225472 RRHVU_GST_Byte1 0;
BA_ "GenSigTimeoutTime" SG_ 3221225472 RRHVU_GST_Byte1 0;
BA_ "NetworkRequest" SG_ 3221225472 RRHVU_GST_Byte1 0;
BA_ "NetworkRequestHoldingTime" SG_ 3221225472 RRHVU_GST_Byte1 5000;
BA_ "Version" SG_ 3221225472 RRHVU_GST_Byte1 "18.03.03";
BA_ "UsrSigPurpose" SG_ 3221225472 RRHVU_GST_Byte2 2;
BA_ "GenSigSendType" SG_ 3221225472 RRHVU_GST_Byte2 2;
BA_ "UserSigValidity" SG_ 3221225472 RRHVU_GST_Byte2 0;
BA_ "GenSigTimeoutTime" SG_ 3221225472 RRHVU_GST_Byte2 0;
BA_ "NetworkRequest" SG_ 3221225472 RRHVU_GST_Byte2 0;
BA_ "NetworkRequestHoldingTime" SG_ 3221225472 RRHVU_GST_Byte2 5000;
BA_ "Version" SG_ 3221225472 RRHVU_GST_Byte2 "18.03.03";
BA_ "UsrSigPurpose" SG_ 3221225472 RRHVU_GST_Byte3 2;
BA_ "GenSigSendType" SG_ 3221225472 RRHVU_GST_Byte3 2;
BA_ "UserSigValidity" SG_ 3221225472 RRHVU_GST_Byte3 0;
BA_ "GenSigTimeoutTime" SG_ 3221225472 RRHVU_GST_Byte3 0;
BA_ "NetworkRequest" SG_ 3221225472 RRHVU_GST_Byte3 0;
BA_ "NetworkRequestHoldingTime" SG_ 3221225472 RRHVU_GST_Byte3 5000;
BA_ "Version" SG_ 3221225472 RRHVU_GST_Byte3 "18.03.03";
BA_ "UsrSigPurpose" SG_ 3221225472 RRHVU_GST_Byte4 2;
BA_ "GenSigSendType" SG_ 3221225472 RRHVU_GST_Byte4 2;
BA_ "UserSigValidity" SG_ 3221225472 RRHVU_GST_Byte4 0;
BA_ "GenSigTimeoutTime" SG_ 3221225472 RRHVU_GST_Byte4 0;
BA_ "NetworkRequest" SG_ 3221225472 RRHVU_GST_Byte4 0;
BA_ "NetworkRequestHoldingTime" SG_ 3221225472 RRHVU_GST_Byte4 5000;
BA_ "Version" SG_ 3221225472 RRHVU_GST_Byte4 "18.03.03";
BA_ "UsrSigPurpose" SG_ 3221225472 RRHVU_GST_Byte5 2;
BA_ "GenSigSendType" SG_ 3221225472 RRHVU_GST_Byte5 2;
BA_ "UserSigValidity" SG_ 3221225472 RRHVU_GST_Byte5 0;
BA_ "GenSigTimeoutTime" SG_ 3221225472 RRHVU_GST_Byte5 0;
BA_ "NetworkRequest" SG_ 3221225472 RRHVU_GST_Byte5 0;
BA_ "NetworkRequestHoldingTime" SG_ 3221225472 RRHVU_GST_Byte5 5000;
BA_ "Version" SG_ 3221225472 RRHVU_GST_Byte5 "18.03.03";
BA_ "UsrSigPurpose" SG_ 3221225472 RRHVU_GST_Byte6 2;
BA_ "GenSigSendType" SG_ 3221225472 RRHVU_GST_Byte6 2;
BA_ "UserSigValidity" SG_ 3221225472 RRHVU_GST_Byte6 0;
BA_ "GenSigTimeoutTime" SG_ 3221225472 RRHVU_GST_Byte6 0;
BA_ "NetworkRequest" SG_ 3221225472 RRHVU_GST_Byte6 0;
BA_ "NetworkRequestHoldingTime" SG_ 3221225472 RRHVU_GST_Byte6 5000;
BA_ "Version" SG_ 3221225472 RRHVU_GST_Byte6 "18.03.03";
BA_ "UsrSigPurpose" SG_ 3221225472 RRHVU_GST_Byte7 2;
BA_ "GenSigSendType" SG_ 3221225472 RRHVU_GST_Byte7 2;
BA_ "UserSigValidity" SG_ 3221225472 RRHVU_GST_Byte7 0;
BA_ "GenSigTimeoutTime" SG_ 3221225472 RRHVU_GST_Byte7 0;
BA_ "NetworkRequest" SG_ 3221225472 RRHVU_GST_Byte7 0;
BA_ "NetworkRequestHoldingTime" SG_ 3221225472 RRHVU_GST_Byte7 5000;
BA_ "Version" SG_ 3221225472 RRHVU_GST_Byte7 "18.03.03";
BA_ "UsrSigPurpose" SG_ 3221225472 MLM_GST_Byte0 2;
BA_ "GenSigSendType" SG_ 3221225472 MLM_GST_Byte0 2;
BA_ "UserSigValidity" SG_ 3221225472 MLM_GST_Byte0 0;
BA_ "GenSigTimeoutTime" SG_ 3221225472 MLM_GST_Byte0 0;
BA_ "NetworkRequest" SG_ 3221225472 MLM_GST_Byte0 0;
BA_ "NetworkRequestHoldingTime" SG_ 3221225472 MLM_GST_Byte0 5000;
BA_ "Version" SG_ 3221225472 MLM_GST_Byte0 "18.01.09";
BA_ "UsrSigPurpose" SG_ 3221225472 MLM_GST_Byte1 2;
BA_ "GenSigSendType" SG_ 3221225472 MLM_GST_Byte1 2;
BA_ "UserSigValidity" SG_ 3221225472 MLM_GST_Byte1 0;
BA_ "GenSigTimeoutTime" SG_ 3221225472 MLM_GST_Byte1 0;
BA_ "NetworkRequest" SG_ 3221225472 MLM_GST_Byte1 0;
BA_ "NetworkRequestHoldingTime" SG_ 3221225472 MLM_GST_Byte1 5000;
BA_ "Version" SG_ 3221225472 MLM_GST_Byte1 "18.01.09";
BA_ "UsrSigPurpose" SG_ 3221225472 MLM_GST_Byte2 2;
BA_ "GenSigSendType" SG_ 3221225472 MLM_GST_Byte2 2;
BA_ "UserSigValidity" SG_ 3221225472 MLM_GST_Byte2 0;
BA_ "GenSigTimeoutTime" SG_ 3221225472 MLM_GST_Byte2 0;
BA_ "NetworkRequest" SG_ 3221225472 MLM_GST_Byte2 0;
BA_ "NetworkRequestHoldingTime" SG_ 3221225472 MLM_GST_Byte2 5000;
BA_ "Version" SG_ 3221225472 MLM_GST_Byte2 "18.01.09";
BA_ "UsrSigPurpose" SG_ 3221225472 MLM_GST_Byte3 2;
BA_ "GenSigSendType" SG_ 3221225472 MLM_GST_Byte3 2;
BA_ "UserSigValidity" SG_ 3221225472 MLM_GST_Byte3 0;
BA_ "GenSigTimeoutTime" SG_ 3221225472 MLM_GST_Byte3 0;
BA_ "NetworkRequest" SG_ 3221225472 MLM_GST_Byte3 0;
BA_ "NetworkRequestHoldingTime" SG_ 3221225472 MLM_GST_Byte3 5000;
BA_ "Version" SG_ 3221225472 MLM_GST_Byte3 "18.01.09";
BA_ "UsrSigPurpose" SG_ 3221225472 MLM_GST_Byte4 2;
BA_ "GenSigSendType" SG_ 3221225472 MLM_GST_Byte4 2;
BA_ "UserSigValidity" SG_ 3221225472 MLM_GST_Byte4 0;
BA_ "GenSigTimeoutTime" SG_ 3221225472 MLM_GST_Byte4 0;
BA_ "NetworkRequest" SG_ 3221225472 MLM_GST_Byte4 0;
BA_ "NetworkRequestHoldingTime" SG_ 3221225472 MLM_GST_Byte4 5000;
BA_ "Version" SG_ 3221225472 MLM_GST_Byte4 "18.01.09";
BA_ "UsrSigPurpose" SG_ 3221225472 MLM_GST_Byte5 2;
BA_ "GenSigSendType" SG_ 3221225472 MLM_GST_Byte5 2;
BA_ "UserSigValidity" SG_ 3221225472 MLM_GST_Byte5 0;
BA_ "GenSigTimeoutTime" SG_ 3221225472 MLM_GST_Byte5 0;
BA_ "NetworkRequest" SG_ 3221225472 MLM_GST_Byte5 0;
BA_ "NetworkRequestHoldingTime" SG_ 3221225472 MLM_GST_Byte5 5000;
BA_ "Version" SG_ 3221225472 MLM_GST_Byte5 "18.01.09";
BA_ "UsrSigPurpose" SG_ 3221225472 MLM_GST_Byte6 2;
BA_ "GenSigSendType" SG_ 3221225472 MLM_GST_Byte6 2;
BA_ "UserSigValidity" SG_ 3221225472 MLM_GST_Byte6 0;
BA_ "GenSigTimeoutTime" SG_ 3221225472 MLM_GST_Byte6 0;
BA_ "NetworkRequest" SG_ 3221225472 MLM_GST_Byte6 0;
BA_ "NetworkRequestHoldingTime" SG_ 3221225472 MLM_GST_Byte6 5000;
BA_ "Version" SG_ 3221225472 MLM_GST_Byte6 "18.01.09";
BA_ "UsrSigPurpose" SG_ 3221225472 MLM_GST_Byte7 2;
BA_ "GenSigSendType" SG_ 3221225472 MLM_GST_Byte7 2;
BA_ "UserSigValidity" SG_ 3221225472 MLM_GST_Byte7 0;
BA_ "GenSigTimeoutTime" SG_ 3221225472 MLM_GST_Byte7 0;
BA_ "NetworkRequest" SG_ 3221225472 MLM_GST_Byte7 0;
BA_ "NetworkRequestHoldingTime" SG_ 3221225472 MLM_GST_Byte7 5000;
BA_ "Version" SG_ 3221225472 MLM_GST_Byte7 "18.01.09";
BA_ "Description" SG_ 3221225472 ADAS_CMD_Crc10Val "The CRC checking process calculates the CRC over the entire data block, including the CRC result.

- CRC Polynomial (0x1021) , Initial Value : 0xFFFF, XOR value : 0x0000

- The mathematical expression to 16 bit CRC polynomial is given here. G(x) = x16 + ";
BA_ "GenSigStartValue" SG_ 3221225472 ADAS_CMD_Crc10Val 65535;
BA_ "UserSigValidity" SG_ 3221225472 ADAS_CMD_Crc10Val 3;
BA_ "GenSigTimeoutTime" SG_ 3221225472 ADAS_CMD_Crc10Val 1500;
BA_ "RoutingFactor" SG_ 3221225472 ADAS_CMD_Crc10Val 5;
BA_ "Version" SG_ 3221225472 ADAS_CMD_Crc10Val "17.12.00";
BA_ "Description" SG_ 3221225472 ADAS_CMD_AlvCnt10Val "For the first transmission request for a data element the counter shall be initialized with 0 and shall be incremented by 1

for every subsequent send request. When the counter reaches the maximum value(0xFF), then it shall restart with ? for the next se";
BA_ "UserSigValidity" SG_ 3221225472 ADAS_CMD_AlvCnt10Val 3;
BA_ "GenSigTimeoutTime" SG_ 3221225472 ADAS_CMD_AlvCnt10Val 1500;
BA_ "RoutingFactor" SG_ 3221225472 ADAS_CMD_AlvCnt10Val 5;
BA_ "Version" SG_ 3221225472 ADAS_CMD_AlvCnt10Val "17.12.00";
BA_ "Description" SG_ 3221225472 FCA_OnOffEquipSta "This signal describes the FCA Function.

- 시스템 장착 여부 및 시스템 on/off 정보";
BA_ "UserSigValidity" SG_ 3221225472 FCA_OnOffEquipSta 3;
BA_ "GenSigTimeoutTime" SG_ 3221225472 FCA_OnOffEquipSta 1500;
BA_ "RoutingFactor" SG_ 3221225472 FCA_OnOffEquipSta 5;
BA_ "Version" SG_ 3221225472 FCA_OnOffEquipSta "17.12.00";
BA_ "Description" SG_ 3221225472 FCA_SysFlrSta "This signal describes the failure information of FCA Function.



- 시스템 정상 또는 카메라/레이더/시스템 고장상태 정보";
BA_ "UserSigValidity" SG_ 3221225472 FCA_SysFlrSta 3;
BA_ "GenSigTimeoutTime" SG_ 3221225472 FCA_SysFlrSta 1500;
BA_ "RoutingFactor" SG_ 3221225472 FCA_SysFlrSta 5;
BA_ "Version" SG_ 3221225472 FCA_SysFlrSta "17.12.00";
BA_ "Description" SG_ 3221225472 FCA_WrngLvlSta "Request CLU to activate the corresponding warning device(s) according to the FCA warning level.

- FCA 1차/2차/3차 작동 상태 표시용 정보신호";
BA_ "UserSigValidity" SG_ 3221225472 FCA_WrngLvlSta 3;
BA_ "GenSigTimeoutTime" SG_ 3221225472 FCA_WrngLvlSta 1500;
BA_ "RoutingFactor" SG_ 3221225472 FCA_WrngLvlSta 5;
BA_ "Version" SG_ 3221225472 FCA_WrngLvlSta "17.12.00";
BA_ "Description" SG_ 3221225472 FCA_VehStpReq "A control request flag for vehicle stop. FCA expects vehicle to be controlled to a complete stop and hold its state by ESC.



- FCA 제동상황 종료후 정차 상태 유지를 위한 신호";
BA_ "UserSigValidity" SG_ 3221225472 FCA_VehStpReq 3;
BA_ "GenSigTimeoutTime" SG_ 3221225472 FCA_VehStpReq 1500;
BA_ "RoutingFactor" SG_ 3221225472 FCA_VehStpReq 5;
BA_ "Version" SG_ 3221225472 FCA_VehStpReq "17.12.00";
BA_ "Description" SG_ 3221225472 FCA_StbltActvReq "Depending on the driving situation, FCA tells PSB to release(no alert), retract or pull the seat belt for occupant protection or warning.

- FCA 제동상황시 시트벨트 작동을 위한 정보 신호";
BA_ "UserSigValidity" SG_ 3221225472 FCA_StbltActvReq 3;
BA_ "GenSigTimeoutTime" SG_ 3221225472 FCA_StbltActvReq 1500;
BA_ "RoutingFactor" SG_ 3221225472 FCA_StbltActvReq 5;
BA_ "Version" SG_ 3221225472 FCA_StbltActvReq "17.12.00";
BA_ "Description" SG_ 3221225472 FCA_HydrlcBstAsstReq "Depending on the driving situation, FCA tells ESC to use lowered HBA (Hydraulic Boost Assist) threshold to sensitize the HBA entrance. 

The boost assist function is more easily activated than under normal driving condition.

- FCA 제동상황시 HBA 작동을 ";
BA_ "UserSigValidity" SG_ 3221225472 FCA_HydrlcBstAsstReq 3;
BA_ "GenSigTimeoutTime" SG_ 3221225472 FCA_HydrlcBstAsstReq 1500;
BA_ "RoutingFactor" SG_ 3221225472 FCA_HydrlcBstAsstReq 5;
BA_ "Version" SG_ 3221225472 FCA_HydrlcBstAsstReq "17.12.00";
BA_ "Description" SG_ 3221225472 FCA_DclReqVal "Depending on the driving situation, FCA gives ESC the deceleration command. ESC maintains the deceleration.

- FCA 제동을 위한 요구 감속도 값";
BA_ "UserSigValidity" SG_ 3221225472 FCA_DclReqVal 3;
BA_ "GenSigTimeoutTime" SG_ 3221225472 FCA_DclReqVal 1500;
BA_ "RoutingFactor" SG_ 3221225472 FCA_DclReqVal 5;
BA_ "Version" SG_ 3221225472 FCA_DclReqVal "17.12.00";
BA_ "Description" SG_ 3221225472 FCA_PrefillActvReq "A control requeset flag for FCA first warning. (Audible Warning)

- FCA 1차 제동상황 요청신호";
BA_ "UserSigValidity" SG_ 3221225472 FCA_PrefillActvReq 3;
BA_ "GenSigTimeoutTime" SG_ 3221225472 FCA_PrefillActvReq 1500;
BA_ "RoutingFactor" SG_ 3221225472 FCA_PrefillActvReq 5;
BA_ "Version" SG_ 3221225472 FCA_PrefillActvReq "17.12.00";
BA_ "Description" SG_ 3221225472 FCA_PartialActvReq "A control requeset flag for FCA second warning. (Partial braking)

- FCA 2차 제동상황 요청신호";
BA_ "UserSigValidity" SG_ 3221225472 FCA_PartialActvReq 3;
BA_ "GenSigTimeoutTime" SG_ 3221225472 FCA_PartialActvReq 1500;
BA_ "RoutingFactor" SG_ 3221225472 FCA_PartialActvReq 5;
BA_ "Version" SG_ 3221225472 FCA_PartialActvReq "17.11.00";
VAL_ 3221225472 ENG_AirconPrsrSnsrVal 255 "Error indicator" ;
VAL_ 3221225472 ENG_CadModSta 0 "CDA OFF (Solenoid Valve OFF)" 1 "Preparation for CDA operation" 2 "CDA ON (Solenoid Valve ON)" 3 "Reserved" 4 "Reserved" 5 "Reserved" 6 "Reserved" 7 "Error indicator" ;
VAL_ 3221225472 ENG_IsgSta 0 "ISG is not operating Normal engine operating without ISG" 1 "Idle stop is activated Idle is stopped by ECU during driving" 2 "Automatically started by ECU Engine is automatically started by ECU regardless driver’s volition during idle stop because the condition that ISG function to be prohibited is satisfied, for example SOC is too low." 3 "ISG is prohibited Driver prohibits to activate ISG in order to avoid start lag when he met traffic jam for example." 4 "Fault  existing in ISG. Idle stop is prohibited and engine started automatically if it is idle stop condition." 5 "Idle stop is inhibited by system automatically for safety and  convenient condition related with battery SOC, brake vacuum pressure etc. ISG function check for EOL." 6 "Auto start is deactivated system automatically to keep safety, Such as door open, hood open and seat belt unlock." 7 "If driver shift gear N to D range without braking to make auto starting. (Economy ISG Only)" ;
VAL_ 3221225472 ENG_OilLvlSta 0 "OIL LEVEL LAMP Off" 1 "OIL LEVEL LAMP On" 2 "Not used" 3 "Error indicator" ;
VAL_ 3221225472 ODS_OccClassSta 1 "Class1" 2 "Class2" 4 "Indeterminate" ;
VAL_ 3221225472 FL_SHVU_SeatOptSta 0 "Init" 1 "Heater only 2step" 2 "Heater only 3step" 3 "Vent only 2step" 4 "Vent only 3step" 5 "Heater and Vent 2step" 6 "Heater and Vent 3step" 7 "Invalid" ;
VAL_ 3221225472 FL_SHVU_SeatHtOperSta 0 "Init" 1 "Unused" 2 "Heater & Vent OFF" 3 "Vent Low" 4 "Vent Mid" 5 "Vent High" 6 "Heater Low" 7 "Heater Mid" 8 "Heater High" 9 "Unused" 10 "Unused" 11 "Unused" 12 "Unused" 13 "Unused" 14 "Unused" 15 "Invalid" ;
VAL_ 3221225472 FL_SHVU_HtSwHiIndSta 0 "Off(Initial Value)" 1 "On" 2 "Not Used" 3 "Error Indicator" ;
VAL_ 3221225472 FL_SHVU_HtSwMidIndSta 0 "Off(Initial Value)" 1 "On" 2 "Not Used" 3 "Error Indicator" ;
VAL_ 3221225472 FL_SHVU_HtSwLowIndSta 0 "Off(Initial Value)" 1 "On" 2 "Not Used" 3 "Error Indicator" ;
VAL_ 3221225472 FL_SHVU_VntSwHiIndSta 0 "Off(Initial Value)" 1 "On" 2 "Not Used" 3 "Error Indicator" ;
VAL_ 3221225472 FL_SHVU_VntSwMidIndSta 0 "Off(Initial Value)" 1 "On" 2 "Not Used" 3 "Error Indicator" ;
VAL_ 3221225472 FL_SHVU_VntSwLowIndSta 0 "Off(Initial Value)" 1 "On" 2 "Not Used" 3 "Error Indicator" ;
VAL_ 3221225472 C_HazardFromIBOX 0 "Off" 1 "On (Remote Hazard On)" ;
VAL_ 3221225472 C_PanicFromIBOX 0 "Off" 1 "On (Remote Horn and Hazard On)" ;
VAL_ 3221225472 C_CtrlDrUnlockRlyIBOX 0 "0ff" 1 "On (Remote Unlock Command)" ;
VAL_ 3221225472 C_CtrlDrLockRlyIBOX 0 "Off (default)" 1 "On (remote Lock Command)" ;
VAL_ 3221225472 C_TeleHeatingCmdIBOX 0 "Off (default)" 1 "On(Remote Heating On)" 2 "Reserved" 3 "Invalid" ;
VAL_ 3221225472 C_TeleStrgWhlHeatingCmdIBOX 0 "Off (default)" 1 "On(Remote Heating On)" 2 "Reserved" 3 "Invalid" ;
VAL_ 3221225472 C_TeleDefoggerHeatingCmdIBOX 0 "Off (default)" 1 "On(Remote Heating On)" 2 "Reserved" 3 "Invalid" ;
VAL_ 3221225472 C_TeleAstSeatOpCmdIBOX 0 "Init" 1 "Unused" 2 "Seat Heat&Vent OFF" 3 "Seat_Vent_Low" 4 "Seat_Vent_Mid" 5 "Seat_Vent_High" 6 "Seat_Heat_Low" 7 "Seat_Heat_Mid" 8 "Seat_Heat_High" 9 "Unused" 10 "Unused" 11 "Unused" 12 "Unused" 13 "Unused" 14 "Unused" 15 "Invalid" ;
VAL_ 3221225472 C_TeleDrvSeatOpCmdIBOX 0 "Init" 1 "Unused" 2 "Seat Heat&Vent OFF" 3 "Seat_Vent_Low" 4 "Seat_Vent_Mid" 5 "Seat_Vent_High" 6 "Seat_Heat_Low" 7 "Seat_Heat_Mid" 8 "Seat_Heat_High" 9 "Unused" 10 "Unused" 11 "Unused" 12 "Unused" 13 "Unused" 14 "Unused" 15 "Invalid" ;
VAL_ 3221225472 C_TeleRRSeatOpCmdIBOX 0 "Init" 1 "Unused" 2 "Seat Heat&Vent OFF" 3 "Seat_Vent_Low" 4 "Seat_Vent_Mid" 5 "Seat_Vent_High" 6 "Seat_Heat_Low" 7 "Seat_Heat_Mid" 8 "Seat_Heat_High" 9 "Unused" 10 "Unused" 11 "Unused" 12 "Unused" 13 "Unused" 14 "Unused" 15 "Invalid" ;
VAL_ 3221225472 C_TeleRLSeatOpCmdIBOX 0 "Init" 1 "Unused" 2 "Seat Heat&Vent OFF" 3 "Seat_Vent_Low" 4 "Seat_Vent_Mid" 5 "Seat_Vent_High" 6 "Seat_Heat_Low" 7 "Seat_Heat_Mid" 8 "Seat_Heat_High" 9 "Unused" 10 "Unused" 11 "Unused" 12 "Unused" 13 "Unused" 14 "Unused" 15 "Invalid" ;
VAL_ 3221225472 CF_AVN_CluWelcomeSnd 0 "Default" 1 "Off" 2 "On" 3 "Invalid" ;
VAL_ 3221225472 CF_AVN_CluAutoInitFuelEconomy 0 "Default" 1 "Off" 2 "Driving" 3 "Refuel" 4 "Reserved" 5 "Reserved" 6 "Reserved" 7 "Invalid" ;
VAL_ 3221225472 CF_AVN_CluVoiceVolume 0 "Default" 1 "Level0" 2 "Level1" 3 "Level2" 4 "Level3" 5 "Reserved" 6 "Reserved" 7 "Invalid" ;
VAL_ 3221225472 CF_AVN_CluServiceReminderSet 0 "Default" 1 "Off" 2 "On" 3 "Invalid" ;
VAL_ 3221225472 CF_AVN_CluTransmissionDisp 0 "Default" 1 "Off" 2 "On" 3 "Invalid" ;
VAL_ 3221225472 CF_AVN_CluWiperLight 0 "Default" 1 "Off" 2 "On" 3 "Invalid" ;
VAL_ 3221225472 CF_AVN_CluRoadInfoGuide 0 "Default" 1 "Off" 2 "On" 3 "Invalid" ;
VAL_ 3221225472 CF_AVN_CluUserSettingPeriod 0 "0~99month" 1 "0~99month" 2 "0~99month" 3 "0~99month" 4 "0~99month" 5 "0~99month" 6 "0~99month" 7 "0~99month" 8 "0~99month" 9 "0~99month" 10 "0~99month" 11 "0~99month" 12 "0~99month" 13 "0~99month" 14 "0~99month" 15 "0~99month" 16 "0~99month" 17 "0~99month" 18 "0~99month" 19 "0~99month" 20 "0~99month" 21 "0~99month" 22 "0~99month" 23 "0~99month" 24 "0~99month" 25 "0~99month" 26 "0~99month" 27 "0~99month" 28 "0~99month" 29 "0~99month" 30 "0~99month" 31 "0~99month" 32 "0~99month" 33 "0~99month" 34 "0~99month" 35 "0~99month" 36 "0~99month" 37 "0~99month" 38 "0~99month" 39 "0~99month" 40 "0~99month" 41 "0~99month" 42 "0~99month" 43 "0~99month" 44 "0~99month" 45 "0~99month" 46 "0~99month" 47 "0~99month" 48 "0~99month" 49 "0~99month" 50 "0~99month" 51 "0~99month" 52 "0~99month" 53 "0~99month" 54 "0~99month" 55 "0~99month" 56 "0~99month" 57 "0~99month" 58 "0~99month" 59 "0~99month" 60 "0~99month" 61 "0~99month" 62 "0~99month" 63 "0~99month" 64 "0~99month" 65 "0~99month" 66 "0~99month" 67 "0~99month" 68 "0~99month" 69 "0~99month" 70 "0~99month" 71 "0~99month" 72 "0~99month" 73 "0~99month" 74 "0~99month" 75 "0~99month" 76 "0~99month" 77 "0~99month" 78 "0~99month" 79 "0~99month" 80 "0~99month" 81 "0~99month" 82 "0~99month" 83 "0~99month" 84 "0~99month" 85 "0~99month" 86 "0~99month" 87 "0~99month" 88 "0~99month" 89 "0~99month" 90 "0~99month" 91 "0~99month" 92 "0~99month" 93 "0~99month" 94 "0~99month" 95 "0~99month" 96 "0~99month" 97 "0~99month" 98 "0~99month" 99 "0~99month" 100 "Reserved" 101 "Reserved" 102 "Reserved" 103 "Reserved" 104 "Reserved" 105 "Reserved" 106 "Reserved" 107 "Reserved" 108 "Reserved" 109 "Reserved" 110 "Reserved" 111 "Reserved" 112 "Reserved" 113 "Reserved" 114 "Reserved" 115 "Reserved" 116 "Reserved" 117 "Reserved" 118 "Reserved" 119 "Reserved" 120 "Reserved" 121 "Reserved" 122 "Reserved" 123 "Reserved" 124 "Reserved" 125 "Reserved" 126 "Reserved" 127 "Invalid" ;
VAL_ 3221225472 CF_AVN_CluSubspeedOdometerDisp 0 "Default" 1 "Off" 2 "On" 3 "Invalid" ;
VAL_ 3221225472 CF_AVN_CluFuelEconUnit_mi 0 "Default" 1 "US gallon" 2 "UK gallon" 3 "Reserved" ;
VAL_ 3221225472 CF_AVN_CluFuelEconUnit_km 0 "Default" 1 "km_L" 2 "L_100km" 3 "Reserved" ;
VAL_ 3221225472 CF_AVN_CluUserSettingDistance 0 "0x0~0x1869F:0~9999km_mi" 99999 "0x0~0x1869F:0~9999km_mi" 131071 "Invalid" ;
VAL_ 3221225472 CF_AVN_UnitReset 0 "Default" 1 "Unit Reset" 2 "Reserved" 3 "Invalid" ;
VAL_ 3221225472 CF_AVN_IcyRoadWarn 0 "Default" 1 "Off" 2 "On" 3 "Invalid" ;
VAL_ 3221225472 CF_AVN_CluServiceReminderReset 0 "Default" 1 "Service Reminder Reset" 2 "Reserved" 3 "Invalid" ;
VAL_ 3221225472 CF_AVN_CluUSMReset 0 "Default" 1 "USM Reset" 2 "Reserved" 3 "Invalid" ;
VAL_ 3221225472 C_PTGMNValueSet 0 "Default" 1 "Power Mode" 2 "Manual Mode" 3 "Invalid" ;
VAL_ 3221225472 CF_AVN_ADrUNValueSet 0 "Default" 1 "Off" 2 "Key Out On(All Doors)" 3 "Shift Lever On(All Doors)" 4 "Override" 5 "Invalid" 6 "Key Out On(Driver Door)" 7 "Shift Lever On(Driver Door)" ;
VAL_ 3221225472 CF_AVN_ADrLNValueSet 0 "Default" 1 "Off" 2 "Vehicle Speed On(15km)" 3 "Shift Lever On" 4 "Invalid" 5 "Reserved" 6 "Reserved" 7 "Reserved" ;
VAL_ 3221225472 CF_AVN_EscortHLNValueSet 0 "Default" 1 "Escort Off" 2 "Escort On" 3 "Invalid" ;
VAL_ 3221225472 CF_AVN_PSMNValueSet 0 "Default" 1 "Off(Disable)" 2 "50mm On(Enable)" 3 "75mm On(Enable)" 4 "Reserved" 5 "Reserved" 6 "Reserved" 7 "Invalid" ;
VAL_ 3221225472 C_HfreeTrunkTgNValueSet 0 "Default" 1 "HandsFree Off" 2 "HandsFree On" 3 "Reserved" 4 "Invalid" 5 "Reserved" 6 "Reserved" 7 "Reserved" ;
VAL_ 3221225472 CF_AVN_TrfChgSet 0 "Default" 1 "Disable(Off)" 2 "Enable(On)" 3 "Invalid" ;
VAL_ 3221225472 CF_AVN_SCMNValueSet 0 "Default" 1 "Steering Off" 2 "Steering On" 3 "Invalid" ;
VAL_ 3221225472 CF_AVN_OTTurnNValueSet 0 "Default" 1 "One Touch Turn Off" 2 "3 Flashing" 3 "5 Flashing" 4 "7 Flashing" 5 "Invalid" 6 "Reserved" 7 "Reserved" ;
VAL_ 3221225472 CF_Gway_WPCNValueSet 0 "Default" 1 "Off(Disable)" 2 "On(Enable)" 3 "Invalid" ;
VAL_ 3221225472 C_AVN_RearWiperNValueSet 0 "Default" 1 "Rear Wiper(Reverse) Off" 2 "Rear Wiper(Reverse) On" 3 "Invalid" ;
VAL_ 3221225472 C_UnlockWelocomeNValueSet 0 "Default" 1 "Off" 2 "On" 3 "Invalid" ;
VAL_ 3221225472 C_SmartWelocomeNValueSet 0 "Default" 1 "Off" 2 "On" 3 "Invalid" ;
VAL_ 3221225472 CF_AVN_PTGSpeedNValueSet 0 "Default" 1 "Fast" 2 "Slow" 3 "Invalid" ;
VAL_ 3221225472 CR_Datc_DRSeatWheel_USM_Set 0 "Default" 1 "Off" 2 "On" 3 "Invalid" ;
VAL_ 3221225472 CF_AVN_TTUnlockNValueSet 0 "Default" 1 "Off" 2 "On" 3 "Invalid" ;
VAL_ 3221225472 CF_Avn_BolsterNValueSet 0 "Default" 1 "Off" 2 "On" 3 "Invalid" ;
VAL_ 3221225472 C_StrWheelAutoHeatNValueSet 0 "Default" 1 "Off" 2 "On" 3 "Invalid" ;
VAL_ 3221225472 CF_Avn_HAPTICWARNINGNValueSet 0 "Default" 1 "Weak" 2 "Medium" 3 "Strong" 4 "Reserved" 5 "Reserved" 6 "Reserved" 7 "Invalid" ;
VAL_ 3221225472 CR_Datc_DRSeatHeat_USM_Set 0 "Default" 1 "Off" 2 "On" 3 "Invalid" ;
VAL_ 3221225472 C_WALNValueSet 0 "Default" 1 "Off" 2 "On" 3 "Invalid" ;
VAL_ 3221225472 CF_AVN_RrSeatRemindNValueSet 0 "Default" 1 "Off(Disable)" 2 "On(Enable)" 3 "Invalid" ;
VAL_ 3221225472 CF_AVN_TunnelWindowNvalueSet 0 "Default" 1 "Off" 2 "On" 3 "Invalid" ;
VAL_ 3221225472 CF_AVN_MoodLpRedNValueSet 0 "0x000~0x0FF:Red Color 0~255 (User Selection)" 255 "0x000~0x0FF:Red Color 0~255 (User Selection)" 256 "100~0x1FF:Red Color 0~255 (Expert Recommendation)" 511 "100~0x1FF:Red Color 0~255 (Expert Recommendation)" 512 "Default" 1023 "Invalid" ;
VAL_ 3221225472 CF_AVN_MoodLpGreenNValueSet 0 "0x000~0x0FF:Green Color 0~255 (User Selection)" 255 "0x000~0x0FF:Green Color 0~255 (User Selection)" 256 "100~0x1FF:Green Color 0~255 (Expert Recommendation)" 511 "100~0x1FF:Green Color 0~255 (Expert Recommendation)" 512 "Default" 1023 "Invalid" ;
VAL_ 3221225472 CF_AVN_MoodLpBlueNValueSet 0 "0x000~0x0FF:Blue Color 0~255 (User Selection)" 255 "0x000~0x0FF:Blue Color 0~255 (User Selection)" 256 "100~0x1FF:Blue Color 0~255 (Expert Recommendation)" 511 "100~0x1FF:Blue Color 0~255 (Expert Recommendation)" 512 "Default" 1023 "Invalid" ;
VAL_ 3221225472 CF_AVN_MoodLpBrightNValueSet 0 "Default" 1 "Off" 2 "Level 1" 3 "Level 2" 4 "Level 3" 5 "Level 4" 6 "Level 5" 7 "Level 6" 8 "Level 7" 9 "Level 8" 10 "Level 9" 11 "Level 10" 12 "Reserved" 13 "Reserved" 14 "Reserved" 15 "Invalid" ;
VAL_ 3221225472 C_MoodLpDrivingNValue 0 "Default" 1 "OFF" 2 "ON" 3 "Invalid" ;
VAL_ 3221225472 C_HCIMSWeightNValueSet 0 "Default" 1 "Under 49.4kg" 2 "49.5~59.4kg" 3 "59.5~69.4kg" 4 "69.5~79.4kg" 5 "79.5~89.4kg" 6 "89.5~99.4kg" 7 "99.5~109.4kg" 8 "109.5~119.4kg" 9 "More than 119.5kg" 10 "Reserved" 11 "Reserved" 12 "Reserved" 13 "Reserved" 14 "Reserved" 15 "Invalid" ;
VAL_ 3221225472 C_HCIMSHeightNvalueSet 0 "Default" 1 "Less than 147.5cm" 2 "147.5~152.4cm" 3 "152.5~157.4cm" 4 "157.5~162.4cm" 5 "162.5~167.4cm" 6 "167.5~172.4cm" 7 "172.5~177.4cm" 8 "177.5~182.4cm" 9 "182.5~187.4cm" 10 "187.5~192.4cm" 11 "192.5~197.4cm" 12 "more than 197.5cm" 13 "Reserved" 14 "Reserved" 15 "Invalid" ;
VAL_ 3221225472 CF_AVN_HCIMSButtonCommand 0 "Default" 1 "Health Care IMS Exit" 2 "Detail View" 3 "Move to recommend position" 4 "Current position Analysis" 5 "Move to setting page" 6 "Save view" 7 "IMS1 saved" 8 "IMS2 saved" 9 "Summary view" 10 "Smart IMS On" 11 "Reserved" 12 "Reserved" 13 "Reserved" 14 "Reserved" 15 "Invalid" ;
VAL_ 3221225472 C_HCIMSSitHeightNValueSet 0 "Default" 1 "Tall" 2 "Middle" 3 "Short" 4 "Reserved" 5 "Reserved" 6 "Reserved" 7 "Reserved" 8 "Reserved" 9 "Reserved" 10 "Reserved" 11 "Reserved" 12 "Reserved" 13 "Reserved" 14 "Reserved" 15 "Invalid" ;
VAL_ 3221225472 CF_AVN_SeatDrvModNValueSet 0 "Default" 1 "Off" 2 "On" 3 "Invalid" ;
VAL_ 3221225472 CF_AVN_AirSptStrNValueSet 0 "Default" 1 "Normal" 2 "Intensity" 3 "Invalid" ;
VAL_ 3221225472 CF_AVN_AirSptTimeNValueSet 0 "Default" 1 "10min" 2 "15min" 3 "20min" 4 "Reserved" 5 "Reserved" 6 "Reserved" 7 "Invalid" ;
VAL_ 3221225472 CF_AVN_CushSoftNValueSet 0 "Default" 1 "Soft" 2 "Mid" 3 "Hard" 4 "Reserved" 5 "Reserved" 6 "Reserved" 7 "Invalid" ;
VAL_ 3221225472 DoorLock_DrvrDrUnLkPsvAcsReq 0 "Off" 1 "Unlock" 2 "Not Used" 3 "Error Indicator" ;
VAL_ 3221225472 DoorLock_RmtKeyDrvrDrUnLkReq 0 "Off" 1 "Unlock" 2 "Not Used" 3 "Error Indicator" ;
VAL_ 3221225472 ENG_Ack4EngStpSta 0 "No acknowledgement" 1 "Acknowledgement engine stopped" 2 "Not used" 3 "Error indicator" ;
VAL_ 3221225472 ENG_OverDrvOffReq 0 "Normal operation" 1 "Over drive off request to TCU by the cruise control function" 2 "Not used" 3 "Error indicator" ;
VAL_ 3221225472 ENG_AccActSta 0 "Auto cruise control is not active" 1 "Auto cruise control is active" 2 "Not used" 3 "Error indicator" ;
VAL_ 3221225472 ENG_CltchOpSta 0 "Clutch is not operating" 1 "Clutch is operating" 2 "Not used" 3 "Error indicator" ;
VAL_ 3221225472 DSL_GlowCtrlReq 0 "Glow plug off request" 1 "Glow plug on request" 2 "System Error" 3 "Reserved" ;
VAL_ 3221225472 ENG_GlowLmpSta 0 "Lamp Off" 1 "Lamp On" 2 "Not used" 3 "Error indicator" ;
VAL_ 3221225472 ENG_ThrPosVal 32 "Idle (port value is learnt)" 245 "Throttle perpendicular" 255 "Throttle defective" ;
VAL_ 3221225472 ENG_AccelPdlVal 0 "Accelerator Pedal not activated" 1022 "Accelerator Pedal fully activated" 1023 "Accelerator Pedal is defective (fail state) or Non-ETC system (APS is not installed), Error indicator" ;
VAL_ 3221225472 ACC_CrsMainSwLmpSta 0 "Cruise MAIN switch indication lamp turn OFF" 1 "Cruise MAIN switch indication lamp turn ON" 2 "Not used" 3 "Error indicator" ;
VAL_ 3221225472 ACC_CrsSetSwLmpSta 0 "Cruise SET switch indication lamp turn OFF" 1 "Cruise SET switch indication lamp turn ON" 2 "Not used" 3 "Error indicator" ;
VAL_ 3221225472 ENG_PreFuelCutInSta 0 "Continue to fuel cut off control" 1 "Indication of fuel cut in previous to stop fuel cut off" 2 "Not used" 3 "Error indicator" ;
VAL_ 3221225472 ENG_SoakTimeErrSta 0 "No Failure detected" 1 "Failure detected" 2 "Not used" 3 "Error indicator" ;
VAL_ 3221225472 ENG_AppAccelPdlSta 0 "Accelerator pedal not pressed" 1 "Accelerator pedal pressed" 2 "Reserved" 3 "Accelerator pedal position sensor failure" ;
VAL_ 3221225472 ENG_BrkCtrlReq 0 "Brake control request is not active" 1 "Brake control request is active" 2 "Not used" 3 "Error indicator" ;
VAL_ 3221225472 ACC_DnShftCtrlReq 0 "Downshift control request is not active" 1 "Downshift request to 1st gear" 2 "Downshift request to 2nd gear" 3 "Downshift request to 3rd gear" 4 "Downshift request to 4th gear" 5 "Downshift request to 5th gear" 6 "Downshift request to 6th gear" 7 "Downshift request to 7th gear" 8 "Downshift request to 8th gear" 9 "Reserved" 10 "Reserved" 11 "Reserved" 12 "Reserved" 13 "Reserved" 14 "Reserved" 15 "Error indicator" ;
VAL_ 3221225472 ENG_ReprgmModRdySta 0 "Normal state" 1 "Reprogramming condition OK" 2 "Reprogramming condition NG" 3 "Reserved" ;
VAL_ 3221225472 ENG_AafOpnReq 0 "None" 1 "AAF open request" 2 "Not used" 3 "Error indicator" ;
VAL_ 3221225472 EMS_Crc2Val 65535 "Signal Invalid (Message with unused CRC. CRC signal is transmitted fixed value)" ;
VAL_ 3221225472 EMS_AlvCnt2Val 255 "Signal Invalid (Message with unused Alive counter. Alive counter signal is transmitted fixed value)" ;
VAL_ 3221225472 ENG_BrkSwSta 0 "Brake switch is not pressed (OFF)" 1 "Brake switch is pressed (ON)" 2 "EMS does not support this function." 3 "Brake switch failure" ;
VAL_ 3221225472 ENG_EngClntTempVal 255 "Error indicator" ;
VAL_ 3221225472 ENG_MafCrctVal 128 "Error indicator" ;
VAL_ 3221225472 ENG_BattDscnctSta 0 "no battery disconnection detected" 1 "battery disconnection detected and failure memory erased" 2 "Not used" 3 "Error indicator" ;
VAL_ 3221225472 OBD_MilConfgVal 0 "no MIL, Failure Memory Management OBD-I" 1 "MIL Treatment OBD-I, Failure Memory Management OBD-I" 2 "MIL Treatment OBD-II, Exception" 3 "MIL Treatment OBD-II, Failure Memory Management OBD-II" 4 "MIL Treatment E-OBD, Failure Memory Management E-OBD" 5 "MIL Treatment K-OBD, Failure Memory Management K-OBD" ;
VAL_ 3221225472 ENG_EngSta 0 "Engine Stop" 1 "Cranking" 2 "Stalled" 3 "Running" 4 "Reserved" 5 "Reserved" 6 "Reserved" 7 "Fault" ;
VAL_ 3221225472 ENG_DclBrkCntrlReq 4095 "Error indicator" ;
VAL_ 3221225472 ENG_BstPrsrVal 4095 "Error indicator" ;
VAL_ 3221225472 ENG_EngOilTempVal 255 "Error indicator" ;
VAL_ 3221225472 ENG_DpfWrngSta 0 "DPF Normal State" 1 "DPF Warning State Level 1" 2 "DPF Warning State Level 2" 3 "Reserved" ;
VAL_ 3221225472 ENG_BattWrngLmpSta 0 "Battery Warning Lamp OFF" 1 "Battery Warning Lamp ON" 2 "Not used" 3 "Error indicator" ;
VAL_ 3221225472 ENG_OilPrsrWrngLmpSta 0 "Oil Pressure Warning Lamp OFF" 1 "Oil Pressure Warning Lamp ON" 2 "Not used" 3 "Error indicator" ;
VAL_ 3221225472 ENG_IsgInhbtLmpSta 0 "ISG Inhibit Lamp OFF" 1 "ISG Inhibit Lamp ON" 2 "Not used" 3 "Error indicator" ;
VAL_ 3221225472 SAS_AnglVal 32767 "Error Indicator" ;
VAL_ 3221225472 SAS_SpdVal 255 "Error Indicator" ;
VAL_ 3221225472 LKA_OptUsmSta 0 "None LKA/LDW Option (Default)" 1 "LDW" 2 "LKA" 3 "Reserved" 4 "LDW Only (None LKA)" 5 "LDW only OFF (None LKA)" 6 "LDW/LKA OFF" 7 "Invalid" ;
VAL_ 3221225472 LKA_RcgSta 0 "Not Recognized" 1 "Full Lane Recognized" 2 "Left Line Recognized" 3 "Right Line Recognized" 4 "Reserved" 5 "Reserved" 6 "Reserved" 7 "Reserved" ;
VAL_ 3221225472 LKA_LHLnWrnSta 0 "No Warning" 1 "HAPTIC Warning and Display" 2 "Acoustic Warning and Display" 3 "Reserved" ;
VAL_ 3221225472 LKA_RHLnWrnSta 0 "No Warning" 1 "HAPTIC Warning and Display" 2 "Acoustic Warning and Display" 3 "Reserved" ;
VAL_ 3221225472 LKA_HndsoffSnd 0 "Off" 1 "Hands-off Sound Warning" 2 "Reserved" 3 "Reserved" ;
VAL_ 3221225472 LKA_StrSnd 0 "Off" 1 "Warning" 2 "Reserved" 3 "Reserved" ;
VAL_ 3221225472 LKA_SysIndReq 0 "Off" 1 "Unavailable_(Grey On)" 2 "Lane Recognized_(Green On)" 3 "Lane Departure_(Green Blink)" 4 "System Fail_(Orange On)" 5 "Not Calibrated_(Orange Blink)" 6 "Regulation_(Orange On)" 7 "Reserved" ;
VAL_ 3221225472 LKA_StrTqReqVal 0 "0x000~0x7FD:0~2045" 2045 "0x000~0x7FD:0~2045" 2046 "Reserved" 2047 "Invalid" ;
VAL_ 3221225472 LKA_ActToiSta 0 "De-activate TOI" 1 "Activate TOI" 2 "Reserved" 3 "Error indicator" ;
VAL_ 3221225472 LKA_ToiFltSta 0 "No Fault" 1 "Fault" 2 "Reserved" 3 "Error indicatorr" ;
VAL_ 3221225472 BCA_Rear_WrnSta 0 "No Warning" 1 "Left Warning" 2 "Right Warning" 3 "Left Control" 4 "Right Control 0x5:Reserved" 6 "Not used" 7 "Error indicator" ;
VAL_ 3221225472 FCA_LO_WrnSta 0 "No Warning" 1 "Left Warning" 2 "Right Warning" 3 "Left Control" 4 "Right Control" 5 "Reserved" 6 "Reserved" 7 "Error indicator" ;
VAL_ 3221225472 FCA_LS_WrnSta 0 "No Warning" 1 "Left Warning" 2 "Right Warning" 3 "Left Control" 4 "Right Control" 5 "Reserved" 6 "Reserved" 7 "Error indicator" ;
VAL_ 3221225472 BCAref_FrCmrSta 0 "BCA_OFF" 1 "BCA_Passive" 2 "BCA_Active" 3 "BCA_Failure" ;
VAL_ 3221225472 BCA_WrngSta 0 "Default(Non-Warning)" 1 "BCA Left Warning is On" 2 "BCA Right Warning is On" 3 "Reserved (Non-Warning)" ;
VAL_ 3221225472 LKA_UsmMod 0 "NONE" 1 "LKA 1 mode" 2 "LKA 2 mode" 3 "LDW" ;
VAL_ 3221225472 Info_PedtrnDst 0 "15m~" 1 "10~15m(Default)" 2 "5~10m" 3 "0~5m" 4 "Reserved" 5 "Reserved" 6 "Reserved" 7 "Invalid" ;
VAL_ 3221225472 APSB_CrashActvSta 0 "APSB Inactive" 1 "APSB is active" 2 "Rserved" 3 "Rserved" ;
VAL_ 3221225472 APSB_RRDrvImpt 0 "Rough Road Impact is Inactive" 1 "Rough Road  Impact is PSB Front Active" 2 "Rough Road  Impact is PSB Rear Active" 3 "Rough Road  Impact is Failure" 4 "Reserved" 5 "Reserved" 6 "Reserved" 7 "Reserved" ;
VAL_ 3221225472 APSB_FCAFrImpt 0 "FCA Impact is Inactive" 1 "FCA Impact is PSB Front Active" 2 "FCA Impact is PSB Rear Active" 3 "FCA Impact is Failure" 4 "Reserved" 5 "Reserved" 6 "Reserved" 7 "Reserved" ;
VAL_ 3221225472 APSB_MinFrImpt 0 "Minor Front Impact is Inactive" 1 "Minor Front Impact is PSB Front Active" 2 "Minor Front Impact is PSB Rear Active" 3 "Minor Front Impact is Failure" 4 "Reserved" 5 "Reserved" 6 "Reserved" 7 "Reserved" ;
VAL_ 3221225472 APSB_MinSidImpt 0 "Minor Side Impact is Inactive" 1 "Minor Side Impact is PSB Front Active" 2 "Minor Side Impact is PSB Rear Active" 3 "Minor Side Impact is Failure" 4 "Reserved" 5 "Reserved" 6 "Reserved" 7 "Reserved" ;
VAL_ 3221225472 APSB_MinRollDetn 0 "Minor Roll Detection is Inactive" 1 "Minor Roll Detection  is PSB Front Active" 2 "Minor Roll Detection  is PSB Rear Active" 3 "Minor Roll Detection  is Failure" 4 "Reserved" 5 "Reserved" 6 "Reserved" 7 "Reserved" ;
VAL_ 3221225472 APSB_MinRearImpt 0 "Minor Rear Impact is Inactive" 1 "Minor Rear Impact is PSB Front Active" 2 "Minor Rear Impact is PSB Rear Active" 3 "Minor Rear Impact is Failure" 4 "Reserved" 5 "Reserved" 6 "Reserved" 7 "Reserved" ;
VAL_ 3221225472 DATC_PtcRlySta 0 "PTC OFF" 1 "PTC ON Lv1" 2 "PTC ON Lv1&2" 3 "PTC ON Lv1&2&3" 4 "Not used" 5 "Not used" 6 "Not used" 7 "Error Indicator" ;
VAL_ 3221225472 DATC_ManufacturerTyp 0 "FATC Type 0 (default)" 1 "FATC Type 1 (Doowon)" 2 "FATC Type 2 (Hanon)/0X3:FATC Type 3(DENSO)" 4 "Not used" 5 "Not used" 6 "Not used" 7 "Error Indicator" ;
VAL_ 3221225472 DATC_AcnCompTyp 0 "Internal Compressor" 1 "External Compressor with Comp clutch" 2 "External Compressor without Comp clutch" 3 "Fixed Compressor" 4 "electrical Compressor" 6 "Not used" 7 "Error Indicator" ;
VAL_ 3221225472 DATC_AcnReq 0 "A/C Non-Request" 1 "A/C Request" 2 "Not used" 3 "Error Indicator" ;
VAL_ 3221225472 DATC_BlwSta 0 "Blower Off" 1 "Blower On" 2 "Not used" 3 "Error Indicator" ;
VAL_ 3221225472 DATC_BlwMaxSta 0 "NOT Max blower speed" 1 "Max blower speed" 2 "Not used" 3 "Error Indicator" ;
VAL_ 3221225472 DATC_EngStrtReq 0 "Engine Not on Request" 1 "Engine Auto Start Request" 2 "Not used" 3 "Error Indicator" ;
VAL_ 3221225472 DATC_IsgInhbtReq 0 "ISG Inhibit Request Off" 1 "ISG Inhibit Request ON" 2 "Not used" 3 "Error Indicator" ;
VAL_ 3221225472 DATC_AcnCompOnReq 0 "A/C COMP Request Off" 1 "A/C COMP Request ON" 2 "Not used" 3 "Error Indicator" ;
VAL_ 3221225472 DATC_EngIdlRpmUpReq 0 "Off" 1 "Request" 2 "Not used" 3 "Error Indicator" ;
VAL_ 3221225472 DATC_EcvFltSta 0 "Normal(No fault)" 1 "ECV Control Fault" 2 "Not used" 3 "Error Indicator" ;
VAL_ 3221225472 DATC_CalcAcnCompTqVal 254 "Not used" 255 "Error Indicator" ;
VAL_ 3221225472 DATC_OutTempSnsrVal 255 "Error" ;
VAL_ 3221225472 DATC_DfgSw 0 "FRONT DEF switch is not selected" 1 "FRONT DEF switch is selected" 2 "Not Used" 3 "Error Indicator" ;
VAL_ 3221225472 PCA_SysSta 0 "Default" 1 "PCW off, PCA off" 2 "PCW on, PCA off" 3 "PCW on, PCA on" 4 "Reserved" 5 "Reserved" 6 "Reserved" 7 "Invalid" ;
VAL_ 3221225472 PCA_EquipSta 0 "Normal" 1 "Unavailable by ESC" 2 "Unavailable by Camera" 3 "Unavailable by Ultrasonic" 4 "Unavailable by PCA-R" 5 "Reserved" 6 "Reserved" 7 "Invalid" ;
VAL_ 3221225472 PCA_WrngLvlSta 0 "Normal" 1 "Ready" 2 "Warning" 3 "Reserved" 4 "Reserved" 5 "Reserved" 6 "Reserved" 7 "Invalid" ;
VAL_ 3221225472 PCA_WrngMsgSta 0 "Normal" 1 "Warning" 2 "Braking" 3 "Reserved" 4 "Reserved" 5 "Reserved" 6 "Reserved" 7 "Invalid" ;
VAL_ 3221225472 PCA_WrngSndCtrSta 0 "Normal" 1 "Warning" 2 "Reserved" 3 "Invalid" ;
VAL_ 3221225472 PCA_WrngSndLftSta 0 "Normal" 1 "Warning" 2 "Reserved" 3 "Invalid" ;
VAL_ 3221225472 PCA_WrngSndRtSta 0 "Normal" 1 "Warning" 2 "Reserved" 3 "Invalid" ;
VAL_ 3221225472 PCA_BrkReq 0 "PCA Brake off" 1 "PCA Brake on" ;
VAL_ 3221225472 PCA_DgrSta 0 "Default" 1 "Late" 2 "Normal" 3 "Reserved" 4 "Reserved" 5 "Reserved" 6 "Reserved" 7 "Invalid" ;
VAL_ 3221225472 FCA_OnOffEquipSta 0 "Default" 1 "Off" 2 "Warning" 3 "Assist" 4 "Reserved" 5 "Reserved" 6 "Reserved" 7 "Invalid" ;
VAL_ 3221225472 FCA_SysFlrSta 0 "Normal" 1 "Temp. Unavailable by Camera" 2 "Temp. Unavailable by Radar" 3 "Service Required" 4 "Temp. Unavailable by Camera (Camera only)" 5 "Reserved" 6 "Reserved" 7 "Reserved" ;
VAL_ 3221225472 FCA_WrngLvlSta 0 "No warning" 1 "Warning level 1" 2 "Warning level 2" 3 "Warning level 3" ;
VAL_ 3221225472 FCA_VehStpReq 0 "No request" 1 "Stop control is required" 2 "Reserved" 3 "Error Indicator" ;
VAL_ 3221225472 FCA_StbltActvReq 0 "Release No alert" 1 "Pre-crash full retraction" 2 "Haptic warning" 3 "Reserved" 4 "Reserved" 5 "Reserved" 6 "Reserved" 7 "Reserved" ;
VAL_ 3221225472 FCA_HydrlcBstAsstReq 0 "Standard threshold" 1 "Lowered threshold 1" 2 "Lowered threshold 2" 3 "Lowered threshold 3" ;
VAL_ 3221225472 FCA_PrefillActvReq 0 "No pre-fill" 1 "Pre-fill act" 2 "Reserved" 3 "Error Indicator" ;
VAL_ 3221225472 FCA_PartialActvReq 0 "No Partial act" 1 "Partail act" 2 "Reserved" 3 "Error Indicator" ;
