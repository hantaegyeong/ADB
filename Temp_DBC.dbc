VERSION ""

NS_ :

BS_:

BU_: MLM IBU_HS ILCU_RH MFSW DPSU ILCU_LH PSB APSU DPSS SWRC CGW PTGM DLBCU SCM DAU WPC IAU eCall PFSU RDC PSM

BO_ 3221225472 VECTOR__INDEPENDENT_SIG_MSG: 0 Vector__XXX
 SG_ BCM_SolSnsrLftOutVoltVal : 0|8@1+ (1,0) [0|0] "" Vector__XXX
 SG_ BCM_RVMSw : 0|2@1+ (1,0) [0|0] "" Vector__XXX
 SG_ BCM_GearPosPSta : 0|2@1+ (1,0) [0|0] "" Vector__XXX
 SG_ BCM_SunRoofOpnSta : 0|2@1+ (1,0) [0|0] "" Vector__XXX
 SG_ IAU_PhoneBDAdrRcvSta : 0|2@1+ (1,0) [0|0] "" Vector__XXX
 SG_ IAU_PhoneBDAdrVal : 0|48@1+ (1,0) [0|0] "" Vector__XXX
 SG_ ILCU_LH_Crc1Val : 0|8@1+ (1,0) [0|0] "" Vector__XXX
 SG_ ILCU_LH_AlvCnt1Val : 0|4@1+ (1,0) [0|0] "" Vector__XXX
 SG_ ILCULH_LowBeamAct_Sta : 0|2@1+ (1,0) [0|0] "" Vector__XXX
 SG_ ILCULH_LowBeamLED_Sta : 0|2@1+ (1,0) [0|0] "" Vector__XXX
 SG_ ILCULH_PstnAct_Sta : 0|2@1+ (1,0) [0|0] "" Vector__XXX
 SG_ ILCULH_PstnLED_Sta : 0|2@1+ (1,0) [0|0] "" Vector__XXX
 SG_ ILCULH_HighBeamAct_Sta : 0|2@1+ (1,0) [0|0] "" Vector__XXX
 SG_ ILCULH_HighBeamLED_Sta : 0|2@1+ (1,0) [0|0] "" Vector__XXX
 SG_ ILCULH_DRLAct_Sta : 0|2@1+ (1,0) [0|0] "" Vector__XXX
 SG_ ILCULH_DRLLED_Sta : 0|2@1+ (1,0) [0|0] "" Vector__XXX
 SG_ ILCULH_FrontTurnAct_Sta : 0|2@1+ (1,0) [0|0] "" Vector__XXX
 SG_ ILCULH_FrontTurnLED_Sta : 0|2@1+ (1,0) [0|0] "" Vector__XXX
 SG_ ILCULH_System_Sta : 0|2@1+ (1,0) [0|0] "" Vector__XXX
 SG_ ILCULH_IFSOpt_Sta : 0|2@1+ (1,0) [0|0] "" Vector__XXX
 SG_ ILCULH_IFSLamp_Act : 0|2@1+ (1,0) [0|0] "" Vector__XXX
 SG_ ILCULH_IFSSysState_Sta : 0|2@1+ (1,0) [0|0] "" Vector__XXX
 SG_ ILCULH_IFSWarning_Sta : 0|2@1+ (1,0) [0|0] "" Vector__XXX
 SG_ ILCU_RH_Crc1Val : 0|8@1+ (1,0) [0|0] "" Vector__XXX
 SG_ ILCU_RH_AlvCnt1Val : 0|4@1+ (1,0) [0|0] "" Vector__XXX
 SG_ ILCURH_LowBeamAct_Sta : 0|2@1+ (1,0) [0|0] "" Vector__XXX
 SG_ ILCURH_LowBeamLED_Sta : 0|2@1+ (1,0) [0|0] "" Vector__XXX
 SG_ ILCURH_PstnAct_Sta : 0|2@1+ (1,0) [0|0] "" Vector__XXX
 SG_ ILCURH_PstnLED_Sta : 0|2@1+ (1,0) [0|0] "" Vector__XXX
 SG_ ILCURH_HighBeamAct_Sta : 0|2@1+ (1,0) [0|0] "" Vector__XXX
 SG_ ILCURH_HighBeamLED_Sta : 0|2@1+ (1,0) [0|0] "" Vector__XXX
 SG_ ILCURH_DRLAct_Sta : 0|2@1+ (1,0) [0|0] "" Vector__XXX
 SG_ ILCURH_DRLLED_Sta : 0|2@1+ (1,0) [0|0] "" Vector__XXX
 SG_ ILCURH_FrontTurnAct_Sta : 0|2@1+ (1,0) [0|0] "" Vector__XXX
 SG_ ILCURH_FrontTurnLED_Sta : 0|2@1+ (1,0) [0|0] "" Vector__XXX
 SG_ ILCURH_System_Sta : 0|2@1+ (1,0) [0|0] "" Vector__XXX
 SG_ ILCURH_IFSOpt_Sta : 0|2@1+ (1,0) [0|0] "" Vector__XXX
 SG_ ILCURH_IFSLamp_Act : 0|2@1+ (1,0) [0|0] "" Vector__XXX
 SG_ ILCURH_IFSSysState_Sta : 0|2@1+ (1,0) [0|0] "" Vector__XXX
 SG_ ILCURH_IFSWarning_Sta : 0|2@1+ (1,0) [0|0] "" Vector__XXX
 SG_ DATC_Crc11Val : 0|16@1+ (1,0) [0|0] "" Vector__XXX
 SG_ DATC_AlvCnt11Val : 0|8@1+ (1,0) [0|0] "" Vector__XXX
 SG_ DATC_TunnelFuncOff4AutoDfgReq : 0|2@1+ (1,0) [0|0] "" Vector__XXX
 SG_ DATC_ArClnSysSta : 0|2@1+ (1,0) [0|0] "" Vector__XXX
 SG_ DATC_DrvrStHtrUSMSta : 0|2@1+ (1,0) [0|0] "" Vector__XXX
 SG_ IAU_EncryptedResult2Val : 0|64@1+ (1,0) [0|0] "" Vector__XXX
 SG_ SMK_Crc4Val : 0|8@1+ (1,0) [0|0] "" Vector__XXX
 SG_ SMK_AlvCnt4Val : 0|4@1+ (1,0) [0|0] "" Vector__XXX
 SG_ Warn_StrtStpBtnWrngSta : 0|2@1+ (1,0) [0|0] "" Vector__XXX
 SG_ Warn_DeActvWrngSta : 0|2@1+ (1,0) [0|0] "" Vector__XXX
 SG_ Warn_ExtrnlBuzWrngSta : 0|4@1+ (1,0) [0|0] "" Vector__XXX
 SG_ Warn_DisWrngSta : 0|5@1+ (1,0) [0|0] "" Vector__XXX
 SG_ Warn_GearPosPWrngReq : 0|2@1+ (1,0) [0|0] "" Vector__XXX
 SG_ Warn_IdOutWrngSta : 0|2@1+ (1,0) [0|0] "" Vector__XXX
 SG_ Warn_KeyBattLoWrngSta : 0|2@1+ (1,0) [0|0] "" Vector__XXX
 SG_ Warn_KeyOutLmpOnReq : 0|2@1+ (1,0) [0|0] "" Vector__XXX
 SG_ Warn_NotGearPosPWrngSta : 0|2@1+ (1,0) [0|0] "" Vector__XXX
 SG_ Warn_EsclFlWrngSta : 0|2@1+ (1,0) [0|0] "" Vector__XXX
 SG_ Warn_EsclNotLkWrngSta : 0|2@1+ (1,0) [0|0] "" Vector__XXX
 SG_ Warn_EsclNotUnLkWrngSta : 0|2@1+ (1,0) [0|0] "" Vector__XXX
 SG_ Warn_ImmoLmpOnReq : 0|2@1+ (1,0) [0|0] "" Vector__XXX
 SG_ RL_SHVU_SeatOptSta : 0|3@1+ (1,0) [0|0] "" Vector__XXX
 SG_ RL_SHVU_SeatHtOperSta : 0|4@1+ (1,0) [0|0] "" Vector__XXX
 SG_ RL_CURTAIN_POSITION : 0|2@1+ (1,0) [0|0] "" Vector__XXX
 SG_ RR_CURTAIN_POSITION : 0|2@1+ (1,0) [0|0] "" Vector__XXX
 SG_ DLBCU_ActiveDis : 0|3@1+ (1,0) [0|0] "" Vector__XXX
 SG_ DLBCU_DrvModUSMSta : 0|2@1+ (1,0) [0|0] "" Vector__XXX
 SG_ DLBCU_ActiveStrSta : 0|2@1+ (1,0) [0|0] "" Vector__XXX
 SG_ DLBCU_ActiveTimeSta : 0|3@1+ (1,0) [0|0] "" Vector__XXX
 SG_ DLBCU_CushSoftSta : 0|3@1+ (1,0) [0|0] "" Vector__XXX
 SG_ BCM_Crc11Val : 0|8@1+ (1,0) [0|0] "" Vector__XXX
 SG_ BCM_AlvCnt11Val : 0|4@1+ (1,0) [0|0] "" Vector__XXX
 SG_ USM_EscrtHdLmpSta : 0|3@1+ (1,0) [0|0] "" Vector__XXX
 SG_ USM_WlcmMirLtSystTitleOpt : 0|3@1+ (1,0) [0|0] "" Vector__XXX
 SG_ USM_UnlockWlcmSta : 0|3@1+ (1,0) [0|0] "" Vector__XXX
 SG_ USM_SmrtWlcmSta : 0|3@1+ (1,0) [0|0] "" Vector__XXX
 SG_ USM_RrWiperByGearPosRSta : 0|3@1+ (1,0) [0|0] "" Vector__XXX
 SG_ USM_RrStRmndSta : 0|3@1+ (1,0) [0|0] "" Vector__XXX
 SG_ USM_TunlModAutoWdwSta : 0|3@1+ (1,0) [0|0] "" Vector__XXX
 SG_ IAU_PhoneNumOnWPCVal : 0|48@1+ (1,0) [0|0] "" Vector__XXX
 SG_ SMK_Crc5Val : 0|8@1+ (1,0) [0|0] "" Vector__XXX
 SG_ SMK_AlvCnt5Val : 0|4@1+ (1,0) [0|0] "" Vector__XXX
 SG_ SMK_AsstTgglBtnSta : 0|2@1+ (1,0) [0|0] "" Vector__XXX
 SG_ SMK_DrvTglBtnSta : 0|2@1+ (1,0) [0|0] "" Vector__XXX
 SG_ SMK_TgglBtnStuckSta : 0|2@1+ (1,0) [0|0] "" Vector__XXX
 SG_ SMK_BrkSwSta : 0|2@1+ (1,0) [0|0] "" Vector__XXX
 SG_ SMK_GearPosPSwSta : 0|2@1+ (1,0) [0|0] "" Vector__XXX
 SG_ SMK_RpmHiByteVal : 0|8@1+ (1,0) [0|0] "" Vector__XXX
 SG_ SMK_RpmLoByteVal : 0|8@1+ (1,0) [0|0] "" Vector__XXX
 SG_ SMK_VehSpdDrctVal : 0|8@1+ (1,0) [0|0] "" Vector__XXX
 SG_ IAU_DigitalKeyOpt : 0|2@1+ (1,0) [0|0] "" Vector__XXX
 SG_ IAU_NFCDeviceDetectionSta : 0|3@1+ (1,0) [0|0] "" Vector__XXX
 SG_ IAU_PhoneAuthSta : 0|3@1+ (1,0) [0|0] "" Vector__XXX
 SG_ IAU_ProfileIDParingRVal : 0|2@1+ (1,0) [0|0] "" Vector__XXX
 SG_ IAU_ProfileIDRVal : 0|4@1+ (1,0) [0|0] "" Vector__XXX
 SG_ IAU_DigitalKeyProcessingSta : 0|4@1+ (1,0) [0|0] "" Vector__XXX
 SG_ IAU_DigitalKeyExit : 0|4@1+ (1,0) [0|0] "" Vector__XXX
 SG_ IAU_DigitalKeyEnblRVal : 0|2@1+ (1,0) [0|0] "" Vector__XXX
 SG_ IAU_OwnerPhnRegRVal : 0|2@1+ (1,0) [0|0] "" Vector__XXX
 SG_ IAU_NFCCard1RegRVal : 0|2@1+ (1,0) [0|0] "" Vector__XXX
 SG_ IAU_NFCCard2RegRVal : 0|2@1+ (1,0) [0|0] "" Vector__XXX
 SG_ IAU_RdyToSendAuthDataSta : 0|2@1+ (1,0) [0|0] "" Vector__XXX
 SG_ IAU_OptTyp : 0|3@1+ (1,0) [0|0] "" Vector__XXX
 SG_ CF_AVN_PhoneParingNValueSet : 0|2@1+ (1,0) [0|0] "" Vector__XXX
 SG_ CF_AVN_ProfileIDNValueSet : 0|4@1+ (1,0) [0|0] "" Vector__XXX
 SG_ NFC_Support_check_request : 0|2@1+ (1,0) [0|0] "" Vector__XXX
 SG_ CF_AVN_DigitKeyEnableNValueSet : 0|2@1+ (1,0) [0|0] "" Vector__XXX
 SG_ CF_AVN_OwnerPhoneNValueSet : 0|2@1+ (1,0) [0|0] "" Vector__XXX
 SG_ CF_AVN_NFCCard1NValueSet : 0|2@1+ (1,0) [0|0] "" Vector__XXX
 SG_ CF_AVN_NFCCard2NValueSet : 0|2@1+ (1,0) [0|0] "" Vector__XXX
 SG_ CF_AVN_IMSProfileNValueSet : 0|3@1+ (1,0) [0|0] "" Vector__XXX
 SG_ CF_AVN_DigitalKeyMenuExit : 0|2@1+ (1,0) [0|0] "" Vector__XXX
 SG_ BCM_Crc1Val : 0|8@1+ (1,0) [0|0] "" Vector__XXX
 SG_ BCM_AlvCnt1Val : 0|4@1+ (1,0) [0|0] "" Vector__XXX
 SG_ BAlarm_AutoLockrReq : 0|2@1+ (1,0) [0|0] "" Vector__XXX
 SG_ C_RH_Unfolding_SW : 0|2@1+ (1,0) [0|0] "" Vector__XXX
 SG_ C_RH_Folding_SW : 0|2@1+ (1,0) [0|0] "" Vector__XXX
 SG_ C_LH_Unfolding_SW : 0|2@1+ (1,0) [0|0] "" Vector__XXX
 SG_ C_LH_Folding_SW : 0|2@1+ (1,0) [0|0] "" Vector__XXX
 SG_ DrvIMS_MemoryP1Req : 0|2@1+ (1,0) [0|0] "" Vector__XXX
 SG_ DrvIMS_MemoryP2Req : 0|2@1+ (1,0) [0|0] "" Vector__XXX
 SG_ DrvIMS_MemorySetEnaSta : 0|2@1+ (1,0) [0|0] "" Vector__XXX
 SG_ DrvIMS_PlyBckP1Req : 0|2@1+ (1,0) [0|0] "" Vector__XXX
 SG_ DrvIMS_PlyBckP2Req : 0|2@1+ (1,0) [0|0] "" Vector__XXX
 SG_ DrvIMS_PlyBckStpReq : 0|2@1+ (1,0) [0|0] "" Vector__XXX
 SG_ SmrtIMS_PlyBckReq : 0|12@1+ (1,0) [0|0] "" Vector__XXX
 SG_ SmrtIMS_ImgDBVal : 0|5@1+ (1,0) [0|0] "" Vector__XXX
 SG_ SmrtIMS_PlyBckStpReq : 0|2@1+ (1,0) [0|0] "" Vector__XXX
 SG_ SmrtIMS_EnterSwSta : 0|2@1+ (1,0) [0|0] "" Vector__XXX
 SG_ DrvIMS_BzrReq : 0|2@1+ (1,0) [0|0] "" Vector__XXX
 SG_ DrvIMS_NotPWrngDis : 0|2@1+ (1,0) [0|0] "" Vector__XXX
 SG_ C_TeleCrankingCmdIBOX : 0|2@1+ (1,0) [0|0] "" Vector__XXX
 SG_ SWRC_Crc2Val : 0|8@1+ (1,0) [0|0] "" Vector__XXX
 SG_ Audio_VolEncoderSta : 0|8@1+ (1,0) [0|0] "" Vector__XXX
 SG_ Cluster_ScrlEncoderSta : 0|8@1+ (1,0) [0|0] "" Vector__XXX
 SG_ IFSref_VehRtAngl2Val : 0|9@1+ (0.1,-20) [0|0] "Deg" Vector__XXX
 SG_ IFSref_VehLftAngl3Val : 0|9@1+ (0.1,-20) [0|0] "Deg" Vector__XXX
 SG_ IFSref_VehRtAngl3Val : 0|9@1+ (0.1,-20) [0|0] "Deg" Vector__XXX
 SG_ IFSref_VehLftAngl4Val : 0|9@1+ (0.1,-20) [0|0] "Deg" Vector__XXX
 SG_ IFSref_VehRtAngl4Val : 0|9@1+ (0.1,-20) [0|0] "Deg" Vector__XXX
 SG_ IFSref_VehLftAngl5Val : 0|9@1+ (0.1,-20) [0|0] "Deg" Vector__XXX
 SG_ IFSref_VehRtAngl5Val : 0|9@1+ (0.1,-20) [0|0] "Deg" Vector__XXX
 SG_ DAU_Crc1Val : 0|8@1+ (1,0) [0|0] "" Vector__XXX
 SG_ DoorLock_CtrlDrLkSwSta : 0|2@1+ (1,0) [0|0] "" Vector__XXX
 SG_ DoorLock_CtrlDrUnLkSwSta : 0|2@1+ (1,0) [0|0] "" Vector__XXX
 SG_ IFSref_VehLftAngl9Val : 0|9@1+ (1,0) [0|0] "" Vector__XXX
 SG_ IFSref_VehLftAngl6Val : 0|9@1+ (0.1,-20) [0|0] "Deg" Vector__XXX
 SG_ IFSref_VehRtAngl6Val : 0|9@1+ (0.1,-20) [0|0] "Deg" Vector__XXX
 SG_ IFSref_VehLftAngl7Val : 0|9@1+ (0.1,-20) [0|0] "Deg" Vector__XXX
 SG_ IFSref_VehRtAngl7Val : 0|9@1+ (0.1,-20) [0|0] "Deg" Vector__XXX
 SG_ IFSref_VehLftAngl8Val : 0|9@1+ (0.1,-20) [0|0] "Deg" Vector__XXX
 SG_ IFSref_VehRtAngl8Val : 0|9@1+ (0.1,-20) [0|0] "Deg" Vector__XXX
 SG_ FR_CMR_AlvCnt4Val : 0|8@1+ (1,0) [0|0] "" Vector__XXX
 SG_ IFSref_VehDst1Val : 0|4@1+ (1,0) [0|0] "" Vector__XXX
 SG_ FR_CMR_Crc4Val : 0|16@1+ (1,0) [0|0] "" Vector__XXX
 SG_ IFSref_FR_CMR_Sta : 0|2@1+ (1,0) [0|0] "" Vector__XXX
 SG_ IFSref_VehNumVal : 0|4@1+ (1,0) [0|0] "" Vector__XXX
 SG_ IFSref_ILLAmbtSta : 0|2@1+ (0.1,0) [0|0] "" Vector__XXX
 SG_ IFSref_VehLftAngl1Val : 0|9@1+ (0.1,-20) [0|0] "Deg" Vector__XXX
 SG_ IFSref_VehRtAngl1Val : 0|9@1+ (0.1,-20) [0|0] "Deg" Vector__XXX
 SG_ IFSref_VehLftAngl2Val : 0|9@1+ (0.1,-20) [0|0] "Deg" Vector__XXX
 SG_ Navi_TunnelDistance : 0|10@1+ (1,0) [0|0] "m" Vector__XXX
 SG_ Navi_TunnelRoadClass : 0|3@1+ (1,0) [0|0] "" Vector__XXX
 SG_ Navi_TunnelExist : 0|2@1+ (1,0) [0|0] "" Vector__XXX
 SG_ Navi_ParkingLot : 0|2@1+ (1,0) [0|0] "" Vector__XXX
 SG_ HU_DistanceUnit : 0|2@1+ (1,0) [0|0] "" Vector__XXX
 SG_ HU_AliveStatus : 0|2@1+ (1,0) [0|0] "" Vector__XXX
 SG_ HU_MicActivity : 0|2@1+ (1,0) [0|0] "" Vector__XXX
 SG_ AVN_RSPA_CancelInput : 0|2@1+ (1,0) [0|0] "" Vector__XXX
 SG_ AVN_RSPA_ModeSetStat : 0|4@1+ (1,0) [0|0] "" Vector__XXX
 SG_ HU_TempUnit : 0|2@1+ (1,0) [0|0] "" Vector__XXX
 SG_ AVN_RSPA_Disp_Rdy : 0|2@1+ (1,0) [0|0] "" Vector__XXX
 SG_ HazardFromHUSVM : 0|2@1+ (1,0) [0|0] "" Vector__XXX
 SG_ OMUOSMirCtrl : 0|2@1+ (1,0) [0|0] "" Vector__XXX
 SG_ AVN_PDW_Input : 0|2@1+ (1,0) [0|0] "" Vector__XXX
 SG_ AVN_RSPA_Input : 0|2@1+ (1,0) [0|0] "" Vector__XXX
 SG_ AVN_ParkingSW : 0|3@1+ (1,0) [0|0] "" Vector__XXX
 SG_ SMK_Crc1Val : 0|8@1+ (1,0) [0|0] "" Vector__XXX
 SG_ SMK_AlvCnt1Val : 0|4@1+ (1,0) [0|0] "" Vector__XXX
 SG_ DoorLock_PsvDrLkReq : 0|3@1+ (1,0) [0|0] "" Vector__XXX
 SG_ DoorLock_PsvDrUnLkReq : 0|3@1+ (1,0) [0|0] "" Vector__XXX
 SG_ DoorLock_DrvDrPsvAcsReq : 0|2@1+ (1,0) [0|0] "" Vector__XXX
 SG_ DoorLock_AsstDrPsvAcsReq : 0|2@1+ (1,0) [0|0] "" Vector__XXX
 SG_ DoorLock_TrnkTlgtPsvAcsReq : 0|2@1+ (1,0) [0|0] "" Vector__XXX
 SG_ Auth_Req : 0|3@1+ (1,0) [0|0] "" Vector__XXX
 SG_ RSPA_CanTmotFlagSta : 0|2@1+ (1,0) [0|0] "" Vector__XXX
 SG_ Mirror_SmrtWlcmMirrReq : 0|2@1+ (1,0) [0|0] "" Vector__XXX
 SG_ RKE_Crc1Val : 0|8@1+ (1,0) [0|0] "" Vector__XXX
 SG_ RKE_AlvCnt1Val : 0|4@1+ (1,0) [0|0] "" Vector__XXX
 SG_ RKE_BtnReq : 0|4@1+ (1,0) [0|0] "" Vector__XXX
 SG_ RKE_WdwUpDnReq : 0|3@1+ (1,0) [0|0] "" Vector__XXX
 SG_ RKE_ID : 0|3@1+ (1,0) [0|0] "" Vector__XXX
 SG_ IAU_NFCWPCDeviceScanReq : 0|2@1+ (1,0) [0|0] "" Vector__XXX
 SG_ IAU_LftDrHndLockSnsrSta : 0|2@1+ (1,0) [0|0] "" Vector__XXX
 SG_ IAU_LftDrHndUnlockSnsrSta : 0|2@1+ (1,0) [0|0] "" Vector__XXX
 SG_ IAU_RtDrHndLockSnsrSta : 0|2@1+ (1,0) [0|0] "" Vector__XXX
 SG_ IAU_RtDrHndUnlockSnsrSta : 0|2@1+ (1,0) [0|0] "" Vector__XXX
 SG_ IAU_LftDrHndWlightSta : 0|2@1+ (1,0) [0|0] "" Vector__XXX
 SG_ IAU_RtDrHndWlightSta : 0|2@1+ (1,0) [0|0] "" Vector__XXX
 SG_ IAU_AuthDevice : 0|3@1+ (2,0) [0|0] "" Vector__XXX
 SG_ IAU_AuthResult : 0|3@1+ (1,0) [0|0] "" Vector__XXX
 SG_ IAU_Msg01Develop0Val : 0|8@1+ (1,0) [0|0] "" Vector__XXX
 SG_ IAU_Msg01Develop1Val : 0|8@1+ (1,0) [0|0] "" Vector__XXX
 SG_ IAU_Msg01Develop2Val : 0|8@1+ (1,0) [0|0] "" Vector__XXX
 SG_ IAU_Msg01Develop3Val : 0|8@1+ (1,0) [0|0] "" Vector__XXX
 SG_ IAU_Msg01Develop4Val : 0|8@1+ (1,0) [0|0] "" Vector__XXX
 SG_ IAU_Msg01Develop5Val : 0|8@1+ (1,0) [0|0] "" Vector__XXX
 SG_ IAU_Msg01Develop6Val : 0|8@1+ (1,0) [0|0] "" Vector__XXX
 SG_ IAU_Msg01Develop7Val : 0|8@1+ (1,0) [0|0] "" Vector__XXX
 SG_ IAU_FOBSrch : 0|3@1+ (1,0) [0|0] "" Vector__XXX
 SG_ IAU_RandomNumVal : 0|48@1+ (1,0) [0|0] "" Vector__XXX
 SG_ WHL_SpdFLVal : 0|14@1+ (0.03125,0) [0|0] "km^h" Vector__XXX
 SG_ WHL_SpdFRVal : 0|14@1+ (0.03125,0) [0|0] "km^h" Vector__XXX
 SG_ WHL_SpdRLVal : 0|14@1+ (0.03125,0) [0|0] "km^h" Vector__XXX
 SG_ WHL_SpdRRVal : 0|14@1+ (0.03125,0) [0|0] "km^h" Vector__XXX
 SG_ WHL_Crc1Val : 0|16@1+ (1,0) [0|0] "" Vector__XXX
 SG_ WHL_AlvCnt1Val : 0|8@1+ (1,0) [0|0] "" Vector__XXX
 SG_ WHL_PlsFLVal : 0|8@1+ (0.5,0) [0|0] "pulse count" Vector__XXX
 SG_ WHL_PlsFRVal : 0|8@1+ (0.5,0) [0|0] "pulse count" Vector__XXX
 SG_ WHL_PlsRLVal : 0|8@1+ (0.5,0) [0|0] "pulse count" Vector__XXX
 SG_ WHL_PlsRRVal : 0|8@1+ (0.5,0) [0|0] "pulse count" Vector__XXX
 SG_ WHL_DirFLVal : 0|2@1+ (1,0) [0|0] "" Vector__XXX
 SG_ WHL_DirFRVal : 0|2@1+ (1,0) [0|0] "" Vector__XXX
 SG_ WHL_DirRLVal : 0|2@1+ (1,0) [0|0] "" Vector__XXX
 SG_ WHL_DirRRVal : 0|2@1+ (1,0) [0|0] "" Vector__XXX
 SG_ ENG_TrgtIdleRpmVal : 0|8@1+ (10,0) [0|0] "rpm" Vector__XXX
 SG_ ENG_GearShftUpDis : 0|2@1+ (1,0) [0|0] "" Vector__XXX
 SG_ ENG_GearShftDnDis : 0|2@1+ (1,0) [0|0] "" Vector__XXX
 SG_ ENG_DsrGearPosDis : 0|4@1+ (1,0) [0|0] "" Vector__XXX
 SG_ ENG_SldFuncSta : 0|2@1+ (1,0) [0|0] "" Vector__XXX
 SG_ ENG_SldActnSta : 0|2@1+ (1,0) [0|0] "" Vector__XXX
 SG_ ENG_FuelTnkPrsrSta : 0|2@1+ (1,0) [0|0] "" Vector__XXX
 SG_ ENG_IsgBzrReq : 0|2@1+ (1,0) [0|0] "" Vector__XXX
 SG_ ENG_IsgFuelCnsmptDis : 0|2@1+ (1,0) [0|0] "" Vector__XXX
 SG_ ENG_FuelCapOpnSta : 0|2@1+ (1,0) [0|0] "" Vector__XXX
 SG_ ENG_EcoDrvActvSta : 0|2@1+ (1,0) [0|0] "" Vector__XXX
 SG_ ENG_EngRunSta : 0|2@1+ (1,0) [0|0] "" Vector__XXX
 SG_ ENG_Isg2Sta : 0|2@1+ (2,0) [0|0] "" Vector__XXX
 SG_ ENG_IgnOnSta : 0|2@1+ (1,0) [0|0] "" Vector__XXX
 SG_ ENG_Ack4TcsSta : 0|2@1+ (1,0) [0|0] "" Vector__XXX
 SG_ ENG_FuelCutOffSta : 0|2@1+ (1,0) [0|0] "" Vector__XXX
 SG_ ENG_CrctTqSta : 0|2@1+ (1,0) [0|0] "" Vector__XXX
 SG_ ENG_AirCompRlySta : 0|2@1+ (1,0) [0|0] "" Vector__XXX
 SG_ ENG_LnchCntrlSta : 0|3@1+ (1,0) [0|0] "" Vector__XXX
 SG_ ENG_EngSpdVal : 0|16@1+ (0.25,0) [0|0] "rpm" Vector__XXX
 SG_ ENG_FuelCnsmptVal : 0|16@1+ (0.128,0) [0|0] "ul" Vector__XXX
 SG_ ENG_TrgtFuelPmpPrsrVal : 0|8@1+ (3.137254902,0) [0|0] "kPa" Vector__XXX
 SG_ ENG_VehSpdHiVal : 0|9@1+ (1,0) [0|0] "km/h" Vector__XXX
 SG_ ENG_VehSpdLimVal : 0|9@1+ (1,0) [0|0] "km/h" Vector__XXX
 SG_ HUD_Crc1Val : 0|16@1+ (1,0) [0|0] "" Vector__XXX
 SG_ HUD_AlvCnt1Val : 0|8@1+ (1,0) [0|0] "" Vector__XXX
 SG_ HUD_HghtSta : 0|5@1+ (1,0) [0|0] "" Vector__XXX
 SG_ HUD_PbackSta : 0|3@1+ (1,0) [0|0] "" Vector__XXX
 SG_ HUD_BrgtnsSta : 0|5@1+ (1,0) [0|0] "" Vector__XXX
 SG_ HUD_Type : 0|2@1+ (1,0) [0|0] "" Vector__XXX
 SG_ HUD_RotatSta : 0|5@1+ (1,0) [0|0] "" Vector__XXX
 SG_ HUD_setSW : 0|2@1+ (1,0) [0|0] "" Vector__XXX
 SG_ HUD_ContentsTBTStatus : 0|2@1+ (1,0) [0|0] "" Vector__XXX
 SG_ HUD_ContentsDISStatus : 0|2@1+ (1,0) [0|0] "" Vector__XXX
 SG_ HUD_ContentsSCCStatus : 0|2@1+ (1,0) [0|0] "" Vector__XXX
 SG_ HUD_ContentsLKA_LDWStatus : 0|2@1+ (1,0) [0|0] "" Vector__XXX
 SG_ HUD_ContentsBCWStatus : 0|2@1+ (1,0) [0|0] "" Vector__XXX
 SG_ HUD_ContentsAVStatus : 0|2@1+ (1,0) [0|0] "" Vector__XXX
 SG_ HUD_FontColorStatus : 0|2@1+ (1,0) [0|0] "" Vector__XXX
 SG_ HUD_FontSizeStatus : 0|2@1+ (1,0) [0|0] "" Vector__XXX
 SG_ EMS_Crc1Val : 0|16@1+ (1,0) [0|0] "" Vector__XXX
 SG_ EMS_AlvCnt1Val : 0|8@1+ (1,0) [0|0] "" Vector__XXX
 SG_ ENG_CrctEngTqVal : 0|12@1- (1,0) [0|0] "Nm" Vector__XXX
 SG_ ENG_StndTqRatioVal : 0|8@1+ (0.0078,0) [0|0] "" Vector__XXX
 SG_ ENG_FrctTqVal : 0|12@1- (1,0) [0|0] "Nm" Vector__XXX
 SG_ ENG_IndTqVal : 0|12@1- (1,0) [0|0] "Nm" Vector__XXX
 SG_ ENG_IndTqBVal : 0|12@1- (1,0) [0|0] "Nm" Vector__XXX
 SG_ ENG_EngSpdErrSta : 0|2@1+ (1,0) [0|0] "" Vector__XXX
 SG_ ENG_MafErrSta : 0|2@1+ (1,0) [0|0] "" Vector__XXX
 SG_ ENG_EtcLmphModSta : 0|2@1+ (1,0) [0|0] "" Vector__XXX
 SG_ ENG_MaxAirconTqVal : 0|8@1+ (0.2,0) [0|0] "Nm" Vector__XXX

CM_ SG_ 3221225472 BCM_SolSnsrLftOutVoltVal "BCM_SolarSensorLeftOutputVoltageValue ##2G##BCM - BCMmsg24 - C_PhotosensorLH";
CM_ SG_ 3221225472 BCM_RVMSw "BCM_RearVeiwMonitorSwitch ##2G##BCM - BCMmsg18 - C_RVMSw";
CM_ SG_ 3221225472 BCM_GearPosPSta "BCM_GearPositionPStatus ##2G##BCM - BCMmsg17 - C_PpositiOn";
CM_ SG_ 3221225472 BCM_SunRoofOpnSta "BCM_SunRoofOpenStatus ##2G##BCM - BCMmsg20 - C_SunRoofOpenState";
CM_ SG_ 3221225472 IAU_PhoneBDAdrRcvSta "Phone BD address received or not when Driver Side DR unlocked by Phone.";
CM_ SG_ 3221225472 IAU_PhoneBDAdrVal "Phone BD Address received when Driver Side DR Unlocked by Phone";
CM_ SG_ 3221225472 ILCU_LH_Crc1Val "ILCU_LH_CyclicRedundancyCheck1Value";
CM_ SG_ 3221225472 ILCU_LH_AlvCnt1Val "ILCU_LH_AliveCounter1Value";
CM_ SG_ 3221225472 ILCULH_LowBeamAct_Sta "LH Lowbeam activation feedback";
CM_ SG_ 3221225472 ILCULH_LowBeamLED_Sta "LH Lowbeam LED status feedback";
CM_ SG_ 3221225472 ILCULH_PstnAct_Sta "LH Front PSTN activation feedback";
CM_ SG_ 3221225472 ILCULH_PstnLED_Sta "LH Front PSTN LED status feedback";
CM_ SG_ 3221225472 ILCULH_HighBeamAct_Sta "LH Highbeam activation feedback";
CM_ SG_ 3221225472 ILCULH_HighBeamLED_Sta "LH Highbeam LED status feedback";
CM_ SG_ 3221225472 ILCULH_DRLAct_Sta "LH DRL activation feedback";
CM_ SG_ 3221225472 ILCULH_DRLLED_Sta "LH DRL LED status feedback";
CM_ SG_ 3221225472 ILCULH_FrontTurnAct_Sta "LH Front turn tell-tale";
CM_ SG_ 3221225472 ILCULH_FrontTurnLED_Sta "LH Front turn LED status feedback";
CM_ SG_ 3221225472 ILCULH_System_Sta "ILCU_LH System status";
CM_ SG_ 3221225472 ILCULH_IFSOpt_Sta "LH IFS Optioin Status";
CM_ SG_ 3221225472 ILCULH_IFSLamp_Act "LH IFS activation status feedback";
CM_ SG_ 3221225472 ILCULH_IFSSysState_Sta "LH IFS System status";
CM_ SG_ 3221225472 ILCULH_IFSWarning_Sta "LH IFS warning activation feedback";
CM_ SG_ 3221225472 ILCU_RH_Crc1Val "ILCU_RH_CyclicRedundancyCheck1Value";
CM_ SG_ 3221225472 ILCU_RH_AlvCnt1Val "ILCU_RH_AliveCounter1Value";
CM_ SG_ 3221225472 ILCURH_LowBeamAct_Sta "RH Lowbeam activation feedback";
CM_ SG_ 3221225472 ILCURH_LowBeamLED_Sta "RH Lowbeam LED status feedback";
CM_ SG_ 3221225472 ILCURH_PstnAct_Sta "RH Front PSTN activation feedback";
CM_ SG_ 3221225472 ILCURH_PstnLED_Sta "RH Front PSTN LED status feedback";
CM_ SG_ 3221225472 ILCURH_HighBeamAct_Sta "RH Highbeam activation feedback";
CM_ SG_ 3221225472 ILCURH_HighBeamLED_Sta "RH Highbeam LED status feedback";
CM_ SG_ 3221225472 ILCURH_DRLAct_Sta "RHDRL activation feedback";
CM_ SG_ 3221225472 ILCURH_DRLLED_Sta "RH DRL LED status feedback";
CM_ SG_ 3221225472 ILCURH_FrontTurnAct_Sta "RH Front turn tell-tale";
CM_ SG_ 3221225472 ILCURH_FrontTurnLED_Sta "RH Front turn LED status feedback";
CM_ SG_ 3221225472 ILCURH_System_Sta "ILCU_RH System status";
CM_ SG_ 3221225472 ILCURH_IFSOpt_Sta "RH IFS Optioin Status";
CM_ SG_ 3221225472 ILCURH_IFSLamp_Act "RH IFS activation status feedback";
CM_ SG_ 3221225472 ILCURH_IFSSysState_Sta "RH IFS System status";
CM_ SG_ 3221225472 ILCURH_IFSWarning_Sta "RH IFS warning activation feedback";
CM_ SG_ 3221225472 DATC_Crc11Val "DATC_CyclicRedundancyCheck11Value";
CM_ SG_ 3221225472 DATC_AlvCnt11Val "DATC_AliveCounter11Value";
CM_ SG_ 3221225472 DATC_TunnelFuncOff4AutoDfgReq "DATC_TunnelFunctionOffForAutoDefogRequest";
CM_ SG_ 3221225472 DATC_ArClnSysSta "DATC_AirCleanSystemStatus";
CM_ SG_ 3221225472 DATC_DrvrStHtrUSMSta "DATC_DriverSeatHeaterUSMStatus";
CM_ SG_ 3221225472 IAU_EncryptedResult2Val "This signal is for a send enrypted result of IAU.";
CM_ SG_ 3221225472 SMK_Crc4Val "SMK_CyclicRedundancyCheck4Value";
CM_ SG_ 3221225472 SMK_AlvCnt4Val "SMK_AliveCounter4Value";
CM_ SG_ 3221225472 Warn_StrtStpBtnWrngSta "Warn_StartStopButtonWarningStatus ##2G##SMK - SMKmsg17 - C_SSBWarn";
CM_ SG_ 3221225472 Warn_DeActvWrngSta "Warn_DeActivationWarningStatus ##2G##SMK - SMKmsg17 - C_DeactivationWarn";
CM_ SG_ 3221225472 Warn_ExtrnlBuzWrngSta "Warn_ExternalBuzzelWarningStatus ##2G##SMK - SMKmsg17 - C_SMKExtBuzWarn";
CM_ SG_ 3221225472 Warn_DisWrngSta "Warn_DisplayWarningStatus ##2G##SMK - SMKmsg17 - C_SMKDispWarn";
CM_ SG_ 3221225472 Warn_GearPosPWrngReq "Warn_GearPositionPWarningRequest ##2G##SMK - SMKmsg17 - C_ShiftPWarn";
CM_ SG_ 3221225472 Warn_IdOutWrngSta "Warn_IdOutWarningStatus ##2G##SMK - SMKmsg17 - C_IDoutWarn";
CM_ SG_ 3221225472 Warn_KeyBattLoWrngSta "Warn_KeyBatteryLowWarningStatus ##2G##SMK - SMKmsg17 - C_KeyBATDischargeWarn";
CM_ SG_ 3221225472 Warn_KeyOutLmpOnReq "Warn_KeyOutLampOnRequest ##2G##SMK - SMKmsg17 - C_KeyoutLp";
CM_ SG_ 3221225472 Warn_NotGearPosPWrngSta "Warn_NotGearPositionPWarningStatus ##2G##SMK - SMKmsg17 - C_VehicleNotPWarn";
CM_ SG_ 3221225472 Warn_EsclFlWrngSta "Warn_EsclFailWarningStatus ##2G##SMK - SMKmsg17 - C_ESCLFailWarn";
CM_ SG_ 3221225472 Warn_EsclNotLkWrngSta "Warn_EsclNotLockWarningStatus ##2G##SMK - SMKmsg17 - C_ESCLNotLockedWarn";
CM_ SG_ 3221225472 Warn_EsclNotUnLkWrngSta "Warn_EsclNotUnLockWarningStatus ##2G##SMK - SMKmsg17 - C_ESCLNotUnlockWarn";
CM_ SG_ 3221225472 Warn_ImmoLmpOnReq "Warn_ImmobilizerLampOnRequest ##2G##SMK - SMKmsg17 - C_ImmoLp";
CM_ SG_ 3221225472 RL_SHVU_SeatOptSta "Rear LH Seat Heater/Vent option info";
CM_ SG_ 3221225472 RL_SHVU_SeatHtOperSta "Rear LH Seat Heater/Vent current operation state";
CM_ SG_ 3221225472 RL_CURTAIN_POSITION "Rear Left Curtain Status Position Output";
CM_ SG_ 3221225472 RR_CURTAIN_POSITION "Rear Right Curtain Status Position Output";
CM_ SG_ 3221225472 DLBCU_ActiveDis "DLBCU_ActiveModeDisplay";
CM_ SG_ 3221225472 DLBCU_DrvModUSMSta "DLBCU_DriveModeStatus";
CM_ SG_ 3221225472 DLBCU_ActiveStrSta "DLBCU_ActiveStrengthStatus";
CM_ SG_ 3221225472 DLBCU_ActiveTimeSta "DLBCU_ActiveTimeStatus";
CM_ SG_ 3221225472 DLBCU_CushSoftSta "DLBCU_CushionSoftnessStatus";
CM_ SG_ 3221225472 BCM_Crc11Val "BCM_CyclicRedundancyCheck11Value";
CM_ SG_ 3221225472 BCM_AlvCnt11Val "BCM_AliveCounter11Value";
CM_ SG_ 3221225472 USM_EscrtHdLmpSta "USM_EscortHeadLampStatus ##2G##BCM - BCMmsg21 - C_EscortHLRValue";
CM_ SG_ 3221225472 USM_WlcmMirLtSystTitleOpt "USM_WelcomeMirrLightSystemTitleOption ##2G##BCM - BCMmsg21 - C_WelcomeSysTitleOption";
CM_ SG_ 3221225472 USM_UnlockWlcmSta "USM_UnlockWelcomeStatus ##2G##BCM - BCMmsg21 - C_UnlockWelcomeRValue";
CM_ SG_ 3221225472 USM_SmrtWlcmSta "USM_SmartWelcomeStatus ##2G##BCM - BCMmsg21 - C_SmartWelcomeRValue";
CM_ SG_ 3221225472 USM_RrWiperByGearPosRSta "USM_RearWiperByGearPositionReverseStatus ##2G##BCM - BCMmsg21 - C_RearWiperRValue";
CM_ SG_ 3221225472 USM_RrStRmndSta "USM_RearSeatReminderStatus ##2G##BCM - BCMmsg21 - C_RrSeatRemindRValue";
CM_ SG_ 3221225472 USM_TunlModAutoWdwSta "USM_TunnelModeAutoWindowStatus ##2G##BCM - BCMmsg21 - C_TunnelWindowRValue";
CM_ SG_ 3221225472 IAU_PhoneNumOnWPCVal "Phone Number / Card Number";
CM_ SG_ 3221225472 SMK_Crc5Val "SMK_CyclicRedundancyCheck5Value";
CM_ SG_ 3221225472 SMK_AlvCnt5Val "SMK_AliveCounter5Value";
CM_ SG_ 3221225472 SMK_AsstTgglBtnSta "SMK_AssistToggleButtonStatus ##2G##SMK - SMKmsg19 - C_AstToggleButton";
CM_ SG_ 3221225472 SMK_DrvTglBtnSta "SMK_DriverToggleButtonStatus ##2G##SMK - SMKmsg19 - C_DrvToggleButton";
CM_ SG_ 3221225472 SMK_TgglBtnStuckSta "SMK_ToggleButtonStuckStatus ##2G##SMK - SMKmsg18 - C_ToggleButtonStuck";
CM_ SG_ 3221225472 SMK_BrkSwSta "SMK_BrakeSwitchStatus ##2G##SMK - SMKmsg19 - C_BrakeSW";
CM_ SG_ 3221225472 SMK_GearPosPSwSta "SMK_GearPositionPSwitchStatus ##2G##SMK - SMKmsg19 - C_PpositionClutch";
CM_ SG_ 3221225472 SMK_RpmHiByteVal "SMK_RpmHighByteValue ##2G##SMK - SMKmsg65 - C_RPMHighByte";
CM_ SG_ 3221225472 SMK_RpmLoByteVal "SMK_RpmLowByteValue ##2G##SMK - SMKmsg65 - C_RPMLowByte";
CM_ SG_ 3221225472 SMK_VehSpdDrctVal "SMK_VehicleSpeedDirectValue ##2G##SMK - SMKmsg65 - C_VehicleSpeedDirect";
CM_ SG_ 3221225472 IAU_DigitalKeyOpt "Digital Key Option Signal";
CM_ SG_ 3221225472 IAU_NFCDeviceDetectionSta "NFC Device Detection Status (Door Handle, WPC)";
CM_ SG_ 3221225472 IAU_PhoneAuthSta "IAU Phone Authentication Process state";
CM_ SG_ 3221225472 IAU_ProfileIDParingRVal "This signal Indicate if the Current ProfileID is paired with Digital Key Device or not.";
CM_ SG_ 3221225472 IAU_ProfileIDRVal "This signal Indicate the Current detected Profile ID by IAU.";
CM_ SG_ 3221225472 IAU_DigitalKeyProcessingSta "Digital Key USM settitng Process State";
CM_ SG_ 3221225472 IAU_DigitalKeyExit "Digital Key USM setting Exit Condition";
CM_ SG_ 3221225472 IAU_DigitalKeyEnblRVal "Digital Key Function Enable / Disable flag (Fob is required for changing flag)";
CM_ SG_ 3221225472 IAU_OwnerPhnRegRVal "Vehicle Owner's Phone is Registered for Digital Key function";
CM_ SG_ 3221225472 IAU_NFCCard1RegRVal "NFC Card 1 is Registered for Digital Key function";
CM_ SG_ 3221225472 IAU_NFCCard2RegRVal "NFC Card 2 is Registered for Digital Key function";
CM_ SG_ 3221225472 IAU_RdyToSendAuthDataSta "This signal is sent when IAU is ready to send Authentication data";
CM_ SG_ 3221225472 IAU_OptTyp "IAU Option Info(NFC, FP, BLE, etc)";
CM_ SG_ 3221225472 CF_AVN_PhoneParingNValueSet "SmartPhone Profile Link On/Off Setting";
CM_ SG_ 3221225472 CF_AVN_ProfileIDNValueSet "Current Profile ID Setting Value";
CM_ SG_ 3221225472 NFC_Support_check_request "(BT)NFC_Support_check_request";
CM_ SG_ 3221225472 CF_AVN_DigitKeyEnableNValueSet "Digital Key On/Off Setting(AVN)";
CM_ SG_ 3221225472 CF_AVN_OwnerPhoneNValueSet "Owner SmartPhone Key Registration(AVN)";
CM_ SG_ 3221225472 CF_AVN_NFCCard1NValueSet "NFC Card 1 Registration(AVN)";
CM_ SG_ 3221225472 CF_AVN_NFCCard2NValueSet "NFC Card 2 Registration(AVN)";
CM_ SG_ 3221225472 CF_AVN_IMSProfileNValueSet "Current Profile IMS Setting";
CM_ SG_ 3221225472 CF_AVN_DigitalKeyMenuExit "Exit setting menu (by AVN)";
CM_ SG_ 3221225472 BCM_Crc1Val "BCM_CyclicRedundancyCheck1Value";
CM_ SG_ 3221225472 BCM_AlvCnt1Val "BCM_AliveCounter1Value";
CM_ SG_ 3221225472 BAlarm_AutoLockrReq "BAlarm_AutoLockRequest ##2G##BCM - BCMmsg01 - C_AutoLockCmd";
CM_ SG_ 3221225472 C_RH_Unfolding_SW "3rd RH Seat Unfolding Switch";
CM_ SG_ 3221225472 C_RH_Folding_SW "3rd RH Seat Folding Switch";
CM_ SG_ 3221225472 C_LH_Unfolding_SW "3rd LH Seat Unfolding Switch";
CM_ SG_ 3221225472 C_LH_Folding_SW "3RD LH Seat Folding Swtich";
CM_ SG_ 3221225472 DrvIMS_MemoryP1Req "PSM_DriverSeatPositionMemoryP1Request";
CM_ SG_ 3221225472 DrvIMS_MemoryP2Req "PSM_DriverSeatPositionMemoryP2Request";
CM_ SG_ 3221225472 DrvIMS_MemorySetEnaSta "PSM_MemorySetEnableStatus";
CM_ SG_ 3221225472 DrvIMS_PlyBckP1Req "PSM_PlayBackP1Request";
CM_ SG_ 3221225472 DrvIMS_PlyBckP2Req "PSM_PlayBackP2Request";
CM_ SG_ 3221225472 DrvIMS_PlyBckStpReq "PSM_PlayBackStopRequest";
CM_ SG_ 3221225472 SmrtIMS_PlyBckReq "HCIMS_PlayBackRequest";
CM_ SG_ 3221225472 SmrtIMS_ImgDBVal "Smart IMS image DB number";
CM_ SG_ 3221225472 SmrtIMS_PlyBckStpReq "HCIMS_Status";
CM_ SG_ 3221225472 SmrtIMS_EnterSwSta "Smart IMS switch on using IMS switch";
CM_ SG_ 3221225472 DrvIMS_BzrReq "PSM_DriverSeatImsBuzzerRequest";
CM_ SG_ 3221225472 DrvIMS_NotPWrngDis "Warning about shift lever not located on P position";
CM_ SG_ 3221225472 C_TeleCrankingCmdIBOX "Command for Remote Cranking
(C_SMKTeleEngineRunning@0x15E is feedback signal)";
CM_ SG_ 3221225472 SWRC_Crc2Val "SWRC_CyclicRedundancyCheck2Value";
CM_ SG_ 3221225472 Audio_VolEncoderSta "Audio_VolumeScrollSwitchStatus";
CM_ SG_ 3221225472 Cluster_ScrlEncoderSta "Cluster_ScrollSwitchStatus";
CM_ SG_ 3221225472 IFSref_VehRtAngl2Val "IFSref_VehicleRightAngle2Value";
CM_ SG_ 3221225472 IFSref_VehLftAngl3Val "IFSref_VehicleLeftAngle3Value";
CM_ SG_ 3221225472 IFSref_VehRtAngl3Val "IFSref_VehicleRightAngle3Value";
CM_ SG_ 3221225472 IFSref_VehLftAngl4Val "IFSref_VehicleLeftAngle4Value";
CM_ SG_ 3221225472 IFSref_VehRtAngl4Val "IFSref_VehicleRightAngle4Value";
CM_ SG_ 3221225472 IFSref_VehLftAngl5Val "IFSref_VehicleLeftAngle5Value";
CM_ SG_ 3221225472 IFSref_VehRtAngl5Val "IFSref_VehicleRightAngle5Value";
CM_ SG_ 3221225472 DAU_Crc1Val "DAU_CyclicRedundancyCheck1Value";
CM_ SG_ 3221225472 DoorLock_CtrlDrLkSwSta "DoorLock_CentralDoorLockSwitchStatus ##2G##DDM -  - C_CtrDrLockSWDDM";
CM_ SG_ 3221225472 DoorLock_CtrlDrUnLkSwSta "DoorLock_CentralDoorUnLockSwitchStatus ##2G##DDM -  - C_CtrDrUnLockSWDDM";
CM_ SG_ 3221225472 IFSref_VehLftAngl6Val "IFSref_VehicleLeftAngle6Value";
CM_ SG_ 3221225472 IFSref_VehRtAngl6Val "IFSref_VehicleRightAngle6Value";
CM_ SG_ 3221225472 IFSref_VehLftAngl7Val "IFSref_VehicleLeftAngle7Value";
CM_ SG_ 3221225472 IFSref_VehRtAngl7Val "IFSref_VehicleRightAngle7Value";
CM_ SG_ 3221225472 IFSref_VehLftAngl8Val "IFSref_VehicleLeftAngle8Value";
CM_ SG_ 3221225472 IFSref_VehRtAngl8Val "IFSref_VehicleRightAngle8Value";
CM_ SG_ 3221225472 FR_CMR_Crc4Val "FR_CMR_CyclicRedundancyCheck4Value";
CM_ SG_ 3221225472 IFSref_FR_CMR_Sta "IFSref_FR_CMR_Status";
CM_ SG_ 3221225472 IFSref_VehNumVal "IFSref_VehicleNumberValue";
CM_ SG_ 3221225472 IFSref_ILLAmbtSta "IFSref_IlluminationAmbientStatus";
CM_ SG_ 3221225472 IFSref_VehLftAngl1Val "IFSref_VehicleLeftAngle1Value";
CM_ SG_ 3221225472 IFSref_VehRtAngl1Val "IFSref_VehicleRightAngle1Value";
CM_ SG_ 3221225472 IFSref_VehLftAngl2Val "IFSref_VehicleLeftAngle2Value";
CM_ SG_ 3221225472 Navi_TunnelDistance "Distnace to tunnel";
CM_ SG_ 3221225472 Navi_TunnelRoadClass "Road class information";
CM_ SG_ 3221225472 Navi_TunnelExist "Tunnel exist Information";
CM_ SG_ 3221225472 Navi_ParkingLot "Parking Lot Information";
CM_ SG_ 3221225472 HU_DistanceUnit "Request to set CLU Distance Unit";
CM_ SG_ 3221225472 HU_AliveStatus "Information of the status of Head Unit
0x00 : Headunit is booting so, Headunit cant display any state
0x01 : Headunit is normal state, Headunit could display according to MM CAN  command.
0x02 : Headunit is doing their internal process, so Headunit cant communicate with other node.
For CLU/SCC/eCall
-AVN System transmission signal";
CM_ SG_ 3221225472 HU_MicActivity "HU send this signal to eCall for MIC using status.
eCall unit stop the diagonosis when received 0x1:Activated from HU
Otherwise, eCall unit keep diagnosis every 1 sec. and HU can not use MIC";
CM_ SG_ 3221225472 AVN_RSPA_CancelInput "Request Signal to cancel RSPA function";
CM_ SG_ 3221225472 AVN_RSPA_ModeSetStat "Signal for User's RSPA mode setting
RSPA 모드 선택 메뉴 선택 결과 (최좌측 기준)";
CM_ SG_ 3221225472 HU_TempUnit "Request to set DATC/CLU temperature unit";
CM_ SG_ 3221225472 AVN_RSPA_Disp_Rdy "Signal to inform RSPA of AVN's display ready status
(RSPA 화면 표시 가능/불가능 상태를 알리기 위한 신호)";
CM_ SG_ 3221225472 HazardFromHUSVM "This signal is for Hazard control";
CM_ SG_ 3221225472 OMUOSMirCtrl "This signal is for the OutSide Mirror Control (Fold or Unfold)";
CM_ SG_ 3221225472 AVN_PDW_Input "This signal is for the PDW softkey";
CM_ SG_ 3221225472 AVN_RSPA_Input "This signal means RSPA softkey input(on/off)";
CM_ SG_ 3221225472 AVN_ParkingSW "This signal means whether ParkingSwich pressed or not";
CM_ SG_ 3221225472 SMK_Crc1Val "SMK_CyclicRedundancyCheck1Value";
CM_ SG_ 3221225472 SMK_AlvCnt1Val "SMK_AliveCounter1Value";
CM_ SG_ 3221225472 DoorLock_PsvDrLkReq "DoorLock_PassiveDoorLockRequest ##2G##SMK - SMKmsg01 - C_PassiveAccessLock";
CM_ SG_ 3221225472 DoorLock_PsvDrUnLkReq "DoorLock_PassiveDoorUnLockRequest ##2G##SMK - SMKmsg01 - C_PassiveAccessUnlock";
CM_ SG_ 3221225472 DoorLock_DrvDrPsvAcsReq "DoorLock_DriverDoorPassiveAccessRequest ##2G##SMK - SMKmsg01 - C_PassiveFrtDrv";
CM_ SG_ 3221225472 DoorLock_AsstDrPsvAcsReq "DoorLock_AssistDoorPassiveAccessRequest ##2G##SMK - SMKmsg01 - C_PassiveFrtAst";
CM_ SG_ 3221225472 DoorLock_TrnkTlgtPsvAcsReq "DoorLock_TrunkTailgatePassiveAccessRequest ##2G##SMK - SMKmsg01 - C_PassiveTrunkTg";
CM_ SG_ 3221225472 Auth_Req "Authentication_Request ##2G##SMK - SMKmsg03 - C_SMK_AuthReq";
CM_ SG_ 3221225472 RSPA_CanTmotFlagSta "RSPA_CANTimeoutFlagStatus ##2G##SMK - SMKmsg18 - C_RSPATimeoutFlag";
CM_ SG_ 3221225472 Mirror_SmrtWlcmMirrReq "Mirror_SmartWelcomeMirrorRequest ##2G##SMK - SMKmsg01 - C_OSMirrCmdSMK";
CM_ SG_ 3221225472 RKE_Crc1Val "RKE_CyclicRedundancyCheck1Value";
CM_ SG_ 3221225472 RKE_AlvCnt1Val "RKE_AliveCounter1Value";
CM_ SG_ 3221225472 RKE_BtnReq "RemoteKey_ButtonRequest ##2G##BCM - BCMmsg01 - C_RKECmd";
CM_ SG_ 3221225472 RKE_WdwUpDnReq "RemoteKey_WindowUpDownRequest ##2G##BCM - BCMmsg01 - C_WdwComfortCMDBCM";
CM_ SG_ 3221225472 RKE_ID "RemoteKey_ID ##2G##BCM - BCMmsg01 - C_BCMRKEID";
CM_ SG_ 3221225472 IAU_NFCWPCDeviceScanReq "NFC Scan Request Command to WPC(B-CAN)";
CM_ SG_ 3221225472 IAU_LftDrHndLockSnsrSta "Door handle LH Lock Sensor";
CM_ SG_ 3221225472 IAU_LftDrHndUnlockSnsrSta "Door Handle LH Unlock Sensor";
CM_ SG_ 3221225472 IAU_RtDrHndLockSnsrSta "Door Handle RH Lock Sensor";
CM_ SG_ 3221225472 IAU_RtDrHndUnlockSnsrSta "Door Handle RH Unlock Sensor";
CM_ SG_ 3221225472 IAU_LftDrHndWlightSta "Welcome Light LH (Handle) on/off state";
CM_ SG_ 3221225472 IAU_RtDrHndWlightSta "Welcome Light RH (Handle) on/off state";
CM_ SG_ 3221225472 IAU_FOBSrch "Signal to request Fob search to IBU";
CM_ SG_ 3221225472 IAU_RandomNumVal "Random number";
CM_ SG_ 3221225472 WHL_SpdFLVal "WHL_SpeedFrontLeftValue ##2G##ESC - WHL_SPD11 - WHL_SPD_FL";
CM_ SG_ 3221225472 WHL_SpdFRVal "WHL_SpeedFrontRightValue ##2G##ESC - WHL_SPD11 - WHL_SPD_FR";
CM_ SG_ 3221225472 WHL_SpdRLVal "WHL_SpeedRearLeftValue ##2G##ESC - WHL_SPD11 - WHL_SPD_RL";
CM_ SG_ 3221225472 WHL_SpdRRVal "WHL_SpeedRearRightValue ##2G##ESC - WHL_SPD11 - WHL_SPD_RR";
CM_ SG_ 3221225472 WHL_Crc1Val "WHL_CyclicRedundancyCheck1Value";
CM_ SG_ 3221225472 WHL_AlvCnt1Val "WHL_AliveCounter1Value";
CM_ SG_ 3221225472 WHL_PlsFLVal "WHL_PulseFrontLeftValue ##2G##ESC - WHL_PUL11 - WHL_PUL_FL";
CM_ SG_ 3221225472 WHL_PlsFRVal "WHL_PulseFrontRightValue ##2G##ESC - WHL_PUL11 - WHL_PUL_FR";
CM_ SG_ 3221225472 WHL_PlsRLVal "WHL_PulseRearLeftValue ##2G##ESC - WHL_PUL11 - WHL_PUL_RL";
CM_ SG_ 3221225472 WHL_PlsRRVal "WHL_PulseRearRightValue ##2G##ESC - WHL_PUL11 - WHL_PUL_RR";
CM_ SG_ 3221225472 WHL_DirFLVal "WHL_DirectionFrontLeftValue ##2G##ESC - WHL_PUL11 - WHL_DIR_FL";
CM_ SG_ 3221225472 WHL_DirFRVal "WHL_DirectionFrontRightValue ##2G##ESC - WHL_PUL11 - WHL_DIR_FR";
CM_ SG_ 3221225472 WHL_DirRLVal "WHL_DirectionRearLeftValue ##2G##ESC - WHL_PUL11 - WHL_DIR_RL";
CM_ SG_ 3221225472 WHL_DirRRVal "WHL_DirectionRearRightValue ##2G##ESC - WHL_PUL11 - WHL_DIR_RR";
CM_ SG_ 3221225472 ENG_TrgtIdleRpmVal "ENG_TargetIdleRpmValue ##2G##EMS - EMS_H12 - R_NEngIdlTgC";
CM_ SG_ 3221225472 ENG_GearShftUpDis "ENG_GearShiftUpDisplay ##2G##EMS - EMS_H12 - CF_Ems_UpTarGr";
CM_ SG_ 3221225472 ENG_GearShftDnDis "ENG_GearShiftDownDisplay ##2G##EMS - EMS_H12 - CF_Ems_DownTarGr";
CM_ SG_ 3221225472 ENG_DsrGearPosDis "ENG_DesirableGearPositionDisplay ##2G##EMS - EMS_H12 - CF_Ems_DesCurGr";
CM_ SG_ 3221225472 ENG_SldFuncSta "ENG_SpeedLimitFunctionStatus ##2G##EMS - EMS_H12 - CF_Ems_SldAct";
CM_ SG_ 3221225472 ENG_SldActnSta "ENG_SpeedLimitActionStatus ##2G##EMS - EMS_H12 - CF_Ems_SldPosAct";
CM_ SG_ 3221225472 ENG_FuelTnkPrsrSta "ENG_FuelTankPressureStatus ##2G##EMS - EMS_H12 - CF_Ems_HPresStat";
CM_ SG_ 3221225472 ENG_IsgBzrReq "ENG_IsgBuzzerRequest ##2G##EMS - EMS_H12 - CF_Ems_IsgBuz";
CM_ SG_ 3221225472 ENG_IsgFuelCnsmptDis "ENG_IsgFuelConsumptionDisplay ##2G##EMS - EMS_H12 - CF_Ems_IdlStpFCO";
CM_ SG_ 3221225472 ENG_FuelCapOpnSta "ENG_FuelCapOpenStatus ##2G##EMS - EMS_H12 - CF_Ems_FCopen";
CM_ SG_ 3221225472 ENG_EcoDrvActvSta "ENG_EcoDriveActiveStatus ##2G##EMS - EMS_H12 - CF_Ems_ActEcoAct";
CM_ SG_ 3221225472 ENG_EngRunSta "ENG_EngineRunningStatus ##2G##EMS - EMS_H12 - CF_Ems_EngRunNorm";
CM_ SG_ 3221225472 ENG_Isg2Sta "ENG_Isg2Status ##2G##EMS - EMS_H12 - CF_Ems_IsgStat2";
CM_ SG_ 3221225472 ENG_IgnOnSta "ENG_IgnitionOnStatus ##2G##EMS - EMS11 - SWI_IGK";
CM_ SG_ 3221225472 ENG_Ack4TcsSta "ENG_AcknowledgeForTcsStatus ##2G##EMS - EMS11 - ACK_TCS";
CM_ SG_ 3221225472 ENG_FuelCutOffSta "ENG_FuelCutOffStatus ##2G##EMS - EMS11 - PUC_STAT";
CM_ SG_ 3221225472 ENG_CrctTqSta "ENG_CorrectedTorqueStatus ##2G##EMS - EMS11 - TQ_COR_STAT";
CM_ SG_ 3221225472 ENG_AirCompRlySta "ENG_AirCompressorRelayStatus ##2G##EMS - EMS11 - RLY_AC";
CM_ SG_ 3221225472 ENG_LnchCntrlSta "ENG_LaunchControlStatus";
CM_ SG_ 3221225472 ENG_EngSpdVal "ENG_EngineSpeedValue ##2G##EMS - EMS11 - N";
CM_ SG_ 3221225472 ENG_FuelCnsmptVal "ENG_FuelConsumptionValue ##2G##EMS - EMS20 - FCO";
CM_ SG_ 3221225472 ENG_TrgtFuelPmpPrsrVal "ENG_TargetFuelPumpPressureValue ##2G##EMS - EMS20 - CF_Ems_PumpTPres";
CM_ SG_ 3221225472 ENG_VehSpdHiVal "ENG_VehicleSpeedHighValue";
CM_ SG_ 3221225472 ENG_VehSpdLimVal "ENG_VehicleSpeedLimitValue ##2G##EMS - EMS_H12 - SLD_VS, EMS20-SLD_VS_EXT";
CM_ SG_ 3221225472 HUD_Crc1Val "HUD_CyclicRedundancyCheck1Value";
CM_ SG_ 3221225472 HUD_AlvCnt1Val "HUD_AliveCounter1Value";
CM_ SG_ 3221225472 HUD_HghtSta "HUD_HeightStatus";
CM_ SG_ 3221225472 HUD_PbackSta "HUD_PbackStatus";
CM_ SG_ 3221225472 HUD_BrgtnsSta "HUD_BrightnessStatus";
CM_ SG_ 3221225472 HUD_Type "the type of head up display (ex : combiner type, windshield type)";
CM_ SG_ 3221225472 HUD_RotatSta "HUD_RotateStatus";
CM_ SG_ 3221225472 HUD_setSW "the status of head up display on/off";
CM_ SG_ 3221225472 HUD_ContentsTBTStatus "this signal shows the display contents setting status of TBT on HUD";
CM_ SG_ 3221225472 HUD_ContentsDISStatus "this signal shows the display contents status of DIS on HUD";
CM_ SG_ 3221225472 HUD_ContentsSCCStatus "this signal shows the display contents status of SCC on HUD";
CM_ SG_ 3221225472 HUD_ContentsLKA_LDWStatus "this signal shows the display contents status of LKA/LDW on HUD";
CM_ SG_ 3221225472 HUD_ContentsBCWStatus "this signal shows the display contents status of BCW on HUD";
CM_ SG_ 3221225472 HUD_ContentsAVStatus "this signal shows the display contents status of AV on HUD";
CM_ SG_ 3221225472 HUD_FontColorStatus "this signal shows the font color status of HUD";
CM_ SG_ 3221225472 HUD_FontSizeStatus "this signal the font size status of HUD";
CM_ SG_ 3221225472 EMS_Crc1Val "EMS_CyclicRedundancyCheck1Value";
CM_ SG_ 3221225472 EMS_AlvCnt1Val "EMS_AliveCounter1Value";
CM_ SG_ 3221225472 ENG_CrctEngTqVal "ENG_CorrectedEngineTorqueValue ##2G##EMS - EMS11 - TQI_ACOR";
CM_ SG_ 3221225472 ENG_StndTqRatioVal "ENG_StandardTorqueRatioValue ##2G##EMS - EMS11 - RATIO_TQI_BAS_MAX_STND";
CM_ SG_ 3221225472 ENG_FrctTqVal "ENG_FrictionTorqueValue ##2G##EMS - EMS11 - TQFR";
CM_ SG_ 3221225472 ENG_IndTqVal "ENG_IndicatedTorqueValue ##2G##EMS - EMS11 - TQI";
CM_ SG_ 3221225472 ENG_IndTqBVal "ENG_IndicatedTorqueBValue ##2G##EMS - EMS_H12 - TQI_B";
CM_ SG_ 3221225472 ENG_EngSpdErrSta "ENG_EngineSpeedErrorStatus ##2G##EMS - EMS11 - F_N_ENG";
CM_ SG_ 3221225472 ENG_MafErrSta "ENG_MassAirFlowErrorStatus ##2G##EMS - EMS11 - F_SUB_TQI";
CM_ SG_ 3221225472 ENG_EtcLmphModSta "ENG_EtcLimphomeModeStatus ##2G##EMS - EMS_H12 - CF_Ems_EtcLimpMod";
CM_ SG_ 3221225472 ENG_MaxAirconTqVal "ENG_MaximumAirconTorqueValue ##2G##EMS - EMS_H12 - R_TqAcnApvC";
BA_DEF_ BO_  "UsrMsgIDSforwardDeviation" INT 0 100;
BA_DEF_ BO_  "UsrMsgIDSbackwardDeviation" INT 50 1000;
BA_DEF_ BO_  "GenMsgCycleTime" INT 0 2000;
BA_DEF_ BO_  "GenMsgStartDelayTime" INT 0 2000;
BA_DEF_ BO_  "GenMsgSendType" ENUM  "Cyclic ","NotUsed ","NotUsed ","NotUsed ","NotUsed ","NotUsed ","NotUsed ","IfActive ","NoMsgSendType ","NotUsed","vector_leerstring";
BA_DEF_ BO_  "GenMsgCycleTimeFast" INT 0 500;
BA_DEF_ BO_  "GenMsgILSupport" ENUM  "No","Yes";
BA_DEF_ BO_  "GenMsgNrOfRepetition" INT 0 3;
BA_DEF_ BO_  "VFrameFormat" ENUM  "StandardCAN","ExtendedCAN","reserved","reserved","reserved","reserved","reserved","reserved","reserved","reserved","reserved","reserved","reserved","reserved","StandardCAN_FD","ExtendedCAN_FD";
BA_DEF_ SG_  "UserSigValidity" ENUM  "B+","ACC","IG","IG1","IG2","IG3","IG1 or IG2","IG1 or IG3","Undef";
BA_DEF_ SG_  "GenSigTimeoutTime" INT 0 7000;
BA_DEF_ SG_  "UsrSigTimeoutValue" STRING ;
BA_DEF_ SG_  "UsrSigPurpose" ENUM  "Undef","FN","DIAG","DEV","NM";
BA_DEF_ SG_  "GenSigStartValue" INT 0 1215752192;
BA_DEF_ SG_  "NetworkRequest" ENUM  "Yes","No";
BA_DEF_ SG_  "NetworkRequestHoldingTime" INT 0 65535;
BA_DEF_ SG_  "Description" STRING ;
BA_DEF_ SG_  "Version" STRING ;
BA_DEF_ SG_  "GenSigEnvVarType" ENUM  "Int","Float","Undef";
BA_DEF_ SG_  "GenSigSendType" ENUM  "Cyclic			","OnWrite			","OnWriteWithRepetition			","OnChange			","OnChangeWithRepetition			","IfActive			","IfActiveWithRepetition			","NoSigSendType			","OnChangeAndIfActive			","OnChangeAndIfActiveWithRepetition";
BA_DEF_ SG_  "GwSigLatencyTime" INT 0 65536;
BA_DEF_ SG_  "GwSigMissingSourceType" ENUM  "Undef","OldValue","DefaultValue","InitialValue";
BA_DEF_ SG_  "NWM-WakeupAllowed" ENUM  "<n.a.>";
BA_DEF_ SG_  "RoutingFactor" INT 1 1215752192;
BA_DEF_DEF_  "UsrMsgIDSforwardDeviation" 10;
BA_DEF_DEF_  "UsrMsgIDSbackwardDeviation" 100;
BA_DEF_DEF_  "GenMsgCycleTime" 200;
BA_DEF_DEF_  "GenMsgStartDelayTime" 0;
BA_DEF_DEF_  "GenMsgSendType" "NoMsgSendType ";
BA_DEF_DEF_  "GenMsgCycleTimeFast" 40;
BA_DEF_DEF_  "GenMsgILSupport" "Yes";
BA_DEF_DEF_  "GenMsgNrOfRepetition" 3;
BA_DEF_DEF_  "VFrameFormat" "StandardCAN";
BA_DEF_DEF_  "UserSigValidity" "IG";
BA_DEF_DEF_  "GenSigTimeoutTime" 500;
BA_DEF_DEF_  "UsrSigTimeoutValue" "Undef";
BA_DEF_DEF_  "UsrSigPurpose" "FN";
BA_DEF_DEF_  "GenSigStartValue" 0;
BA_DEF_DEF_  "NetworkRequest" "No";
BA_DEF_DEF_  "NetworkRequestHoldingTime" 0;
BA_DEF_DEF_  "Description" "";
BA_DEF_DEF_  "Version" "";
BA_DEF_DEF_  "GenSigEnvVarType" "Undef";
BA_DEF_DEF_  "GenSigSendType" "NoSigSendType			";
BA_DEF_DEF_  "GwSigLatencyTime" 40;
BA_DEF_DEF_  "GwSigMissingSourceType" "Undef";
BA_DEF_DEF_  "NWM-WakeupAllowed" "<n.a.>";
BA_DEF_DEF_  "RoutingFactor" 1;
BA_ "Description" SG_ 3221225472 BCM_SolSnsrLftOutVoltVal "This signal indicates solar sensor output voltage - LH";
BA_ "GenSigSendType" SG_ 3221225472 BCM_SolSnsrLftOutVoltVal 4;
BA_ "UserSigValidity" SG_ 3221225472 BCM_SolSnsrLftOutVoltVal 0;
BA_ "GenSigTimeoutTime" SG_ 3221225472 BCM_SolSnsrLftOutVoltVal 1500;
BA_ "NetworkRequest" SG_ 3221225472 BCM_SolSnsrLftOutVoltVal 0;
BA_ "NetworkRequestHoldingTime" SG_ 3221225472 BCM_SolSnsrLftOutVoltVal 5000;
BA_ "Version" SG_ 3221225472 BCM_SolSnsrLftOutVoltVal "17.12.00";
BA_ "Description" SG_ 3221225472 BCM_RVMSw "This Signal is represent for the state of RVM(Rear View Monitor) Switch. 



1) RVM Switch is pushed : On 

1) RVM Switch is non pushed : Off



This signal is gateway signal.

C-CAN (gateway for RVM Unit), CF_Gway_RVMSwR";
BA_ "GenSigSendType" SG_ 3221225472 BCM_RVMSw 4;
BA_ "UserSigValidity" SG_ 3221225472 BCM_RVMSw 0;
BA_ "GenSigTimeoutTime" SG_ 3221225472 BCM_RVMSw 1500;
BA_ "NetworkRequest" SG_ 3221225472 BCM_RVMSw 0;
BA_ "NetworkRequestHoldingTime" SG_ 3221225472 BCM_RVMSw 5000;
BA_ "Version" SG_ 3221225472 BCM_RVMSw "17.12.00";
BA_ "GenSigSendType" SG_ 3221225472 BCM_GearPosPSta 4;
BA_ "UserSigValidity" SG_ 3221225472 BCM_GearPosPSta 0;
BA_ "GenSigTimeoutTime" SG_ 3221225472 BCM_GearPosPSta 1500;
BA_ "NetworkRequest" SG_ 3221225472 BCM_GearPosPSta 0;
BA_ "NetworkRequestHoldingTime" SG_ 3221225472 BCM_GearPosPSta 5000;
BA_ "Version" SG_ 3221225472 BCM_GearPosPSta "17.12.00";
BA_ "Description" SG_ 3221225472 BCM_SunRoofOpnSta "-Sunroof open/close state";
BA_ "GenSigSendType" SG_ 3221225472 BCM_SunRoofOpnSta 4;
BA_ "UserSigValidity" SG_ 3221225472 BCM_SunRoofOpnSta 0;
BA_ "GenSigTimeoutTime" SG_ 3221225472 BCM_SunRoofOpnSta 1500;
BA_ "NetworkRequest" SG_ 3221225472 BCM_SunRoofOpnSta 0;
BA_ "NetworkRequestHoldingTime" SG_ 3221225472 BCM_SunRoofOpnSta 5000;
BA_ "Version" SG_ 3221225472 BCM_SunRoofOpnSta "17.12.00";
BA_ "GenSigSendType" SG_ 3221225472 IAU_PhoneBDAdrRcvSta 4;
BA_ "UserSigValidity" SG_ 3221225472 IAU_PhoneBDAdrRcvSta 0;
BA_ "GenSigTimeoutTime" SG_ 3221225472 IAU_PhoneBDAdrRcvSta 1500;
BA_ "NetworkRequest" SG_ 3221225472 IAU_PhoneBDAdrRcvSta 0;
BA_ "NetworkRequestHoldingTime" SG_ 3221225472 IAU_PhoneBDAdrRcvSta 5000;
BA_ "Version" SG_ 3221225472 IAU_PhoneBDAdrRcvSta "17.12.08";
BA_ "GenSigSendType" SG_ 3221225472 IAU_PhoneBDAdrVal 4;
BA_ "UserSigValidity" SG_ 3221225472 IAU_PhoneBDAdrVal 0;
BA_ "GenSigTimeoutTime" SG_ 3221225472 IAU_PhoneBDAdrVal 1500;
BA_ "NetworkRequest" SG_ 3221225472 IAU_PhoneBDAdrVal 0;
BA_ "NetworkRequestHoldingTime" SG_ 3221225472 IAU_PhoneBDAdrVal 5000;
BA_ "Version" SG_ 3221225472 IAU_PhoneBDAdrVal "18.03.06";
BA_ "Description" SG_ 3221225472 ILCU_LH_Crc1Val "The CRC checking process calculates the CRC over the entire data block, including the CRC result CRC Polynomial (0x1D) ,

Initial Value : 0x00, XOR value : 0x00

The mathematical expression to 8 bit CRC polynomial is given here. G(x) = x8 + x4 + x3 + x2 ";
BA_ "GenSigStartValue" SG_ 3221225472 ILCU_LH_Crc1Val 255;
BA_ "UserSigValidity" SG_ 3221225472 ILCU_LH_Crc1Val 0;
BA_ "GenSigTimeoutTime" SG_ 3221225472 ILCU_LH_Crc1Val 1500;
BA_ "Version" SG_ 3221225472 ILCU_LH_Crc1Val "17.12.02";
BA_ "Description" SG_ 3221225472 ILCU_LH_AlvCnt1Val "For the first transmission request for a data element the counter shall be initialized with 0 and shall be incremented by 1

for every subsequent send request. When the counter reaches the maximum value(0xE), then it shall restart with ? for the next sen";
BA_ "UserSigValidity" SG_ 3221225472 ILCU_LH_AlvCnt1Val 0;
BA_ "GenSigTimeoutTime" SG_ 3221225472 ILCU_LH_AlvCnt1Val 1500;
BA_ "Version" SG_ 3221225472 ILCU_LH_AlvCnt1Val "17.12.02";
BA_ "GenSigSendType" SG_ 3221225472 ILCULH_LowBeamAct_Sta 4;
BA_ "UserSigValidity" SG_ 3221225472 ILCULH_LowBeamAct_Sta 0;
BA_ "GenSigTimeoutTime" SG_ 3221225472 ILCULH_LowBeamAct_Sta 1500;
BA_ "NetworkRequest" SG_ 3221225472 ILCULH_LowBeamAct_Sta 0;
BA_ "NetworkRequestHoldingTime" SG_ 3221225472 ILCULH_LowBeamAct_Sta 5000;
BA_ "Version" SG_ 3221225472 ILCULH_LowBeamAct_Sta "17.12.02";
BA_ "GenSigSendType" SG_ 3221225472 ILCULH_LowBeamLED_Sta 4;
BA_ "UserSigValidity" SG_ 3221225472 ILCULH_LowBeamLED_Sta 0;
BA_ "GenSigTimeoutTime" SG_ 3221225472 ILCULH_LowBeamLED_Sta 1500;
BA_ "NetworkRequest" SG_ 3221225472 ILCULH_LowBeamLED_Sta 0;
BA_ "NetworkRequestHoldingTime" SG_ 3221225472 ILCULH_LowBeamLED_Sta 5000;
BA_ "Version" SG_ 3221225472 ILCULH_LowBeamLED_Sta "17.12.02";
BA_ "GenSigSendType" SG_ 3221225472 ILCULH_PstnAct_Sta 4;
BA_ "UserSigValidity" SG_ 3221225472 ILCULH_PstnAct_Sta 0;
BA_ "GenSigTimeoutTime" SG_ 3221225472 ILCULH_PstnAct_Sta 1500;
BA_ "NetworkRequest" SG_ 3221225472 ILCULH_PstnAct_Sta 0;
BA_ "NetworkRequestHoldingTime" SG_ 3221225472 ILCULH_PstnAct_Sta 5000;
BA_ "Version" SG_ 3221225472 ILCULH_PstnAct_Sta "17.12.02";
BA_ "GenSigSendType" SG_ 3221225472 ILCULH_PstnLED_Sta 4;
BA_ "UserSigValidity" SG_ 3221225472 ILCULH_PstnLED_Sta 0;
BA_ "GenSigTimeoutTime" SG_ 3221225472 ILCULH_PstnLED_Sta 1500;
BA_ "NetworkRequest" SG_ 3221225472 ILCULH_PstnLED_Sta 0;
BA_ "NetworkRequestHoldingTime" SG_ 3221225472 ILCULH_PstnLED_Sta 5000;
BA_ "Version" SG_ 3221225472 ILCULH_PstnLED_Sta "17.12.02";
BA_ "GenSigSendType" SG_ 3221225472 ILCULH_HighBeamAct_Sta 4;
BA_ "UserSigValidity" SG_ 3221225472 ILCULH_HighBeamAct_Sta 3;
BA_ "GenSigTimeoutTime" SG_ 3221225472 ILCULH_HighBeamAct_Sta 1500;
BA_ "NetworkRequest" SG_ 3221225472 ILCULH_HighBeamAct_Sta 0;
BA_ "NetworkRequestHoldingTime" SG_ 3221225472 ILCULH_HighBeamAct_Sta 5000;
BA_ "Version" SG_ 3221225472 ILCULH_HighBeamAct_Sta "17.12.02";
BA_ "GenSigSendType" SG_ 3221225472 ILCULH_HighBeamLED_Sta 4;
BA_ "UserSigValidity" SG_ 3221225472 ILCULH_HighBeamLED_Sta 3;
BA_ "GenSigTimeoutTime" SG_ 3221225472 ILCULH_HighBeamLED_Sta 1500;
BA_ "NetworkRequest" SG_ 3221225472 ILCULH_HighBeamLED_Sta 0;
BA_ "NetworkRequestHoldingTime" SG_ 3221225472 ILCULH_HighBeamLED_Sta 5000;
BA_ "Version" SG_ 3221225472 ILCULH_HighBeamLED_Sta "17.12.02";
BA_ "GenSigSendType" SG_ 3221225472 ILCULH_DRLAct_Sta 4;
BA_ "UserSigValidity" SG_ 3221225472 ILCULH_DRLAct_Sta 3;
BA_ "GenSigTimeoutTime" SG_ 3221225472 ILCULH_DRLAct_Sta 1500;
BA_ "NetworkRequest" SG_ 3221225472 ILCULH_DRLAct_Sta 0;
BA_ "NetworkRequestHoldingTime" SG_ 3221225472 ILCULH_DRLAct_Sta 5000;
BA_ "Version" SG_ 3221225472 ILCULH_DRLAct_Sta "17.12.02";
BA_ "GenSigSendType" SG_ 3221225472 ILCULH_DRLLED_Sta 4;
BA_ "UserSigValidity" SG_ 3221225472 ILCULH_DRLLED_Sta 3;
BA_ "GenSigTimeoutTime" SG_ 3221225472 ILCULH_DRLLED_Sta 1500;
BA_ "NetworkRequest" SG_ 3221225472 ILCULH_DRLLED_Sta 0;
BA_ "NetworkRequestHoldingTime" SG_ 3221225472 ILCULH_DRLLED_Sta 5000;
BA_ "Version" SG_ 3221225472 ILCULH_DRLLED_Sta "17.12.02";
BA_ "GenSigSendType" SG_ 3221225472 ILCULH_FrontTurnAct_Sta 4;
BA_ "UserSigValidity" SG_ 3221225472 ILCULH_FrontTurnAct_Sta 0;
BA_ "GenSigTimeoutTime" SG_ 3221225472 ILCULH_FrontTurnAct_Sta 1500;
BA_ "NetworkRequest" SG_ 3221225472 ILCULH_FrontTurnAct_Sta 0;
BA_ "NetworkRequestHoldingTime" SG_ 3221225472 ILCULH_FrontTurnAct_Sta 5000;
BA_ "Version" SG_ 3221225472 ILCULH_FrontTurnAct_Sta "17.12.02";
BA_ "GenSigSendType" SG_ 3221225472 ILCULH_FrontTurnLED_Sta 4;
BA_ "UserSigValidity" SG_ 3221225472 ILCULH_FrontTurnLED_Sta 0;
BA_ "GenSigTimeoutTime" SG_ 3221225472 ILCULH_FrontTurnLED_Sta 1500;
BA_ "NetworkRequest" SG_ 3221225472 ILCULH_FrontTurnLED_Sta 0;
BA_ "NetworkRequestHoldingTime" SG_ 3221225472 ILCULH_FrontTurnLED_Sta 5000;
BA_ "Version" SG_ 3221225472 ILCULH_FrontTurnLED_Sta "17.12.02";
BA_ "GenSigSendType" SG_ 3221225472 ILCULH_System_Sta 4;
BA_ "UserSigValidity" SG_ 3221225472 ILCULH_System_Sta 0;
BA_ "GenSigTimeoutTime" SG_ 3221225472 ILCULH_System_Sta 1500;
BA_ "NetworkRequest" SG_ 3221225472 ILCULH_System_Sta 0;
BA_ "NetworkRequestHoldingTime" SG_ 3221225472 ILCULH_System_Sta 5000;
BA_ "Version" SG_ 3221225472 ILCULH_System_Sta "17.12.02";
BA_ "GenSigSendType" SG_ 3221225472 ILCULH_IFSOpt_Sta 4;
BA_ "UserSigValidity" SG_ 3221225472 ILCULH_IFSOpt_Sta 3;
BA_ "GenSigTimeoutTime" SG_ 3221225472 ILCULH_IFSOpt_Sta 1500;
BA_ "NetworkRequest" SG_ 3221225472 ILCULH_IFSOpt_Sta 0;
BA_ "NetworkRequestHoldingTime" SG_ 3221225472 ILCULH_IFSOpt_Sta 5000;
BA_ "Version" SG_ 3221225472 ILCULH_IFSOpt_Sta "17.12.02";
BA_ "GenSigSendType" SG_ 3221225472 ILCULH_IFSLamp_Act 4;
BA_ "UserSigValidity" SG_ 3221225472 ILCULH_IFSLamp_Act 3;
BA_ "GenSigTimeoutTime" SG_ 3221225472 ILCULH_IFSLamp_Act 1500;
BA_ "NetworkRequest" SG_ 3221225472 ILCULH_IFSLamp_Act 0;
BA_ "NetworkRequestHoldingTime" SG_ 3221225472 ILCULH_IFSLamp_Act 5000;
BA_ "Version" SG_ 3221225472 ILCULH_IFSLamp_Act "17.12.02";
BA_ "GenSigSendType" SG_ 3221225472 ILCULH_IFSSysState_Sta 4;
BA_ "UserSigValidity" SG_ 3221225472 ILCULH_IFSSysState_Sta 3;
BA_ "GenSigTimeoutTime" SG_ 3221225472 ILCULH_IFSSysState_Sta 1500;
BA_ "NetworkRequest" SG_ 3221225472 ILCULH_IFSSysState_Sta 0;
BA_ "NetworkRequestHoldingTime" SG_ 3221225472 ILCULH_IFSSysState_Sta 5000;
BA_ "Version" SG_ 3221225472 ILCULH_IFSSysState_Sta "17.12.02";
BA_ "GenSigSendType" SG_ 3221225472 ILCULH_IFSWarning_Sta 4;
BA_ "UserSigValidity" SG_ 3221225472 ILCULH_IFSWarning_Sta 3;
BA_ "GenSigTimeoutTime" SG_ 3221225472 ILCULH_IFSWarning_Sta 1500;
BA_ "NetworkRequest" SG_ 3221225472 ILCULH_IFSWarning_Sta 0;
BA_ "NetworkRequestHoldingTime" SG_ 3221225472 ILCULH_IFSWarning_Sta 5000;
BA_ "Version" SG_ 3221225472 ILCULH_IFSWarning_Sta "17.12.02";
BA_ "Description" SG_ 3221225472 ILCU_RH_Crc1Val "The CRC checking process calculates the CRC over the entire data block, including the CRC result CRC Polynomial (0x1D) ,

Initial Value : 0x00, XOR value : 0x00

The mathematical expression to 8 bit CRC polynomial is given here. G(x) = x8 + x4 + x3 + x2 ";
BA_ "GenSigStartValue" SG_ 3221225472 ILCU_RH_Crc1Val 255;
BA_ "UserSigValidity" SG_ 3221225472 ILCU_RH_Crc1Val 0;
BA_ "GenSigTimeoutTime" SG_ 3221225472 ILCU_RH_Crc1Val 1500;
BA_ "Version" SG_ 3221225472 ILCU_RH_Crc1Val "17.12.02";
BA_ "Description" SG_ 3221225472 ILCU_RH_AlvCnt1Val "For the first transmission request for a data element the counter shall be initialized with 0 and shall be incremented by 1

for every subsequent send request. When the counter reaches the maximum value(0xE), then it shall restart with ? for the next sen";
BA_ "UserSigValidity" SG_ 3221225472 ILCU_RH_AlvCnt1Val 0;
BA_ "GenSigTimeoutTime" SG_ 3221225472 ILCU_RH_AlvCnt1Val 1500;
BA_ "Version" SG_ 3221225472 ILCU_RH_AlvCnt1Val "17.12.02";
BA_ "GenSigSendType" SG_ 3221225472 ILCURH_LowBeamAct_Sta 4;
BA_ "UserSigValidity" SG_ 3221225472 ILCURH_LowBeamAct_Sta 0;
BA_ "GenSigTimeoutTime" SG_ 3221225472 ILCURH_LowBeamAct_Sta 1500;
BA_ "NetworkRequest" SG_ 3221225472 ILCURH_LowBeamAct_Sta 0;
BA_ "NetworkRequestHoldingTime" SG_ 3221225472 ILCURH_LowBeamAct_Sta 5000;
BA_ "Version" SG_ 3221225472 ILCURH_LowBeamAct_Sta "17.12.02";
BA_ "GenSigSendType" SG_ 3221225472 ILCURH_LowBeamLED_Sta 4;
BA_ "UserSigValidity" SG_ 3221225472 ILCURH_LowBeamLED_Sta 0;
BA_ "GenSigTimeoutTime" SG_ 3221225472 ILCURH_LowBeamLED_Sta 1500;
BA_ "NetworkRequest" SG_ 3221225472 ILCURH_LowBeamLED_Sta 0;
BA_ "NetworkRequestHoldingTime" SG_ 3221225472 ILCURH_LowBeamLED_Sta 5000;
BA_ "Version" SG_ 3221225472 ILCURH_LowBeamLED_Sta "17.12.02";
BA_ "GenSigSendType" SG_ 3221225472 ILCURH_PstnAct_Sta 4;
BA_ "UserSigValidity" SG_ 3221225472 ILCURH_PstnAct_Sta 0;
BA_ "GenSigTimeoutTime" SG_ 3221225472 ILCURH_PstnAct_Sta 1500;
BA_ "NetworkRequest" SG_ 3221225472 ILCURH_PstnAct_Sta 0;
BA_ "NetworkRequestHoldingTime" SG_ 3221225472 ILCURH_PstnAct_Sta 5000;
BA_ "Version" SG_ 3221225472 ILCURH_PstnAct_Sta "17.12.02";
BA_ "GenSigSendType" SG_ 3221225472 ILCURH_PstnLED_Sta 4;
BA_ "UserSigValidity" SG_ 3221225472 ILCURH_PstnLED_Sta 0;
BA_ "GenSigTimeoutTime" SG_ 3221225472 ILCURH_PstnLED_Sta 1500;
BA_ "NetworkRequest" SG_ 3221225472 ILCURH_PstnLED_Sta 0;
BA_ "NetworkRequestHoldingTime" SG_ 3221225472 ILCURH_PstnLED_Sta 5000;
BA_ "Version" SG_ 3221225472 ILCURH_PstnLED_Sta "17.12.02";
BA_ "GenSigSendType" SG_ 3221225472 ILCURH_HighBeamAct_Sta 4;
BA_ "UserSigValidity" SG_ 3221225472 ILCURH_HighBeamAct_Sta 3;
BA_ "GenSigTimeoutTime" SG_ 3221225472 ILCURH_HighBeamAct_Sta 1500;
BA_ "NetworkRequest" SG_ 3221225472 ILCURH_HighBeamAct_Sta 0;
BA_ "NetworkRequestHoldingTime" SG_ 3221225472 ILCURH_HighBeamAct_Sta 5000;
BA_ "Version" SG_ 3221225472 ILCURH_HighBeamAct_Sta "17.12.02";
BA_ "GenSigSendType" SG_ 3221225472 ILCURH_HighBeamLED_Sta 4;
BA_ "UserSigValidity" SG_ 3221225472 ILCURH_HighBeamLED_Sta 3;
BA_ "GenSigTimeoutTime" SG_ 3221225472 ILCURH_HighBeamLED_Sta 1500;
BA_ "NetworkRequest" SG_ 3221225472 ILCURH_HighBeamLED_Sta 0;
BA_ "NetworkRequestHoldingTime" SG_ 3221225472 ILCURH_HighBeamLED_Sta 5000;
BA_ "Version" SG_ 3221225472 ILCURH_HighBeamLED_Sta "17.12.02";
BA_ "GenSigSendType" SG_ 3221225472 ILCURH_DRLAct_Sta 4;
BA_ "UserSigValidity" SG_ 3221225472 ILCURH_DRLAct_Sta 3;
BA_ "GenSigTimeoutTime" SG_ 3221225472 ILCURH_DRLAct_Sta 1500;
BA_ "NetworkRequest" SG_ 3221225472 ILCURH_DRLAct_Sta 0;
BA_ "NetworkRequestHoldingTime" SG_ 3221225472 ILCURH_DRLAct_Sta 5000;
BA_ "Version" SG_ 3221225472 ILCURH_DRLAct_Sta "17.12.02";
BA_ "GenSigSendType" SG_ 3221225472 ILCURH_DRLLED_Sta 4;
BA_ "UserSigValidity" SG_ 3221225472 ILCURH_DRLLED_Sta 3;
BA_ "GenSigTimeoutTime" SG_ 3221225472 ILCURH_DRLLED_Sta 1500;
BA_ "NetworkRequest" SG_ 3221225472 ILCURH_DRLLED_Sta 0;
BA_ "NetworkRequestHoldingTime" SG_ 3221225472 ILCURH_DRLLED_Sta 5000;
BA_ "Version" SG_ 3221225472 ILCURH_DRLLED_Sta "17.12.02";
BA_ "GenSigSendType" SG_ 3221225472 ILCURH_FrontTurnAct_Sta 4;
BA_ "UserSigValidity" SG_ 3221225472 ILCURH_FrontTurnAct_Sta 0;
BA_ "GenSigTimeoutTime" SG_ 3221225472 ILCURH_FrontTurnAct_Sta 1500;
BA_ "NetworkRequest" SG_ 3221225472 ILCURH_FrontTurnAct_Sta 0;
BA_ "NetworkRequestHoldingTime" SG_ 3221225472 ILCURH_FrontTurnAct_Sta 5000;
BA_ "Version" SG_ 3221225472 ILCURH_FrontTurnAct_Sta "17.12.02";
BA_ "GenSigSendType" SG_ 3221225472 ILCURH_FrontTurnLED_Sta 4;
BA_ "UserSigValidity" SG_ 3221225472 ILCURH_FrontTurnLED_Sta 0;
BA_ "GenSigTimeoutTime" SG_ 3221225472 ILCURH_FrontTurnLED_Sta 1500;
BA_ "NetworkRequest" SG_ 3221225472 ILCURH_FrontTurnLED_Sta 0;
BA_ "NetworkRequestHoldingTime" SG_ 3221225472 ILCURH_FrontTurnLED_Sta 5000;
BA_ "Version" SG_ 3221225472 ILCURH_FrontTurnLED_Sta "17.12.02";
BA_ "GenSigSendType" SG_ 3221225472 ILCURH_System_Sta 4;
BA_ "UserSigValidity" SG_ 3221225472 ILCURH_System_Sta 0;
BA_ "GenSigTimeoutTime" SG_ 3221225472 ILCURH_System_Sta 1500;
BA_ "NetworkRequest" SG_ 3221225472 ILCURH_System_Sta 0;
BA_ "NetworkRequestHoldingTime" SG_ 3221225472 ILCURH_System_Sta 5000;
BA_ "Version" SG_ 3221225472 ILCURH_System_Sta "17.12.02";
BA_ "GenSigSendType" SG_ 3221225472 ILCURH_IFSOpt_Sta 4;
BA_ "UserSigValidity" SG_ 3221225472 ILCURH_IFSOpt_Sta 3;
BA_ "GenSigTimeoutTime" SG_ 3221225472 ILCURH_IFSOpt_Sta 1500;
BA_ "NetworkRequest" SG_ 3221225472 ILCURH_IFSOpt_Sta 0;
BA_ "NetworkRequestHoldingTime" SG_ 3221225472 ILCURH_IFSOpt_Sta 5000;
BA_ "Version" SG_ 3221225472 ILCURH_IFSOpt_Sta "17.12.02";
BA_ "GenSigSendType" SG_ 3221225472 ILCURH_IFSLamp_Act 4;
BA_ "UserSigValidity" SG_ 3221225472 ILCURH_IFSLamp_Act 3;
BA_ "GenSigTimeoutTime" SG_ 3221225472 ILCURH_IFSLamp_Act 1500;
BA_ "NetworkRequest" SG_ 3221225472 ILCURH_IFSLamp_Act 0;
BA_ "NetworkRequestHoldingTime" SG_ 3221225472 ILCURH_IFSLamp_Act 5000;
BA_ "Version" SG_ 3221225472 ILCURH_IFSLamp_Act "17.12.02";
BA_ "GenSigSendType" SG_ 3221225472 ILCURH_IFSSysState_Sta 4;
BA_ "UserSigValidity" SG_ 3221225472 ILCURH_IFSSysState_Sta 3;
BA_ "GenSigTimeoutTime" SG_ 3221225472 ILCURH_IFSSysState_Sta 1500;
BA_ "NetworkRequest" SG_ 3221225472 ILCURH_IFSSysState_Sta 0;
BA_ "NetworkRequestHoldingTime" SG_ 3221225472 ILCURH_IFSSysState_Sta 5000;
BA_ "Version" SG_ 3221225472 ILCURH_IFSSysState_Sta "17.12.02";
BA_ "GenSigSendType" SG_ 3221225472 ILCURH_IFSWarning_Sta 4;
BA_ "UserSigValidity" SG_ 3221225472 ILCURH_IFSWarning_Sta 3;
BA_ "GenSigTimeoutTime" SG_ 3221225472 ILCURH_IFSWarning_Sta 1500;
BA_ "NetworkRequest" SG_ 3221225472 ILCURH_IFSWarning_Sta 0;
BA_ "NetworkRequestHoldingTime" SG_ 3221225472 ILCURH_IFSWarning_Sta 5000;
BA_ "Version" SG_ 3221225472 ILCURH_IFSWarning_Sta "17.12.02";
BA_ "Description" SG_ 3221225472 DATC_Crc11Val "The CRC checking process calculates the CRC over the entire data block, including the CRC result.

- CRC Polynomial (0x1021) , Initial Value : 0xFFFF, XOR value : 0x0000

- The mathematical expression to 16 bit CRC polynomial is given here. G(x) = x16 + ";
BA_ "GenSigSendType" SG_ 3221225472 DATC_Crc11Val 4;
BA_ "GenSigStartValue" SG_ 3221225472 DATC_Crc11Val 65535;
BA_ "UserSigValidity" SG_ 3221225472 DATC_Crc11Val 3;
BA_ "GenSigTimeoutTime" SG_ 3221225472 DATC_Crc11Val 1500;
BA_ "Version" SG_ 3221225472 DATC_Crc11Val "17.11.00";
BA_ "Description" SG_ 3221225472 DATC_AlvCnt11Val "For the first transmission request for a data element the counter shall be initialized with 0 and shall be incremented by 1

for every subsequent send request. When the counter reaches the maximum value(0xFF), then it shall restart with ? for the next se";
BA_ "GenSigSendType" SG_ 3221225472 DATC_AlvCnt11Val 4;
BA_ "UserSigValidity" SG_ 3221225472 DATC_AlvCnt11Val 3;
BA_ "GenSigTimeoutTime" SG_ 3221225472 DATC_AlvCnt11Val 1500;
BA_ "Version" SG_ 3221225472 DATC_AlvCnt11Val "17.11.00";
BA_ "Description" SG_ 3221225472 DATC_TunnelFuncOff4AutoDfgReq "DATC Turn off Tunnel Function for ADS";
BA_ "GenSigSendType" SG_ 3221225472 DATC_TunnelFuncOff4AutoDfgReq 4;
BA_ "UserSigValidity" SG_ 3221225472 DATC_TunnelFuncOff4AutoDfgReq 7;
BA_ "GenSigTimeoutTime" SG_ 3221225472 DATC_TunnelFuncOff4AutoDfgReq 1500;
BA_ "Version" SG_ 3221225472 DATC_TunnelFuncOff4AutoDfgReq "17.11.00";
BA_ "Description" SG_ 3221225472 DATC_ArClnSysSta "Air Cleaning System Operate Status";
BA_ "GenSigSendType" SG_ 3221225472 DATC_ArClnSysSta 4;
BA_ "GenSigStartValue" SG_ 3221225472 DATC_ArClnSysSta 3;
BA_ "UserSigValidity" SG_ 3221225472 DATC_ArClnSysSta 7;
BA_ "GenSigTimeoutTime" SG_ 3221225472 DATC_ArClnSysSta 1500;
BA_ "Version" SG_ 3221225472 DATC_ArClnSysSta "17.11.00";
BA_ "Description" SG_ 3221225472 DATC_DrvrStHtrUSMSta "If the 'Auto Comfort Control' function is applied separately to the Seat and Steering Wheel, 

this signal is used.";
BA_ "GenSigSendType" SG_ 3221225472 DATC_DrvrStHtrUSMSta 4;
BA_ "UserSigValidity" SG_ 3221225472 DATC_DrvrStHtrUSMSta 7;
BA_ "GenSigTimeoutTime" SG_ 3221225472 DATC_DrvrStHtrUSMSta 1500;
BA_ "Version" SG_ 3221225472 DATC_DrvrStHtrUSMSta "17.11.00";
BA_ "GenSigSendType" SG_ 3221225472 IAU_EncryptedResult2Val 4;
BA_ "UserSigValidity" SG_ 3221225472 IAU_EncryptedResult2Val 0;
BA_ "GenSigTimeoutTime" SG_ 3221225472 IAU_EncryptedResult2Val 0;
BA_ "NetworkRequest" SG_ 3221225472 IAU_EncryptedResult2Val 0;
BA_ "NetworkRequestHoldingTime" SG_ 3221225472 IAU_EncryptedResult2Val 5000;
BA_ "Version" SG_ 3221225472 IAU_EncryptedResult2Val "17.12.08";
BA_ "Description" SG_ 3221225472 SMK_Crc4Val "The CRC checking process calculates the CRC over the entire data block, including the CRC result CRC Polynomial (0x1D) ,

Initial Value : 0x00, XOR value : 0x00

The mathematical expression to 8 bit CRC polynomial is given here. G(x) = x8 + x4 + x3 + x2 ";
BA_ "GenSigSendType" SG_ 3221225472 SMK_Crc4Val 4;
BA_ "GenSigStartValue" SG_ 3221225472 SMK_Crc4Val 255;
BA_ "UserSigValidity" SG_ 3221225472 SMK_Crc4Val 0;
BA_ "GenSigTimeoutTime" SG_ 3221225472 SMK_Crc4Val 1500;
BA_ "Version" SG_ 3221225472 SMK_Crc4Val "17.11.00";
BA_ "Description" SG_ 3221225472 SMK_AlvCnt4Val "For the first transmission request for a data element the counter shall be initialized with 0 and shall be incremented by 1

for every subsequent send request. When the counter reaches the maximum value(0xE), then it shall restart with ? for the next sen";
BA_ "GenSigSendType" SG_ 3221225472 SMK_AlvCnt4Val 4;
BA_ "UserSigValidity" SG_ 3221225472 SMK_AlvCnt4Val 0;
BA_ "GenSigTimeoutTime" SG_ 3221225472 SMK_AlvCnt4Val 1500;
BA_ "Version" SG_ 3221225472 SMK_AlvCnt4Val "17.11.00";
BA_ "Description" SG_ 3221225472 Warn_StrtStpBtnWrngSta "-(Old)C_SSB_Warning";
BA_ "GenSigSendType" SG_ 3221225472 Warn_StrtStpBtnWrngSta 4;
BA_ "UserSigValidity" SG_ 3221225472 Warn_StrtStpBtnWrngSta 0;
BA_ "GenSigTimeoutTime" SG_ 3221225472 Warn_StrtStpBtnWrngSta 1500;
BA_ "Version" SG_ 3221225472 Warn_StrtStpBtnWrngSta "17.12.00";
BA_ "Description" SG_ 3221225472 Warn_DeActvWrngSta "-(Old)C_Deactivation_Warning";
BA_ "GenSigSendType" SG_ 3221225472 Warn_DeActvWrngSta 4;
BA_ "UserSigValidity" SG_ 3221225472 Warn_DeActvWrngSta 0;
BA_ "GenSigTimeoutTime" SG_ 3221225472 Warn_DeActvWrngSta 1500;
BA_ "Version" SG_ 3221225472 Warn_DeActvWrngSta "17.12.00";
BA_ "Description" SG_ 3221225472 Warn_ExtrnlBuzWrngSta "-(Old)C_PICWarning";
BA_ "GenSigSendType" SG_ 3221225472 Warn_ExtrnlBuzWrngSta 4;
BA_ "UserSigValidity" SG_ 3221225472 Warn_ExtrnlBuzWrngSta 0;
BA_ "GenSigTimeoutTime" SG_ 3221225472 Warn_ExtrnlBuzWrngSta 1500;
BA_ "Version" SG_ 3221225472 Warn_ExtrnlBuzWrngSta "17.12.00";
BA_ "Description" SG_ 3221225472 Warn_DisWrngSta "-(Old)C_PICWarningIND



Changed Value Table ('15 1/12)



: 0x4 : Not Locked Warning → AC_Plug_Connected_Warning



for EV/PHEV SMK Warning Logic(Cranking Trial with AC Plug Connected)";
BA_ "GenSigSendType" SG_ 3221225472 Warn_DisWrngSta 4;
BA_ "UserSigValidity" SG_ 3221225472 Warn_DisWrngSta 0;
BA_ "GenSigTimeoutTime" SG_ 3221225472 Warn_DisWrngSta 1500;
BA_ "Version" SG_ 3221225472 Warn_DisWrngSta "17.12.00";
BA_ "Description" SG_ 3221225472 Warn_GearPosPWrngReq "-(Old)C_Shift_P_Warning";
BA_ "GenSigSendType" SG_ 3221225472 Warn_GearPosPWrngReq 4;
BA_ "UserSigValidity" SG_ 3221225472 Warn_GearPosPWrngReq 0;
BA_ "GenSigTimeoutTime" SG_ 3221225472 Warn_GearPosPWrngReq 1500;
BA_ "Version" SG_ 3221225472 Warn_GearPosPWrngReq "17.12.00";
BA_ "Description" SG_ 3221225472 Warn_IdOutWrngSta "-(Old)C_IDOUT_WNG";
BA_ "GenSigSendType" SG_ 3221225472 Warn_IdOutWrngSta 4;
BA_ "UserSigValidity" SG_ 3221225472 Warn_IdOutWrngSta 0;
BA_ "GenSigTimeoutTime" SG_ 3221225472 Warn_IdOutWrngSta 1500;
BA_ "Version" SG_ 3221225472 Warn_IdOutWrngSta "17.12.00";
BA_ "Description" SG_ 3221225472 Warn_KeyBattLoWrngSta "-(Old)C_KeyBATDischargeWarning";
BA_ "GenSigSendType" SG_ 3221225472 Warn_KeyBattLoWrngSta 4;
BA_ "UserSigValidity" SG_ 3221225472 Warn_KeyBattLoWrngSta 0;
BA_ "GenSigTimeoutTime" SG_ 3221225472 Warn_KeyBattLoWrngSta 1500;
BA_ "Version" SG_ 3221225472 Warn_KeyBattLoWrngSta "17.12.00";
BA_ "Description" SG_ 3221225472 Warn_KeyOutLmpOnReq "-(Old)C_KeyoutLpWngCluster";
BA_ "GenSigSendType" SG_ 3221225472 Warn_KeyOutLmpOnReq 4;
BA_ "UserSigValidity" SG_ 3221225472 Warn_KeyOutLmpOnReq 0;
BA_ "GenSigTimeoutTime" SG_ 3221225472 Warn_KeyOutLmpOnReq 1500;
BA_ "Version" SG_ 3221225472 Warn_KeyOutLmpOnReq "17.12.00";
BA_ "Description" SG_ 3221225472 Warn_NotGearPosPWrngSta "-(Old)C_Vehicle_not_P_Warning";
BA_ "GenSigSendType" SG_ 3221225472 Warn_NotGearPosPWrngSta 4;
BA_ "UserSigValidity" SG_ 3221225472 Warn_NotGearPosPWrngSta 0;
BA_ "GenSigTimeoutTime" SG_ 3221225472 Warn_NotGearPosPWrngSta 1500;
BA_ "Version" SG_ 3221225472 Warn_NotGearPosPWrngSta "17.12.00";
BA_ "Description" SG_ 3221225472 Warn_EsclFlWrngSta "-(Old)C_ESCL_Fail_Warning";
BA_ "GenSigSendType" SG_ 3221225472 Warn_EsclFlWrngSta 4;
BA_ "UserSigValidity" SG_ 3221225472 Warn_EsclFlWrngSta 0;
BA_ "GenSigTimeoutTime" SG_ 3221225472 Warn_EsclFlWrngSta 1500;
BA_ "Version" SG_ 3221225472 Warn_EsclFlWrngSta "17.12.00";
BA_ "Description" SG_ 3221225472 Warn_EsclNotLkWrngSta "-(Old)C_ESCL_Notlocked_Warning";
BA_ "GenSigSendType" SG_ 3221225472 Warn_EsclNotLkWrngSta 4;
BA_ "UserSigValidity" SG_ 3221225472 Warn_EsclNotLkWrngSta 0;
BA_ "GenSigTimeoutTime" SG_ 3221225472 Warn_EsclNotLkWrngSta 1500;
BA_ "Version" SG_ 3221225472 Warn_EsclNotLkWrngSta "17.12.00";
BA_ "Description" SG_ 3221225472 Warn_EsclNotUnLkWrngSta "-(Old)C_ESCLNotUnlockWarning";
BA_ "GenSigSendType" SG_ 3221225472 Warn_EsclNotUnLkWrngSta 4;
BA_ "UserSigValidity" SG_ 3221225472 Warn_EsclNotUnLkWrngSta 0;
BA_ "GenSigTimeoutTime" SG_ 3221225472 Warn_EsclNotUnLkWrngSta 1500;
BA_ "Version" SG_ 3221225472 Warn_EsclNotUnLkWrngSta "17.12.00";
BA_ "Description" SG_ 3221225472 Warn_ImmoLmpOnReq "-(Old)C_ImmoLp";
BA_ "GenSigSendType" SG_ 3221225472 Warn_ImmoLmpOnReq 4;
BA_ "UserSigValidity" SG_ 3221225472 Warn_ImmoLmpOnReq 0;
BA_ "GenSigTimeoutTime" SG_ 3221225472 Warn_ImmoLmpOnReq 1500;
BA_ "Version" SG_ 3221225472 Warn_ImmoLmpOnReq "17.12.00";
BA_ "Description" SG_ 3221225472 RL_SHVU_SeatOptSta "후석 LH 시트에 적용된 히터/통풍 옵션 사양";
BA_ "GenSigSendType" SG_ 3221225472 RL_SHVU_SeatOptSta 4;
BA_ "UserSigValidity" SG_ 3221225472 RL_SHVU_SeatOptSta 3;
BA_ "GenSigTimeoutTime" SG_ 3221225472 RL_SHVU_SeatOptSta 1500;
BA_ "NetworkRequest" SG_ 3221225472 RL_SHVU_SeatOptSta 0;
BA_ "NetworkRequestHoldingTime" SG_ 3221225472 RL_SHVU_SeatOptSta 5000;
BA_ "Version" SG_ 3221225472 RL_SHVU_SeatOptSta "17.12.03";
BA_ "Description" SG_ 3221225472 RL_SHVU_SeatHtOperSta "후석 LH 시트 현재 작동 중인 히터/통풍 단수 상태";
BA_ "GenSigSendType" SG_ 3221225472 RL_SHVU_SeatHtOperSta 4;
BA_ "UserSigValidity" SG_ 3221225472 RL_SHVU_SeatHtOperSta 3;
BA_ "GenSigTimeoutTime" SG_ 3221225472 RL_SHVU_SeatHtOperSta 1500;
BA_ "NetworkRequest" SG_ 3221225472 RL_SHVU_SeatHtOperSta 0;
BA_ "NetworkRequestHoldingTime" SG_ 3221225472 RL_SHVU_SeatHtOperSta 5000;
BA_ "Version" SG_ 3221225472 RL_SHVU_SeatHtOperSta "17.12.03";
BA_ "Description" SG_ 3221225472 RL_CURTAIN_POSITION "2열 좌측 윈도우 글라스 커튼 위치 정보";
BA_ "GenSigSendType" SG_ 3221225472 RL_CURTAIN_POSITION 4;
BA_ "UserSigValidity" SG_ 3221225472 RL_CURTAIN_POSITION 0;
BA_ "GenSigTimeoutTime" SG_ 3221225472 RL_CURTAIN_POSITION 1500;
BA_ "NetworkRequest" SG_ 3221225472 RL_CURTAIN_POSITION 0;
BA_ "NetworkRequestHoldingTime" SG_ 3221225472 RL_CURTAIN_POSITION 5000;
BA_ "Version" SG_ 3221225472 RL_CURTAIN_POSITION "18.03.07";
BA_ "Description" SG_ 3221225472 RR_CURTAIN_POSITION "2열 우측 윈도우 글라스 커튼 위치 정보";
BA_ "GenSigSendType" SG_ 3221225472 RR_CURTAIN_POSITION 4;
BA_ "UserSigValidity" SG_ 3221225472 RR_CURTAIN_POSITION 0;
BA_ "GenSigTimeoutTime" SG_ 3221225472 RR_CURTAIN_POSITION 1500;
BA_ "NetworkRequest" SG_ 3221225472 RR_CURTAIN_POSITION 0;
BA_ "NetworkRequestHoldingTime" SG_ 3221225472 RR_CURTAIN_POSITION 5000;
BA_ "Version" SG_ 3221225472 RR_CURTAIN_POSITION "18.03.07";
BA_ "Description" SG_ 3221225472 DLBCU_ActiveDis "에어서포트모드 AVN 표시";
BA_ "GenSigSendType" SG_ 3221225472 DLBCU_ActiveDis 4;
BA_ "UserSigValidity" SG_ 3221225472 DLBCU_ActiveDis 1;
BA_ "GenSigTimeoutTime" SG_ 3221225472 DLBCU_ActiveDis 1500;
BA_ "NetworkRequest" SG_ 3221225472 DLBCU_ActiveDis 0;
BA_ "NetworkRequestHoldingTime" SG_ 3221225472 DLBCU_ActiveDis 5000;
BA_ "Version" SG_ 3221225472 DLBCU_ActiveDis "18.03.07";
BA_ "Description" SG_ 3221225472 DLBCU_DrvModUSMSta "드라이브 모드 연동 Signal 피드백 to AVN";
BA_ "GenSigSendType" SG_ 3221225472 DLBCU_DrvModUSMSta 4;
BA_ "UserSigValidity" SG_ 3221225472 DLBCU_DrvModUSMSta 1;
BA_ "GenSigTimeoutTime" SG_ 3221225472 DLBCU_DrvModUSMSta 1500;
BA_ "NetworkRequest" SG_ 3221225472 DLBCU_DrvModUSMSta 0;
BA_ "NetworkRequestHoldingTime" SG_ 3221225472 DLBCU_DrvModUSMSta 5000;
BA_ "Version" SG_ 3221225472 DLBCU_DrvModUSMSta "18.03.07";
BA_ "Description" SG_ 3221225472 DLBCU_ActiveStrSta "에어서포트 모드 강도 Signal 피드백 to AVN";
BA_ "GenSigSendType" SG_ 3221225472 DLBCU_ActiveStrSta 4;
BA_ "UserSigValidity" SG_ 3221225472 DLBCU_ActiveStrSta 1;
BA_ "GenSigTimeoutTime" SG_ 3221225472 DLBCU_ActiveStrSta 1500;
BA_ "NetworkRequest" SG_ 3221225472 DLBCU_ActiveStrSta 0;
BA_ "NetworkRequestHoldingTime" SG_ 3221225472 DLBCU_ActiveStrSta 5000;
BA_ "Version" SG_ 3221225472 DLBCU_ActiveStrSta "18.03.07";
BA_ "Description" SG_ 3221225472 DLBCU_ActiveTimeSta "에어서포트 재생시간 Signal 피드백 to AVN";
BA_ "GenSigSendType" SG_ 3221225472 DLBCU_ActiveTimeSta 4;
BA_ "UserSigValidity" SG_ 3221225472 DLBCU_ActiveTimeSta 1;
BA_ "GenSigTimeoutTime" SG_ 3221225472 DLBCU_ActiveTimeSta 1500;
BA_ "NetworkRequest" SG_ 3221225472 DLBCU_ActiveTimeSta 0;
BA_ "NetworkRequestHoldingTime" SG_ 3221225472 DLBCU_ActiveTimeSta 5000;
BA_ "Version" SG_ 3221225472 DLBCU_ActiveTimeSta "18.03.07";
BA_ "Description" SG_ 3221225472 DLBCU_CushSoftSta "쿠션 소프트니스 Signal 피드백 to AVN";
BA_ "GenSigSendType" SG_ 3221225472 DLBCU_CushSoftSta 4;
BA_ "UserSigValidity" SG_ 3221225472 DLBCU_CushSoftSta 1;
BA_ "GenSigTimeoutTime" SG_ 3221225472 DLBCU_CushSoftSta 1500;
BA_ "NetworkRequest" SG_ 3221225472 DLBCU_CushSoftSta 0;
BA_ "NetworkRequestHoldingTime" SG_ 3221225472 DLBCU_CushSoftSta 5000;
BA_ "Version" SG_ 3221225472 DLBCU_CushSoftSta "18.03.07";
BA_ "Description" SG_ 3221225472 BCM_Crc11Val "The CRC checking process calculates the CRC over the entire data block, including the CRC result CRC Polynomial (0x1D) ,

Initial Value : 0x00, XOR value : 0x00

The mathematical expression to 8 bit CRC polynomial is given here. G(x) = x8 + x4 + x3 + x2 ";
BA_ "GenSigSendType" SG_ 3221225472 BCM_Crc11Val 4;
BA_ "GenSigStartValue" SG_ 3221225472 BCM_Crc11Val 255;
BA_ "UserSigValidity" SG_ 3221225472 BCM_Crc11Val 0;
BA_ "GenSigTimeoutTime" SG_ 3221225472 BCM_Crc11Val 1500;
BA_ "Version" SG_ 3221225472 BCM_Crc11Val "17.11.00";
BA_ "Description" SG_ 3221225472 BCM_AlvCnt11Val "For the first transmission request for a data element the counter shall be initialized with 0 and shall be incremented by 1

for every subsequent send request. When the counter reaches the maximum value(0xE), then it shall restart with ? for the next sen";
BA_ "GenSigSendType" SG_ 3221225472 BCM_AlvCnt11Val 4;
BA_ "UserSigValidity" SG_ 3221225472 BCM_AlvCnt11Val 0;
BA_ "GenSigTimeoutTime" SG_ 3221225472 BCM_AlvCnt11Val 1500;
BA_ "Version" SG_ 3221225472 BCM_AlvCnt11Val "17.11.00";
BA_ "GenSigSendType" SG_ 3221225472 USM_EscrtHdLmpSta 4;
BA_ "UserSigValidity" SG_ 3221225472 USM_EscrtHdLmpSta 0;
BA_ "GenSigTimeoutTime" SG_ 3221225472 USM_EscrtHdLmpSta 1500;
BA_ "NetworkRequest" SG_ 3221225472 USM_EscrtHdLmpSta 0;
BA_ "NetworkRequestHoldingTime" SG_ 3221225472 USM_EscrtHdLmpSta 5000;
BA_ "Version" SG_ 3221225472 USM_EscrtHdLmpSta "17.12.00";
BA_ "Description" SG_ 3221225472 USM_WlcmMirLtSystTitleOpt "USM Welcome System Title Option";
BA_ "GenSigSendType" SG_ 3221225472 USM_WlcmMirLtSystTitleOpt 4;
BA_ "UserSigValidity" SG_ 3221225472 USM_WlcmMirLtSystTitleOpt 0;
BA_ "GenSigTimeoutTime" SG_ 3221225472 USM_WlcmMirLtSystTitleOpt 1500;
BA_ "NetworkRequest" SG_ 3221225472 USM_WlcmMirLtSystTitleOpt 0;
BA_ "NetworkRequestHoldingTime" SG_ 3221225472 USM_WlcmMirLtSystTitleOpt 5000;
BA_ "Version" SG_ 3221225472 USM_WlcmMirLtSystTitleOpt "17.12.00";
BA_ "Description" SG_ 3221225472 USM_UnlockWlcmSta "Current setting value for Door Unlock Welcome Setting Option";
BA_ "GenSigSendType" SG_ 3221225472 USM_UnlockWlcmSta 4;
BA_ "UserSigValidity" SG_ 3221225472 USM_UnlockWlcmSta 0;
BA_ "GenSigTimeoutTime" SG_ 3221225472 USM_UnlockWlcmSta 1500;
BA_ "NetworkRequest" SG_ 3221225472 USM_UnlockWlcmSta 0;
BA_ "NetworkRequestHoldingTime" SG_ 3221225472 USM_UnlockWlcmSta 5000;
BA_ "Version" SG_ 3221225472 USM_UnlockWlcmSta "17.12.00";
BA_ "Description" SG_ 3221225472 USM_SmrtWlcmSta "Current setting value for Smart Key Welcome Setting Option";
BA_ "GenSigSendType" SG_ 3221225472 USM_SmrtWlcmSta 4;
BA_ "UserSigValidity" SG_ 3221225472 USM_SmrtWlcmSta 0;
BA_ "GenSigTimeoutTime" SG_ 3221225472 USM_SmrtWlcmSta 1500;
BA_ "NetworkRequest" SG_ 3221225472 USM_SmrtWlcmSta 0;
BA_ "NetworkRequestHoldingTime" SG_ 3221225472 USM_SmrtWlcmSta 5000;
BA_ "Version" SG_ 3221225472 USM_SmrtWlcmSta "17.12.00";
BA_ "Description" SG_ 3221225472 USM_RrWiperByGearPosRSta "USM Request value of Rear wiper reverse mode";
BA_ "GenSigSendType" SG_ 3221225472 USM_RrWiperByGearPosRSta 4;
BA_ "UserSigValidity" SG_ 3221225472 USM_RrWiperByGearPosRSta 0;
BA_ "GenSigTimeoutTime" SG_ 3221225472 USM_RrWiperByGearPosRSta 1500;
BA_ "NetworkRequest" SG_ 3221225472 USM_RrWiperByGearPosRSta 0;
BA_ "NetworkRequestHoldingTime" SG_ 3221225472 USM_RrWiperByGearPosRSta 5000;
BA_ "Version" SG_ 3221225472 USM_RrWiperByGearPosRSta "17.12.00";
BA_ "Description" SG_ 3221225472 USM_RrStRmndSta "Rear seat reminder USM function signal";
BA_ "GenSigSendType" SG_ 3221225472 USM_RrStRmndSta 4;
BA_ "UserSigValidity" SG_ 3221225472 USM_RrStRmndSta 0;
BA_ "GenSigTimeoutTime" SG_ 3221225472 USM_RrStRmndSta 1500;
BA_ "NetworkRequest" SG_ 3221225472 USM_RrStRmndSta 0;
BA_ "NetworkRequestHoldingTime" SG_ 3221225472 USM_RrStRmndSta 5000;
BA_ "Version" SG_ 3221225472 USM_RrStRmndSta "17.12.00";
BA_ "Description" SG_ 3221225472 USM_TunlModAutoWdwSta "Current setting value for Tunnel mode window control";
BA_ "GenSigSendType" SG_ 3221225472 USM_TunlModAutoWdwSta 4;
BA_ "UserSigValidity" SG_ 3221225472 USM_TunlModAutoWdwSta 0;
BA_ "GenSigTimeoutTime" SG_ 3221225472 USM_TunlModAutoWdwSta 1500;
BA_ "NetworkRequest" SG_ 3221225472 USM_TunlModAutoWdwSta 0;
BA_ "NetworkRequestHoldingTime" SG_ 3221225472 USM_TunlModAutoWdwSta 5000;
BA_ "Version" SG_ 3221225472 USM_TunlModAutoWdwSta "17.12.00";
BA_ "GenSigSendType" SG_ 3221225472 IAU_PhoneNumOnWPCVal 4;
BA_ "UserSigValidity" SG_ 3221225472 IAU_PhoneNumOnWPCVal 0;
BA_ "GenSigTimeoutTime" SG_ 3221225472 IAU_PhoneNumOnWPCVal 1500;
BA_ "NetworkRequest" SG_ 3221225472 IAU_PhoneNumOnWPCVal 0;
BA_ "NetworkRequestHoldingTime" SG_ 3221225472 IAU_PhoneNumOnWPCVal 5000;
BA_ "Version" SG_ 3221225472 IAU_PhoneNumOnWPCVal "17.12.08";
BA_ "Description" SG_ 3221225472 SMK_Crc5Val "The CRC checking process calculates the CRC over the entire data block, including the CRC result CRC Polynomial (0x1D) ,

Initial Value : 0x00, XOR value : 0x00

The mathematical expression to 8 bit CRC polynomial is given here. G(x) = x8 + x4 + x3 + x2 ";
BA_ "GenSigSendType" SG_ 3221225472 SMK_Crc5Val 4;
BA_ "GenSigStartValue" SG_ 3221225472 SMK_Crc5Val 255;
BA_ "UserSigValidity" SG_ 3221225472 SMK_Crc5Val 0;
BA_ "GenSigTimeoutTime" SG_ 3221225472 SMK_Crc5Val 1500;
BA_ "Version" SG_ 3221225472 SMK_Crc5Val "17.11.00";
BA_ "Description" SG_ 3221225472 SMK_AlvCnt5Val "For the first transmission request for a data element the counter shall be initialized with 0 and shall be incremented by 1

for every subsequent send request. When the counter reaches the maximum value(0xE), then it shall restart with ? for the next sen";
BA_ "GenSigSendType" SG_ 3221225472 SMK_AlvCnt5Val 4;
BA_ "UserSigValidity" SG_ 3221225472 SMK_AlvCnt5Val 0;
BA_ "GenSigTimeoutTime" SG_ 3221225472 SMK_AlvCnt5Val 1500;
BA_ "Version" SG_ 3221225472 SMK_AlvCnt5Val "17.11.00";
BA_ "Description" SG_ 3221225472 SMK_AsstTgglBtnSta "Development for SMK";
BA_ "GenSigSendType" SG_ 3221225472 SMK_AsstTgglBtnSta 4;
BA_ "UserSigValidity" SG_ 3221225472 SMK_AsstTgglBtnSta 0;
BA_ "GenSigTimeoutTime" SG_ 3221225472 SMK_AsstTgglBtnSta 1500;
BA_ "Version" SG_ 3221225472 SMK_AsstTgglBtnSta "17.12.00";
BA_ "Description" SG_ 3221225472 SMK_DrvTglBtnSta "Development for SMK";
BA_ "GenSigSendType" SG_ 3221225472 SMK_DrvTglBtnSta 4;
BA_ "UserSigValidity" SG_ 3221225472 SMK_DrvTglBtnSta 0;
BA_ "GenSigTimeoutTime" SG_ 3221225472 SMK_DrvTglBtnSta 1500;
BA_ "Version" SG_ 3221225472 SMK_DrvTglBtnSta "17.12.00";
BA_ "Description" SG_ 3221225472 SMK_TgglBtnStuckSta "This signal represents Toggle Button's Error condition.

If Toggle Button has Fault(ex, Stuck etc..). signal has fault value.";
BA_ "GenSigSendType" SG_ 3221225472 SMK_TgglBtnStuckSta 4;
BA_ "UserSigValidity" SG_ 3221225472 SMK_TgglBtnStuckSta 0;
BA_ "GenSigTimeoutTime" SG_ 3221225472 SMK_TgglBtnStuckSta 1500;
BA_ "Version" SG_ 3221225472 SMK_TgglBtnStuckSta "17.12.00";
BA_ "Description" SG_ 3221225472 SMK_BrkSwSta "SMK+ Brake SW input state";
BA_ "GenSigSendType" SG_ 3221225472 SMK_BrkSwSta 4;
BA_ "UserSigValidity" SG_ 3221225472 SMK_BrkSwSta 0;
BA_ "GenSigTimeoutTime" SG_ 3221225472 SMK_BrkSwSta 1500;
BA_ "Version" SG_ 3221225472 SMK_BrkSwSta "17.12.00";
BA_ "Description" SG_ 3221225472 SMK_GearPosPSwSta "Clutch SW (M/T Only)

Shift lever P Postion";
BA_ "GenSigSendType" SG_ 3221225472 SMK_GearPosPSwSta 4;
BA_ "UserSigValidity" SG_ 3221225472 SMK_GearPosPSwSta 0;
BA_ "GenSigTimeoutTime" SG_ 3221225472 SMK_GearPosPSwSta 1500;
BA_ "Version" SG_ 3221225472 SMK_GearPosPSwSta "17.12.00";
BA_ "GenSigSendType" SG_ 3221225472 SMK_RpmHiByteVal 4;
BA_ "UserSigValidity" SG_ 3221225472 SMK_RpmHiByteVal 0;
BA_ "GenSigTimeoutTime" SG_ 3221225472 SMK_RpmHiByteVal 1500;
BA_ "Version" SG_ 3221225472 SMK_RpmHiByteVal "17.12.00";
BA_ "GenSigSendType" SG_ 3221225472 SMK_RpmLoByteVal 4;
BA_ "UserSigValidity" SG_ 3221225472 SMK_RpmLoByteVal 0;
BA_ "GenSigTimeoutTime" SG_ 3221225472 SMK_RpmLoByteVal 1500;
BA_ "Version" SG_ 3221225472 SMK_RpmLoByteVal "17.12.00";
BA_ "GenSigSendType" SG_ 3221225472 SMK_VehSpdDrctVal 4;
BA_ "UserSigValidity" SG_ 3221225472 SMK_VehSpdDrctVal 0;
BA_ "GenSigTimeoutTime" SG_ 3221225472 SMK_VehSpdDrctVal 1500;
BA_ "Version" SG_ 3221225472 SMK_VehSpdDrctVal "17.12.00";
BA_ "GenSigSendType" SG_ 3221225472 IAU_DigitalKeyOpt 4;
BA_ "UserSigValidity" SG_ 3221225472 IAU_DigitalKeyOpt 0;
BA_ "GenSigTimeoutTime" SG_ 3221225472 IAU_DigitalKeyOpt 1500;
BA_ "NetworkRequest" SG_ 3221225472 IAU_DigitalKeyOpt 0;
BA_ "NetworkRequestHoldingTime" SG_ 3221225472 IAU_DigitalKeyOpt 5000;
BA_ "Version" SG_ 3221225472 IAU_DigitalKeyOpt "17.12.08";
BA_ "GenSigSendType" SG_ 3221225472 IAU_NFCDeviceDetectionSta 4;
BA_ "UserSigValidity" SG_ 3221225472 IAU_NFCDeviceDetectionSta 0;
BA_ "GenSigTimeoutTime" SG_ 3221225472 IAU_NFCDeviceDetectionSta 1500;
BA_ "NetworkRequest" SG_ 3221225472 IAU_NFCDeviceDetectionSta 0;
BA_ "NetworkRequestHoldingTime" SG_ 3221225472 IAU_NFCDeviceDetectionSta 5000;
BA_ "Version" SG_ 3221225472 IAU_NFCDeviceDetectionSta "17.12.08";
BA_ "GenSigSendType" SG_ 3221225472 IAU_PhoneAuthSta 4;
BA_ "UserSigValidity" SG_ 3221225472 IAU_PhoneAuthSta 0;
BA_ "GenSigTimeoutTime" SG_ 3221225472 IAU_PhoneAuthSta 1500;
BA_ "NetworkRequest" SG_ 3221225472 IAU_PhoneAuthSta 0;
BA_ "NetworkRequestHoldingTime" SG_ 3221225472 IAU_PhoneAuthSta 5000;
BA_ "Version" SG_ 3221225472 IAU_PhoneAuthSta "17.12.08";
BA_ "GenSigSendType" SG_ 3221225472 IAU_ProfileIDParingRVal 4;
BA_ "UserSigValidity" SG_ 3221225472 IAU_ProfileIDParingRVal 0;
BA_ "GenSigTimeoutTime" SG_ 3221225472 IAU_ProfileIDParingRVal 1500;
BA_ "NetworkRequest" SG_ 3221225472 IAU_ProfileIDParingRVal 0;
BA_ "NetworkRequestHoldingTime" SG_ 3221225472 IAU_ProfileIDParingRVal 5000;
BA_ "Version" SG_ 3221225472 IAU_ProfileIDParingRVal "17.12.08";
BA_ "GenSigSendType" SG_ 3221225472 IAU_ProfileIDRVal 4;
BA_ "UserSigValidity" SG_ 3221225472 IAU_ProfileIDRVal 0;
BA_ "GenSigTimeoutTime" SG_ 3221225472 IAU_ProfileIDRVal 1500;
BA_ "NetworkRequest" SG_ 3221225472 IAU_ProfileIDRVal 0;
BA_ "NetworkRequestHoldingTime" SG_ 3221225472 IAU_ProfileIDRVal 5000;
BA_ "Version" SG_ 3221225472 IAU_ProfileIDRVal "17.12.08";
BA_ "GenSigSendType" SG_ 3221225472 IAU_DigitalKeyProcessingSta 4;
BA_ "UserSigValidity" SG_ 3221225472 IAU_DigitalKeyProcessingSta 3;
BA_ "GenSigTimeoutTime" SG_ 3221225472 IAU_DigitalKeyProcessingSta 1500;
BA_ "NetworkRequest" SG_ 3221225472 IAU_DigitalKeyProcessingSta 0;
BA_ "NetworkRequestHoldingTime" SG_ 3221225472 IAU_DigitalKeyProcessingSta 5000;
BA_ "Version" SG_ 3221225472 IAU_DigitalKeyProcessingSta "17.12.08";
BA_ "GenSigSendType" SG_ 3221225472 IAU_DigitalKeyExit 4;
BA_ "UserSigValidity" SG_ 3221225472 IAU_DigitalKeyExit 3;
BA_ "GenSigTimeoutTime" SG_ 3221225472 IAU_DigitalKeyExit 1500;
BA_ "NetworkRequest" SG_ 3221225472 IAU_DigitalKeyExit 0;
BA_ "NetworkRequestHoldingTime" SG_ 3221225472 IAU_DigitalKeyExit 5000;
BA_ "Version" SG_ 3221225472 IAU_DigitalKeyExit "17.12.08";
BA_ "GenSigSendType" SG_ 3221225472 IAU_DigitalKeyEnblRVal 4;
BA_ "UserSigValidity" SG_ 3221225472 IAU_DigitalKeyEnblRVal 0;
BA_ "GenSigTimeoutTime" SG_ 3221225472 IAU_DigitalKeyEnblRVal 1500;
BA_ "NetworkRequest" SG_ 3221225472 IAU_DigitalKeyEnblRVal 0;
BA_ "NetworkRequestHoldingTime" SG_ 3221225472 IAU_DigitalKeyEnblRVal 5000;
BA_ "Version" SG_ 3221225472 IAU_DigitalKeyEnblRVal "17.12.08";
BA_ "GenSigSendType" SG_ 3221225472 IAU_OwnerPhnRegRVal 4;
BA_ "UserSigValidity" SG_ 3221225472 IAU_OwnerPhnRegRVal 0;
BA_ "GenSigTimeoutTime" SG_ 3221225472 IAU_OwnerPhnRegRVal 1500;
BA_ "NetworkRequest" SG_ 3221225472 IAU_OwnerPhnRegRVal 0;
BA_ "NetworkRequestHoldingTime" SG_ 3221225472 IAU_OwnerPhnRegRVal 5000;
BA_ "Version" SG_ 3221225472 IAU_OwnerPhnRegRVal "17.12.08";
BA_ "GenSigSendType" SG_ 3221225472 IAU_NFCCard1RegRVal 4;
BA_ "UserSigValidity" SG_ 3221225472 IAU_NFCCard1RegRVal 0;
BA_ "GenSigTimeoutTime" SG_ 3221225472 IAU_NFCCard1RegRVal 1500;
BA_ "NetworkRequest" SG_ 3221225472 IAU_NFCCard1RegRVal 0;
BA_ "NetworkRequestHoldingTime" SG_ 3221225472 IAU_NFCCard1RegRVal 5000;
BA_ "Version" SG_ 3221225472 IAU_NFCCard1RegRVal "17.12.08";
BA_ "GenSigSendType" SG_ 3221225472 IAU_NFCCard2RegRVal 4;
BA_ "UserSigValidity" SG_ 3221225472 IAU_NFCCard2RegRVal 0;
BA_ "GenSigTimeoutTime" SG_ 3221225472 IAU_NFCCard2RegRVal 1500;
BA_ "NetworkRequest" SG_ 3221225472 IAU_NFCCard2RegRVal 0;
BA_ "NetworkRequestHoldingTime" SG_ 3221225472 IAU_NFCCard2RegRVal 5000;
BA_ "Version" SG_ 3221225472 IAU_NFCCard2RegRVal "17.12.08";
BA_ "GenSigSendType" SG_ 3221225472 IAU_RdyToSendAuthDataSta 4;
BA_ "UserSigValidity" SG_ 3221225472 IAU_RdyToSendAuthDataSta 0;
BA_ "GenSigTimeoutTime" SG_ 3221225472 IAU_RdyToSendAuthDataSta 1500;
BA_ "NetworkRequest" SG_ 3221225472 IAU_RdyToSendAuthDataSta 0;
BA_ "NetworkRequestHoldingTime" SG_ 3221225472 IAU_RdyToSendAuthDataSta 5000;
BA_ "Version" SG_ 3221225472 IAU_RdyToSendAuthDataSta "17.12.08";
BA_ "GenSigSendType" SG_ 3221225472 IAU_OptTyp 4;
BA_ "UserSigValidity" SG_ 3221225472 IAU_OptTyp 0;
BA_ "GenSigTimeoutTime" SG_ 3221225472 IAU_OptTyp 1500;
BA_ "NetworkRequest" SG_ 3221225472 IAU_OptTyp 0;
BA_ "NetworkRequestHoldingTime" SG_ 3221225472 IAU_OptTyp 5000;
BA_ "Version" SG_ 3221225472 IAU_OptTyp "17.12.08";
BA_ "GenSigSendType" SG_ 3221225472 CF_AVN_PhoneParingNValueSet 4;
BA_ "UserSigValidity" SG_ 3221225472 CF_AVN_PhoneParingNValueSet 1;
BA_ "GenSigTimeoutTime" SG_ 3221225472 CF_AVN_PhoneParingNValueSet 0;
BA_ "Version" SG_ 3221225472 CF_AVN_PhoneParingNValueSet "17.11.00";
BA_ "GenSigSendType" SG_ 3221225472 CF_AVN_ProfileIDNValueSet 4;
BA_ "UserSigValidity" SG_ 3221225472 CF_AVN_ProfileIDNValueSet 1;
BA_ "GenSigTimeoutTime" SG_ 3221225472 CF_AVN_ProfileIDNValueSet 0;
BA_ "Version" SG_ 3221225472 CF_AVN_ProfileIDNValueSet "17.11.00";
BA_ "GenSigSendType" SG_ 3221225472 NFC_Support_check_request 4;
BA_ "UserSigValidity" SG_ 3221225472 NFC_Support_check_request 1;
BA_ "GenSigTimeoutTime" SG_ 3221225472 NFC_Support_check_request 0;
BA_ "Version" SG_ 3221225472 NFC_Support_check_request "17.11.00";
BA_ "GenSigSendType" SG_ 3221225472 CF_AVN_DigitKeyEnableNValueSet 4;
BA_ "UserSigValidity" SG_ 3221225472 CF_AVN_DigitKeyEnableNValueSet 1;
BA_ "GenSigTimeoutTime" SG_ 3221225472 CF_AVN_DigitKeyEnableNValueSet 0;
BA_ "Version" SG_ 3221225472 CF_AVN_DigitKeyEnableNValueSet "17.11.00";
BA_ "GenSigSendType" SG_ 3221225472 CF_AVN_OwnerPhoneNValueSet 4;
BA_ "UserSigValidity" SG_ 3221225472 CF_AVN_OwnerPhoneNValueSet 1;
BA_ "GenSigTimeoutTime" SG_ 3221225472 CF_AVN_OwnerPhoneNValueSet 0;
BA_ "Version" SG_ 3221225472 CF_AVN_OwnerPhoneNValueSet "17.11.00";
BA_ "GenSigSendType" SG_ 3221225472 CF_AVN_NFCCard1NValueSet 4;
BA_ "UserSigValidity" SG_ 3221225472 CF_AVN_NFCCard1NValueSet 1;
BA_ "GenSigTimeoutTime" SG_ 3221225472 CF_AVN_NFCCard1NValueSet 0;
BA_ "Version" SG_ 3221225472 CF_AVN_NFCCard1NValueSet "17.11.00";
BA_ "GenSigSendType" SG_ 3221225472 CF_AVN_NFCCard2NValueSet 4;
BA_ "UserSigValidity" SG_ 3221225472 CF_AVN_NFCCard2NValueSet 1;
BA_ "GenSigTimeoutTime" SG_ 3221225472 CF_AVN_NFCCard2NValueSet 0;
BA_ "Version" SG_ 3221225472 CF_AVN_NFCCard2NValueSet "17.11.00";
BA_ "GenSigSendType" SG_ 3221225472 CF_AVN_IMSProfileNValueSet 4;
BA_ "UserSigValidity" SG_ 3221225472 CF_AVN_IMSProfileNValueSet 1;
BA_ "GenSigTimeoutTime" SG_ 3221225472 CF_AVN_IMSProfileNValueSet 0;
BA_ "Version" SG_ 3221225472 CF_AVN_IMSProfileNValueSet "17.11.00";
BA_ "GenSigSendType" SG_ 3221225472 CF_AVN_DigitalKeyMenuExit 4;
BA_ "UserSigValidity" SG_ 3221225472 CF_AVN_DigitalKeyMenuExit 1;
BA_ "GenSigTimeoutTime" SG_ 3221225472 CF_AVN_DigitalKeyMenuExit 0;
BA_ "Version" SG_ 3221225472 CF_AVN_DigitalKeyMenuExit "17.11.00";
BA_ "Description" SG_ 3221225472 BCM_Crc1Val "The CRC checking process calculates the CRC over the entire data block, including the CRC result CRC Polynomial (0x1D) ,

Initial Value : 0x00, XOR value : 0x00

The mathematical expression to 8 bit CRC polynomial is given here. G(x) = x8 + x4 + x3 + x2 ";
BA_ "GenSigSendType" SG_ 3221225472 BCM_Crc1Val 4;
BA_ "GenSigStartValue" SG_ 3221225472 BCM_Crc1Val 255;
BA_ "UserSigValidity" SG_ 3221225472 BCM_Crc1Val 0;
BA_ "GenSigTimeoutTime" SG_ 3221225472 BCM_Crc1Val 0;
BA_ "Version" SG_ 3221225472 BCM_Crc1Val "17.11.00";
BA_ "Description" SG_ 3221225472 BCM_AlvCnt1Val "For the first transmission request for a data element the counter shall be initialized with 0 and shall be incremented by 1

for every subsequent send request. When the counter reaches the maximum value(0xE), then it shall restart with ? for the next sen";
BA_ "GenSigSendType" SG_ 3221225472 BCM_AlvCnt1Val 4;
BA_ "UserSigValidity" SG_ 3221225472 BCM_AlvCnt1Val 0;
BA_ "GenSigTimeoutTime" SG_ 3221225472 BCM_AlvCnt1Val 0;
BA_ "Version" SG_ 3221225472 BCM_AlvCnt1Val "17.11.00";
BA_ "Description" SG_ 3221225472 BAlarm_AutoLockrReq "-Lock request by Auto Locking

 (BurglarAlarmFunction)";
BA_ "GenSigSendType" SG_ 3221225472 BAlarm_AutoLockrReq 4;
BA_ "UserSigValidity" SG_ 3221225472 BAlarm_AutoLockrReq 0;
BA_ "GenSigTimeoutTime" SG_ 3221225472 BAlarm_AutoLockrReq 0;
BA_ "NetworkRequest" SG_ 3221225472 BAlarm_AutoLockrReq 0;
BA_ "NetworkRequestHoldingTime" SG_ 3221225472 BAlarm_AutoLockrReq 5000;
BA_ "Version" SG_ 3221225472 BAlarm_AutoLockrReq "17.12.00";
BA_ "GenSigSendType" SG_ 3221225472 C_RH_Unfolding_SW 4;
BA_ "UserSigValidity" SG_ 3221225472 C_RH_Unfolding_SW 1;
BA_ "GenSigTimeoutTime" SG_ 3221225472 C_RH_Unfolding_SW 0;
BA_ "Version" SG_ 3221225472 C_RH_Unfolding_SW "17.11.00";
BA_ "GenSigSendType" SG_ 3221225472 C_RH_Folding_SW 4;
BA_ "UserSigValidity" SG_ 3221225472 C_RH_Folding_SW 1;
BA_ "GenSigTimeoutTime" SG_ 3221225472 C_RH_Folding_SW 0;
BA_ "Version" SG_ 3221225472 C_RH_Folding_SW "17.11.00";
BA_ "GenSigSendType" SG_ 3221225472 C_LH_Unfolding_SW 4;
BA_ "UserSigValidity" SG_ 3221225472 C_LH_Unfolding_SW 1;
BA_ "GenSigTimeoutTime" SG_ 3221225472 C_LH_Unfolding_SW 0;
BA_ "Version" SG_ 3221225472 C_LH_Unfolding_SW "17.11.00";
BA_ "GenSigSendType" SG_ 3221225472 C_LH_Folding_SW 4;
BA_ "UserSigValidity" SG_ 3221225472 C_LH_Folding_SW 1;
BA_ "GenSigTimeoutTime" SG_ 3221225472 C_LH_Folding_SW 0;
BA_ "Version" SG_ 3221225472 C_LH_Folding_SW "17.11.00";
BA_ "Description" SG_ 3221225472 DrvIMS_MemoryP1Req "-(Old)C_MEMP1CMD";
BA_ "GenSigSendType" SG_ 3221225472 DrvIMS_MemoryP1Req 4;
BA_ "UserSigValidity" SG_ 3221225472 DrvIMS_MemoryP1Req 0;
BA_ "GenSigTimeoutTime" SG_ 3221225472 DrvIMS_MemoryP1Req 0;
BA_ "NetworkRequest" SG_ 3221225472 DrvIMS_MemoryP1Req 0;
BA_ "NetworkRequestHoldingTime" SG_ 3221225472 DrvIMS_MemoryP1Req 5000;
BA_ "Version" SG_ 3221225472 DrvIMS_MemoryP1Req "17.11.00";
BA_ "Description" SG_ 3221225472 DrvIMS_MemoryP2Req "-(Old)C_MEMP2CMD";
BA_ "GenSigSendType" SG_ 3221225472 DrvIMS_MemoryP2Req 4;
BA_ "UserSigValidity" SG_ 3221225472 DrvIMS_MemoryP2Req 0;
BA_ "GenSigTimeoutTime" SG_ 3221225472 DrvIMS_MemoryP2Req 0;
BA_ "NetworkRequest" SG_ 3221225472 DrvIMS_MemoryP2Req 0;
BA_ "NetworkRequestHoldingTime" SG_ 3221225472 DrvIMS_MemoryP2Req 5000;
BA_ "Version" SG_ 3221225472 DrvIMS_MemoryP2Req "17.11.00";
BA_ "Description" SG_ 3221225472 DrvIMS_MemorySetEnaSta "-(Old)C_MEMENB";
BA_ "GenSigSendType" SG_ 3221225472 DrvIMS_MemorySetEnaSta 4;
BA_ "UserSigValidity" SG_ 3221225472 DrvIMS_MemorySetEnaSta 0;
BA_ "GenSigTimeoutTime" SG_ 3221225472 DrvIMS_MemorySetEnaSta 0;
BA_ "NetworkRequest" SG_ 3221225472 DrvIMS_MemorySetEnaSta 0;
BA_ "NetworkRequestHoldingTime" SG_ 3221225472 DrvIMS_MemorySetEnaSta 5000;
BA_ "Version" SG_ 3221225472 DrvIMS_MemorySetEnaSta "17.11.00";
BA_ "GenSigSendType" SG_ 3221225472 DrvIMS_PlyBckP1Req 4;
BA_ "UserSigValidity" SG_ 3221225472 DrvIMS_PlyBckP1Req 0;
BA_ "GenSigTimeoutTime" SG_ 3221225472 DrvIMS_PlyBckP1Req 0;
BA_ "NetworkRequest" SG_ 3221225472 DrvIMS_PlyBckP1Req 0;
BA_ "NetworkRequestHoldingTime" SG_ 3221225472 DrvIMS_PlyBckP1Req 5000;
BA_ "Version" SG_ 3221225472 DrvIMS_PlyBckP1Req "17.11.00";
BA_ "GenSigSendType" SG_ 3221225472 DrvIMS_PlyBckP2Req 4;
BA_ "UserSigValidity" SG_ 3221225472 DrvIMS_PlyBckP2Req 0;
BA_ "GenSigTimeoutTime" SG_ 3221225472 DrvIMS_PlyBckP2Req 0;
BA_ "NetworkRequest" SG_ 3221225472 DrvIMS_PlyBckP2Req 0;
BA_ "NetworkRequestHoldingTime" SG_ 3221225472 DrvIMS_PlyBckP2Req 5000;
BA_ "Version" SG_ 3221225472 DrvIMS_PlyBckP2Req "17.11.00";
BA_ "Description" SG_ 3221225472 DrvIMS_PlyBckStpReq "This signal is used to stop during playback";
BA_ "GenSigSendType" SG_ 3221225472 DrvIMS_PlyBckStpReq 4;
BA_ "UserSigValidity" SG_ 3221225472 DrvIMS_PlyBckStpReq 0;
BA_ "GenSigTimeoutTime" SG_ 3221225472 DrvIMS_PlyBckStpReq 0;
BA_ "NetworkRequest" SG_ 3221225472 DrvIMS_PlyBckStpReq 0;
BA_ "NetworkRequestHoldingTime" SG_ 3221225472 DrvIMS_PlyBckStpReq 5000;
BA_ "Version" SG_ 3221225472 DrvIMS_PlyBckStpReq "17.11.00";
BA_ "Description" SG_ 3221225472 SmrtIMS_PlyBckReq "Signal for Health Care IMS Playback DB Number";
BA_ "GenSigSendType" SG_ 3221225472 SmrtIMS_PlyBckReq 4;
BA_ "UserSigValidity" SG_ 3221225472 SmrtIMS_PlyBckReq 0;
BA_ "GenSigTimeoutTime" SG_ 3221225472 SmrtIMS_PlyBckReq 0;
BA_ "NetworkRequest" SG_ 3221225472 SmrtIMS_PlyBckReq 0;
BA_ "NetworkRequestHoldingTime" SG_ 3221225472 SmrtIMS_PlyBckReq 5000;
BA_ "Version" SG_ 3221225472 SmrtIMS_PlyBckReq "17.11.00";
BA_ "Description" SG_ 3221225472 SmrtIMS_ImgDBVal "-(Old)C_SmartIMSImageDB";
BA_ "GenSigSendType" SG_ 3221225472 SmrtIMS_ImgDBVal 4;
BA_ "UserSigValidity" SG_ 3221225472 SmrtIMS_ImgDBVal 0;
BA_ "GenSigTimeoutTime" SG_ 3221225472 SmrtIMS_ImgDBVal 0;
BA_ "NetworkRequest" SG_ 3221225472 SmrtIMS_ImgDBVal 0;
BA_ "NetworkRequestHoldingTime" SG_ 3221225472 SmrtIMS_ImgDBVal 5000;
BA_ "Version" SG_ 3221225472 SmrtIMS_ImgDBVal "17.11.00";
BA_ "Description" SG_ 3221225472 SmrtIMS_PlyBckStpReq "Health Care IMS On/Off Flag";
BA_ "GenSigSendType" SG_ 3221225472 SmrtIMS_PlyBckStpReq 4;
BA_ "UserSigValidity" SG_ 3221225472 SmrtIMS_PlyBckStpReq 0;
BA_ "GenSigTimeoutTime" SG_ 3221225472 SmrtIMS_PlyBckStpReq 0;
BA_ "NetworkRequest" SG_ 3221225472 SmrtIMS_PlyBckStpReq 0;
BA_ "NetworkRequestHoldingTime" SG_ 3221225472 SmrtIMS_PlyBckStpReq 5000;
BA_ "Version" SG_ 3221225472 SmrtIMS_PlyBckStpReq "17.11.00";
BA_ "Description" SG_ 3221225472 SmrtIMS_EnterSwSta "-(Old)C_SmartIMSOn";
BA_ "GenSigSendType" SG_ 3221225472 SmrtIMS_EnterSwSta 4;
BA_ "UserSigValidity" SG_ 3221225472 SmrtIMS_EnterSwSta 0;
BA_ "GenSigTimeoutTime" SG_ 3221225472 SmrtIMS_EnterSwSta 0;
BA_ "NetworkRequest" SG_ 3221225472 SmrtIMS_EnterSwSta 0;
BA_ "NetworkRequestHoldingTime" SG_ 3221225472 SmrtIMS_EnterSwSta 5000;
BA_ "Version" SG_ 3221225472 SmrtIMS_EnterSwSta "17.11.00";
BA_ "Description" SG_ 3221225472 DrvIMS_BzrReq "IMS 부져음을 클러스터 스피커에서 출력하기 위한 시그널";
BA_ "GenSigSendType" SG_ 3221225472 DrvIMS_BzrReq 4;
BA_ "UserSigValidity" SG_ 3221225472 DrvIMS_BzrReq 0;
BA_ "GenSigTimeoutTime" SG_ 3221225472 DrvIMS_BzrReq 0;
BA_ "NetworkRequest" SG_ 3221225472 DrvIMS_BzrReq 0;
BA_ "NetworkRequestHoldingTime" SG_ 3221225472 DrvIMS_BzrReq 5000;
BA_ "Version" SG_ 3221225472 DrvIMS_BzrReq "17.11.00";
BA_ "Description" SG_ 3221225472 DrvIMS_NotPWrngDis "-(Old)C_NotPWarnIMS";
BA_ "GenSigSendType" SG_ 3221225472 DrvIMS_NotPWrngDis 4;
BA_ "UserSigValidity" SG_ 3221225472 DrvIMS_NotPWrngDis 0;
BA_ "GenSigTimeoutTime" SG_ 3221225472 DrvIMS_NotPWrngDis 0;
BA_ "NetworkRequest" SG_ 3221225472 DrvIMS_NotPWrngDis 0;
BA_ "NetworkRequestHoldingTime" SG_ 3221225472 DrvIMS_NotPWrngDis 5000;
BA_ "Version" SG_ 3221225472 DrvIMS_NotPWrngDis "17.11.00";
BA_ "Description" SG_ 3221225472 C_TeleCrankingCmdIBOX "Remote COntrol Message";
BA_ "GenSigSendType" SG_ 3221225472 C_TeleCrankingCmdIBOX 4;
BA_ "GenSigStartValue" SG_ 3221225472 C_TeleCrankingCmdIBOX 3;
BA_ "UserSigValidity" SG_ 3221225472 C_TeleCrankingCmdIBOX 0;
BA_ "GenSigTimeoutTime" SG_ 3221225472 C_TeleCrankingCmdIBOX 1500;
BA_ "NetworkRequest" SG_ 3221225472 C_TeleCrankingCmdIBOX 0;
BA_ "NetworkRequestHoldingTime" SG_ 3221225472 C_TeleCrankingCmdIBOX 2000;
BA_ "Version" SG_ 3221225472 C_TeleCrankingCmdIBOX "17.11.00";
BA_ "Description" SG_ 3221225472 SWRC_Crc2Val "The CRC checking process calculates the CRC over the entire data block, including the CRC result CRC Polynomial (0x1D) ,

Initial Value : 0x00, XOR value : 0x00

The mathematical expression to 8 bit CRC polynomial is given here. G(x) = x8 + x4 + x3 + x2 ";
BA_ "GenSigSendType" SG_ 3221225472 SWRC_Crc2Val 4;
BA_ "GenSigStartValue" SG_ 3221225472 SWRC_Crc2Val 255;
BA_ "UserSigValidity" SG_ 3221225472 SWRC_Crc2Val 1;
BA_ "GenSigTimeoutTime" SG_ 3221225472 SWRC_Crc2Val 0;
BA_ "Version" SG_ 3221225472 SWRC_Crc2Val "17.11.00";
BA_ "Description" SG_ 3221225472 Audio_VolEncoderSta "Audio Volume switch

MM-CAN Gateway needed";
BA_ "GenSigSendType" SG_ 3221225472 Audio_VolEncoderSta 4;
BA_ "UserSigValidity" SG_ 3221225472 Audio_VolEncoderSta 1;
BA_ "GenSigTimeoutTime" SG_ 3221225472 Audio_VolEncoderSta 0;
BA_ "NetworkRequest" SG_ 3221225472 Audio_VolEncoderSta 0;
BA_ "NetworkRequestHoldingTime" SG_ 3221225472 Audio_VolEncoderSta 5000;
BA_ "Version" SG_ 3221225472 Audio_VolEncoderSta "17.11.00";
BA_ "Description" SG_ 3221225472 Cluster_ScrlEncoderSta "Cluster Trip Switch";
BA_ "GenSigSendType" SG_ 3221225472 Cluster_ScrlEncoderSta 4;
BA_ "UserSigValidity" SG_ 3221225472 Cluster_ScrlEncoderSta 1;
BA_ "GenSigTimeoutTime" SG_ 3221225472 Cluster_ScrlEncoderSta 0;
BA_ "NetworkRequest" SG_ 3221225472 Cluster_ScrlEncoderSta 0;
BA_ "NetworkRequestHoldingTime" SG_ 3221225472 Cluster_ScrlEncoderSta 5000;
BA_ "Version" SG_ 3221225472 Cluster_ScrlEncoderSta "17.11.00";
BA_ "Description" SG_ 3221225472 IFSref_VehRtAngl2Val "This is right angle of vehicle 2



Deg = (HEX)*0.1-20";
BA_ "GenSigSendType" SG_ 3221225472 IFSref_VehRtAngl2Val 2;
BA_ "UserSigValidity" SG_ 3221225472 IFSref_VehRtAngl2Val 3;
BA_ "Version" SG_ 3221225472 IFSref_VehRtAngl2Val "17.11.00";
BA_ "Description" SG_ 3221225472 IFSref_VehLftAngl3Val "This is left angle of vehicle 3



Deg = (HEX)*0.1-20";
BA_ "GenSigSendType" SG_ 3221225472 IFSref_VehLftAngl3Val 2;
BA_ "UserSigValidity" SG_ 3221225472 IFSref_VehLftAngl3Val 3;
BA_ "Version" SG_ 3221225472 IFSref_VehLftAngl3Val "17.11.00";
BA_ "Description" SG_ 3221225472 IFSref_VehRtAngl3Val "This is right angle of vehicle 3



Deg = (HEX)*0.1-20";
BA_ "GenSigSendType" SG_ 3221225472 IFSref_VehRtAngl3Val 2;
BA_ "UserSigValidity" SG_ 3221225472 IFSref_VehRtAngl3Val 3;
BA_ "Version" SG_ 3221225472 IFSref_VehRtAngl3Val "17.11.00";
BA_ "Description" SG_ 3221225472 IFSref_VehLftAngl4Val "This is left angle of vehicle 4



Deg = (HEX)*0.1-20";
BA_ "GenSigSendType" SG_ 3221225472 IFSref_VehLftAngl4Val 2;
BA_ "UserSigValidity" SG_ 3221225472 IFSref_VehLftAngl4Val 3;
BA_ "Version" SG_ 3221225472 IFSref_VehLftAngl4Val "17.11.00";
BA_ "Description" SG_ 3221225472 IFSref_VehRtAngl4Val "This is right angle of vehicle 4



Deg = (HEX)*0.1-20";
BA_ "GenSigSendType" SG_ 3221225472 IFSref_VehRtAngl4Val 2;
BA_ "UserSigValidity" SG_ 3221225472 IFSref_VehRtAngl4Val 3;
BA_ "Version" SG_ 3221225472 IFSref_VehRtAngl4Val "17.11.00";
BA_ "Description" SG_ 3221225472 IFSref_VehLftAngl5Val "This is left angle of vehicle 5



Deg = (HEX)*0.1-20";
BA_ "GenSigSendType" SG_ 3221225472 IFSref_VehLftAngl5Val 2;
BA_ "UserSigValidity" SG_ 3221225472 IFSref_VehLftAngl5Val 3;
BA_ "Version" SG_ 3221225472 IFSref_VehLftAngl5Val "17.11.00";
BA_ "Description" SG_ 3221225472 IFSref_VehRtAngl5Val "This is right angle of vehicle 5



Deg = (HEX)*0.1-20";
BA_ "GenSigSendType" SG_ 3221225472 IFSref_VehRtAngl5Val 2;
BA_ "UserSigValidity" SG_ 3221225472 IFSref_VehRtAngl5Val 3;
BA_ "Version" SG_ 3221225472 IFSref_VehRtAngl5Val "17.11.00";
BA_ "Description" SG_ 3221225472 DAU_Crc1Val "The CRC checking process calculates the CRC over the entire data block, including the CRC result CRC Polynomial (0x1D) ,

Initial Value : 0x00, XOR value : 0x00

The mathematical expression to 8 bit CRC polynomial is given here. G(x) = x8 + x4 + x3 + x2 ";
BA_ "GenSigSendType" SG_ 3221225472 DAU_Crc1Val 4;
BA_ "GenSigStartValue" SG_ 3221225472 DAU_Crc1Val 255;
BA_ "UserSigValidity" SG_ 3221225472 DAU_Crc1Val 0;
BA_ "GenSigTimeoutTime" SG_ 3221225472 DAU_Crc1Val 0;
BA_ "NetworkRequest" SG_ 3221225472 DAU_Crc1Val 0;
BA_ "NetworkRequestHoldingTime" SG_ 3221225472 DAU_Crc1Val 5000;
BA_ "Version" SG_ 3221225472 DAU_Crc1Val "17.11.00";
BA_ "Description" SG_ 3221225472 DoorLock_CtrlDrLkSwSta "-(Old)C_DRVCtrLockSw";
BA_ "GenSigSendType" SG_ 3221225472 DoorLock_CtrlDrLkSwSta 4;
BA_ "UserSigValidity" SG_ 3221225472 DoorLock_CtrlDrLkSwSta 0;
BA_ "GenSigTimeoutTime" SG_ 3221225472 DoorLock_CtrlDrLkSwSta 0;
BA_ "NetworkRequest" SG_ 3221225472 DoorLock_CtrlDrLkSwSta 0;
BA_ "NetworkRequestHoldingTime" SG_ 3221225472 DoorLock_CtrlDrLkSwSta 5000;
BA_ "Version" SG_ 3221225472 DoorLock_CtrlDrLkSwSta "17.12.00";
BA_ "Description" SG_ 3221225472 DoorLock_CtrlDrUnLkSwSta "-(Old)C_DRVCtrUnlockSw";
BA_ "GenSigSendType" SG_ 3221225472 DoorLock_CtrlDrUnLkSwSta 4;
BA_ "UserSigValidity" SG_ 3221225472 DoorLock_CtrlDrUnLkSwSta 0;
BA_ "GenSigTimeoutTime" SG_ 3221225472 DoorLock_CtrlDrUnLkSwSta 0;
BA_ "NetworkRequest" SG_ 3221225472 DoorLock_CtrlDrUnLkSwSta 0;
BA_ "NetworkRequestHoldingTime" SG_ 3221225472 DoorLock_CtrlDrUnLkSwSta 5000;
BA_ "Version" SG_ 3221225472 DoorLock_CtrlDrUnLkSwSta "17.12.00";
BA_ "Description" SG_ 3221225472 IFSref_VehLftAngl6Val "This is left angle of vehicle 6



Deg = (HEX)*0.1-20";
BA_ "GenSigSendType" SG_ 3221225472 IFSref_VehLftAngl6Val 2;
BA_ "UserSigValidity" SG_ 3221225472 IFSref_VehLftAngl6Val 3;
BA_ "Version" SG_ 3221225472 IFSref_VehLftAngl6Val "17.11.00";
BA_ "Description" SG_ 3221225472 IFSref_VehRtAngl6Val "This is right angle of vehicle 6



Deg = (HEX)*0.1-20";
BA_ "GenSigSendType" SG_ 3221225472 IFSref_VehRtAngl6Val 2;
BA_ "UserSigValidity" SG_ 3221225472 IFSref_VehRtAngl6Val 3;
BA_ "Version" SG_ 3221225472 IFSref_VehRtAngl6Val "17.11.00";
BA_ "Description" SG_ 3221225472 IFSref_VehLftAngl7Val "This is left angle of vehicle 7



Deg = (HEX)*0.1-20";
BA_ "GenSigSendType" SG_ 3221225472 IFSref_VehLftAngl7Val 2;
BA_ "UserSigValidity" SG_ 3221225472 IFSref_VehLftAngl7Val 3;
BA_ "GenSigTimeoutTime" SG_ 3221225472 IFSref_VehLftAngl7Val 0;
BA_ "Version" SG_ 3221225472 IFSref_VehLftAngl7Val "17.11.00";
BA_ "Description" SG_ 3221225472 IFSref_VehRtAngl7Val "This is right angle of vehicle 7



Deg = (HEX)*0.1-20";
BA_ "GenSigSendType" SG_ 3221225472 IFSref_VehRtAngl7Val 2;
BA_ "UserSigValidity" SG_ 3221225472 IFSref_VehRtAngl7Val 3;
BA_ "Version" SG_ 3221225472 IFSref_VehRtAngl7Val "17.11.00";
BA_ "Description" SG_ 3221225472 IFSref_VehLftAngl8Val "This is left angle of vehicle 8



Deg = (HEX)*0.1-20";
BA_ "GenSigSendType" SG_ 3221225472 IFSref_VehLftAngl8Val 2;
BA_ "UserSigValidity" SG_ 3221225472 IFSref_VehLftAngl8Val 3;
BA_ "Version" SG_ 3221225472 IFSref_VehLftAngl8Val "17.11.00";
BA_ "Description" SG_ 3221225472 IFSref_VehRtAngl8Val "This is right angle of vehicle 8



Deg = (HEX)*0.1-20";
BA_ "GenSigSendType" SG_ 3221225472 IFSref_VehRtAngl8Val 2;
BA_ "UserSigValidity" SG_ 3221225472 IFSref_VehRtAngl8Val 3;
BA_ "Version" SG_ 3221225472 IFSref_VehRtAngl8Val "17.11.00";
BA_ "Description" SG_ 3221225472 FR_CMR_Crc4Val "The CRC checking process calculates the CRC over the entire data block, including the CRC result.

- CRC Polynomial (0x1021) , Initial Value : 0xFFFF, XOR value : 0x0000

- The mathematical expression to 16 bit CRC polynomial is given here. G(x) = x16 + ";
BA_ "GenSigSendType" SG_ 3221225472 FR_CMR_Crc4Val 2;
BA_ "GenSigStartValue" SG_ 3221225472 FR_CMR_Crc4Val 65535;
BA_ "UserSigValidity" SG_ 3221225472 FR_CMR_Crc4Val 3;
BA_ "Version" SG_ 3221225472 FR_CMR_Crc4Val "17.11.00";
BA_ "Description" SG_ 3221225472 IFSref_FR_CMR_Sta "This is IFS system status needed for operate the IFS function of headlamp highbeam";
BA_ "GenSigSendType" SG_ 3221225472 IFSref_FR_CMR_Sta 2;
BA_ "UserSigValidity" SG_ 3221225472 IFSref_FR_CMR_Sta 3;
BA_ "Version" SG_ 3221225472 IFSref_FR_CMR_Sta "17.11.00";
BA_ "Description" SG_ 3221225472 IFSref_VehNumVal "This is number of vehicles detected from camera";
BA_ "GenSigSendType" SG_ 3221225472 IFSref_VehNumVal 2;
BA_ "UserSigValidity" SG_ 3221225472 IFSref_VehNumVal 3;
BA_ "Version" SG_ 3221225472 IFSref_VehNumVal "17.11.00";
BA_ "Description" SG_ 3221225472 IFSref_ILLAmbtSta "This signal is status of the ambient brightness

0x0 is bright condition (HighBeam off), 0x1 is dark condition (None)";
BA_ "GenSigSendType" SG_ 3221225472 IFSref_ILLAmbtSta 2;
BA_ "UserSigValidity" SG_ 3221225472 IFSref_ILLAmbtSta 3;
BA_ "Version" SG_ 3221225472 IFSref_ILLAmbtSta "17.11.00";
BA_ "Description" SG_ 3221225472 IFSref_VehLftAngl1Val "This is left angle of vehicle 1



Deg = (HEX)*0.1-20";
BA_ "GenSigSendType" SG_ 3221225472 IFSref_VehLftAngl1Val 2;
BA_ "UserSigValidity" SG_ 3221225472 IFSref_VehLftAngl1Val 3;
BA_ "Version" SG_ 3221225472 IFSref_VehLftAngl1Val "17.11.00";
BA_ "Description" SG_ 3221225472 IFSref_VehRtAngl1Val "This is right angle of vehicle 1



Deg = (HEX)*0.1-20";
BA_ "GenSigSendType" SG_ 3221225472 IFSref_VehRtAngl1Val 2;
BA_ "UserSigValidity" SG_ 3221225472 IFSref_VehRtAngl1Val 3;
BA_ "Version" SG_ 3221225472 IFSref_VehRtAngl1Val "17.11.00";
BA_ "Description" SG_ 3221225472 IFSref_VehLftAngl2Val "This is left angle of vehicle 2



Deg = (HEX)*0.1-20";
BA_ "GenSigSendType" SG_ 3221225472 IFSref_VehLftAngl2Val 2;
BA_ "UserSigValidity" SG_ 3221225472 IFSref_VehLftAngl2Val 3;
BA_ "Version" SG_ 3221225472 IFSref_VehLftAngl2Val "17.11.00";
BA_ "GenSigSendType" SG_ 3221225472 Navi_TunnelDistance 4;
BA_ "GenSigStartValue" SG_ 3221225472 Navi_TunnelDistance 1023;
BA_ "UserSigValidity" SG_ 3221225472 Navi_TunnelDistance 3;
BA_ "GenSigTimeoutTime" SG_ 3221225472 Navi_TunnelDistance 1500;
BA_ "Version" SG_ 3221225472 Navi_TunnelDistance "17.11.00";
BA_ "GenSigSendType" SG_ 3221225472 Navi_TunnelRoadClass 4;
BA_ "UserSigValidity" SG_ 3221225472 Navi_TunnelRoadClass 3;
BA_ "GenSigTimeoutTime" SG_ 3221225472 Navi_TunnelRoadClass 1500;
BA_ "Version" SG_ 3221225472 Navi_TunnelRoadClass "17.11.00";
BA_ "GenSigSendType" SG_ 3221225472 Navi_TunnelExist 4;
BA_ "UserSigValidity" SG_ 3221225472 Navi_TunnelExist 3;
BA_ "GenSigTimeoutTime" SG_ 3221225472 Navi_TunnelExist 1500;
BA_ "Version" SG_ 3221225472 Navi_TunnelExist "17.11.00";
BA_ "GenSigSendType" SG_ 3221225472 Navi_ParkingLot 4;
BA_ "UserSigValidity" SG_ 3221225472 Navi_ParkingLot 3;
BA_ "GenSigTimeoutTime" SG_ 3221225472 Navi_ParkingLot 1500;
BA_ "Version" SG_ 3221225472 Navi_ParkingLot "17.11.00";
BA_ "Description" SG_ 3221225472 HU_DistanceUnit "J.H.J. DR Request";
BA_ "GenSigSendType" SG_ 3221225472 HU_DistanceUnit 4;
BA_ "GenSigStartValue" SG_ 3221225472 HU_DistanceUnit 3;
BA_ "UserSigValidity" SG_ 3221225472 HU_DistanceUnit 1;
BA_ "GenSigTimeoutTime" SG_ 3221225472 HU_DistanceUnit 1500;
BA_ "NetworkRequest" SG_ 3221225472 HU_DistanceUnit 0;
BA_ "Version" SG_ 3221225472 HU_DistanceUnit "17.11.00";
BA_ "GenSigSendType" SG_ 3221225472 HU_AliveStatus 4;
BA_ "GenSigStartValue" SG_ 3221225472 HU_AliveStatus 3;
BA_ "UserSigValidity" SG_ 3221225472 HU_AliveStatus 0;
BA_ "GenSigTimeoutTime" SG_ 3221225472 HU_AliveStatus 1500;
BA_ "NetworkRequest" SG_ 3221225472 HU_AliveStatus 0;
BA_ "Version" SG_ 3221225472 HU_AliveStatus "17.11.00";
BA_ "GenSigSendType" SG_ 3221225472 HU_MicActivity 4;
BA_ "GenSigStartValue" SG_ 3221225472 HU_MicActivity 3;
BA_ "UserSigValidity" SG_ 3221225472 HU_MicActivity 0;
BA_ "GenSigTimeoutTime" SG_ 3221225472 HU_MicActivity 1500;
BA_ "Version" SG_ 3221225472 HU_MicActivity "17.11.00";
BA_ "GenSigSendType" SG_ 3221225472 AVN_RSPA_CancelInput 4;
BA_ "UserSigValidity" SG_ 3221225472 AVN_RSPA_CancelInput 3;
BA_ "GenSigTimeoutTime" SG_ 3221225472 AVN_RSPA_CancelInput 1500;
BA_ "Version" SG_ 3221225472 AVN_RSPA_CancelInput "17.11.00";
BA_ "Description" SG_ 3221225472 AVN_RSPA_ModeSetStat "Signal for User's RSPA mode setting

RSPA 모드 선택 메뉴 선택 결과 (최좌측 기준)";
BA_ "GenSigSendType" SG_ 3221225472 AVN_RSPA_ModeSetStat 4;
BA_ "GenSigStartValue" SG_ 3221225472 AVN_RSPA_ModeSetStat 15;
BA_ "UserSigValidity" SG_ 3221225472 AVN_RSPA_ModeSetStat 3;
BA_ "GenSigTimeoutTime" SG_ 3221225472 AVN_RSPA_ModeSetStat 1500;
BA_ "Version" SG_ 3221225472 AVN_RSPA_ModeSetStat "17.11.00";
BA_ "GenSigSendType" SG_ 3221225472 HU_TempUnit 4;
BA_ "GenSigStartValue" SG_ 3221225472 HU_TempUnit 3;
BA_ "UserSigValidity" SG_ 3221225472 HU_TempUnit 1;
BA_ "GenSigTimeoutTime" SG_ 3221225472 HU_TempUnit 1500;
BA_ "Version" SG_ 3221225472 HU_TempUnit "17.11.00";
BA_ "GenSigSendType" SG_ 3221225472 AVN_RSPA_Disp_Rdy 4;
BA_ "GenSigStartValue" SG_ 3221225472 AVN_RSPA_Disp_Rdy 3;
BA_ "UserSigValidity" SG_ 3221225472 AVN_RSPA_Disp_Rdy 3;
BA_ "GenSigTimeoutTime" SG_ 3221225472 AVN_RSPA_Disp_Rdy 1500;
BA_ "Version" SG_ 3221225472 AVN_RSPA_Disp_Rdy "17.11.00";
BA_ "Description" SG_ 3221225472 HazardFromHUSVM "18.02.01_";
BA_ "GenSigSendType" SG_ 3221225472 HazardFromHUSVM 4;
BA_ "GenSigStartValue" SG_ 3221225472 HazardFromHUSVM 3;
BA_ "UserSigValidity" SG_ 3221225472 HazardFromHUSVM 0;
BA_ "GenSigTimeoutTime" SG_ 3221225472 HazardFromHUSVM 1500;
BA_ "Version" SG_ 3221225472 HazardFromHUSVM "18.05.01";
BA_ "Description" SG_ 3221225472 OMUOSMirCtrl "18.02.01_";
BA_ "GenSigSendType" SG_ 3221225472 OMUOSMirCtrl 4;
BA_ "GenSigStartValue" SG_ 3221225472 OMUOSMirCtrl 3;
BA_ "UserSigValidity" SG_ 3221225472 OMUOSMirCtrl 0;
BA_ "GenSigTimeoutTime" SG_ 3221225472 OMUOSMirCtrl 1500;
BA_ "Version" SG_ 3221225472 OMUOSMirCtrl "18.05.01";
BA_ "Description" SG_ 3221225472 AVN_PDW_Input "18.04.00_";
BA_ "GenSigSendType" SG_ 3221225472 AVN_PDW_Input 4;
BA_ "GenSigStartValue" SG_ 3221225472 AVN_PDW_Input 3;
BA_ "UserSigValidity" SG_ 3221225472 AVN_PDW_Input 3;
BA_ "GenSigTimeoutTime" SG_ 3221225472 AVN_PDW_Input 1500;
BA_ "Version" SG_ 3221225472 AVN_PDW_Input "18.05.01";
BA_ "Description" SG_ 3221225472 AVN_RSPA_Input "18.04.00_";
BA_ "GenSigSendType" SG_ 3221225472 AVN_RSPA_Input 4;
BA_ "GenSigStartValue" SG_ 3221225472 AVN_RSPA_Input 3;
BA_ "UserSigValidity" SG_ 3221225472 AVN_RSPA_Input 3;
BA_ "GenSigTimeoutTime" SG_ 3221225472 AVN_RSPA_Input 1500;
BA_ "Version" SG_ 3221225472 AVN_RSPA_Input "18.05.01";
BA_ "Description" SG_ 3221225472 AVN_ParkingSW "18.04.00_";
BA_ "GenSigSendType" SG_ 3221225472 AVN_ParkingSW 4;
BA_ "GenSigStartValue" SG_ 3221225472 AVN_ParkingSW 7;
BA_ "UserSigValidity" SG_ 3221225472 AVN_ParkingSW 3;
BA_ "GenSigTimeoutTime" SG_ 3221225472 AVN_ParkingSW 1500;
BA_ "Version" SG_ 3221225472 AVN_ParkingSW "18.05.01";
BA_ "Description" SG_ 3221225472 SMK_Crc1Val "The CRC checking process calculates the CRC over the entire data block, including the CRC result CRC Polynomial (0x1D) ,

Initial Value : 0x00, XOR value : 0x00

The mathematical expression to 8 bit CRC polynomial is given here. G(x) = x8 + x4 + x3 + x2 ";
BA_ "GenSigSendType" SG_ 3221225472 SMK_Crc1Val 4;
BA_ "GenSigStartValue" SG_ 3221225472 SMK_Crc1Val 255;
BA_ "UserSigValidity" SG_ 3221225472 SMK_Crc1Val 0;
BA_ "GenSigTimeoutTime" SG_ 3221225472 SMK_Crc1Val 0;
BA_ "Version" SG_ 3221225472 SMK_Crc1Val "17.11.00";
BA_ "Description" SG_ 3221225472 SMK_AlvCnt1Val "For the first transmission request for a data element the counter shall be initialized with 0 and shall be incremented by 1

for every subsequent send request. When the counter reaches the maximum value(0xE), then it shall restart with ? for the next sen";
BA_ "GenSigSendType" SG_ 3221225472 SMK_AlvCnt1Val 4;
BA_ "UserSigValidity" SG_ 3221225472 SMK_AlvCnt1Val 0;
BA_ "GenSigTimeoutTime" SG_ 3221225472 SMK_AlvCnt1Val 0;
BA_ "Version" SG_ 3221225472 SMK_AlvCnt1Val "17.11.00";
BA_ "GenSigSendType" SG_ 3221225472 DoorLock_PsvDrLkReq 4;
BA_ "UserSigValidity" SG_ 3221225472 DoorLock_PsvDrLkReq 0;
BA_ "GenSigTimeoutTime" SG_ 3221225472 DoorLock_PsvDrLkReq 0;
BA_ "Version" SG_ 3221225472 DoorLock_PsvDrLkReq "17.12.00";
BA_ "GenSigSendType" SG_ 3221225472 DoorLock_PsvDrUnLkReq 4;
BA_ "UserSigValidity" SG_ 3221225472 DoorLock_PsvDrUnLkReq 0;
BA_ "GenSigTimeoutTime" SG_ 3221225472 DoorLock_PsvDrUnLkReq 0;
BA_ "Version" SG_ 3221225472 DoorLock_PsvDrUnLkReq "17.12.00";
BA_ "Description" SG_ 3221225472 DoorLock_DrvDrPsvAcsReq "-(Old)C_P_FL";
BA_ "GenSigSendType" SG_ 3221225472 DoorLock_DrvDrPsvAcsReq 4;
BA_ "UserSigValidity" SG_ 3221225472 DoorLock_DrvDrPsvAcsReq 0;
BA_ "GenSigTimeoutTime" SG_ 3221225472 DoorLock_DrvDrPsvAcsReq 0;
BA_ "Version" SG_ 3221225472 DoorLock_DrvDrPsvAcsReq "17.12.00";
BA_ "Description" SG_ 3221225472 DoorLock_AsstDrPsvAcsReq "-(Old)C_P_FR";
BA_ "GenSigSendType" SG_ 3221225472 DoorLock_AsstDrPsvAcsReq 4;
BA_ "UserSigValidity" SG_ 3221225472 DoorLock_AsstDrPsvAcsReq 0;
BA_ "GenSigTimeoutTime" SG_ 3221225472 DoorLock_AsstDrPsvAcsReq 0;
BA_ "Version" SG_ 3221225472 DoorLock_AsstDrPsvAcsReq "17.12.00";
BA_ "Description" SG_ 3221225472 DoorLock_TrnkTlgtPsvAcsReq "-(Old)C_PassiveTrunk_TG";
BA_ "GenSigSendType" SG_ 3221225472 DoorLock_TrnkTlgtPsvAcsReq 4;
BA_ "UserSigValidity" SG_ 3221225472 DoorLock_TrnkTlgtPsvAcsReq 0;
BA_ "GenSigTimeoutTime" SG_ 3221225472 DoorLock_TrnkTlgtPsvAcsReq 0;
BA_ "Version" SG_ 3221225472 DoorLock_TrnkTlgtPsvAcsReq "17.12.00";
BA_ "Description" SG_ 3221225472 Auth_Req "Request NFC / Fingerprint authentication";
BA_ "GenSigSendType" SG_ 3221225472 Auth_Req 4;
BA_ "UserSigValidity" SG_ 3221225472 Auth_Req 0;
BA_ "GenSigTimeoutTime" SG_ 3221225472 Auth_Req 0;
BA_ "NetworkRequest" SG_ 3221225472 Auth_Req 0;
BA_ "NetworkRequestHoldingTime" SG_ 3221225472 Auth_Req 5000;
BA_ "Version" SG_ 3221225472 Auth_Req "18.02.00";
BA_ "Description" SG_ 3221225472 RSPA_CanTmotFlagSta "This Signal repesents Timeout State of CAN signals.(From RSPA Unit)

When RSPA Related signal have can timeout, this signal set value 0x1(RSPA Timeout)



This signal would use to determin why vehicle's engine is stoped.";
BA_ "GenSigSendType" SG_ 3221225472 RSPA_CanTmotFlagSta 4;
BA_ "UserSigValidity" SG_ 3221225472 RSPA_CanTmotFlagSta 0;
BA_ "GenSigTimeoutTime" SG_ 3221225472 RSPA_CanTmotFlagSta 0;
BA_ "Version" SG_ 3221225472 RSPA_CanTmotFlagSta "17.12.00";
BA_ "GenSigSendType" SG_ 3221225472 Mirror_SmrtWlcmMirrReq 4;
BA_ "UserSigValidity" SG_ 3221225472 Mirror_SmrtWlcmMirrReq 0;
BA_ "GenSigTimeoutTime" SG_ 3221225472 Mirror_SmrtWlcmMirrReq 0;
BA_ "NetworkRequest" SG_ 3221225472 Mirror_SmrtWlcmMirrReq 0;
BA_ "NetworkRequestHoldingTime" SG_ 3221225472 Mirror_SmrtWlcmMirrReq 5000;
BA_ "Version" SG_ 3221225472 Mirror_SmrtWlcmMirrReq "17.12.00";
BA_ "Description" SG_ 3221225472 RKE_Crc1Val "The CRC checking process calculates the CRC over the entire data block, including the CRC result CRC Polynomial (0x1D) ,

Initial Value : 0x00, XOR value : 0x00

The mathematical expression to 8 bit CRC polynomial is given here. G(x) = x8 + x4 + x3 + x2 ";
BA_ "GenSigSendType" SG_ 3221225472 RKE_Crc1Val 4;
BA_ "GenSigStartValue" SG_ 3221225472 RKE_Crc1Val 255;
BA_ "UserSigValidity" SG_ 3221225472 RKE_Crc1Val 0;
BA_ "GenSigTimeoutTime" SG_ 3221225472 RKE_Crc1Val 0;
BA_ "Version" SG_ 3221225472 RKE_Crc1Val "17.11.00";
BA_ "Description" SG_ 3221225472 RKE_AlvCnt1Val "For the first transmission request for a data element the counter shall be initialized with 0 and shall be incremented by 1

for every subsequent send request. When the counter reaches the maximum value(0xE), then it shall restart with ? for the next sen";
BA_ "GenSigSendType" SG_ 3221225472 RKE_AlvCnt1Val 4;
BA_ "UserSigValidity" SG_ 3221225472 RKE_AlvCnt1Val 0;
BA_ "GenSigTimeoutTime" SG_ 3221225472 RKE_AlvCnt1Val 0;
BA_ "Version" SG_ 3221225472 RKE_AlvCnt1Val "17.11.00";
BA_ "Description" SG_ 3221225472 RKE_BtnReq "Remote Key Button Request from Folding Key or Smart Key";
BA_ "GenSigSendType" SG_ 3221225472 RKE_BtnReq 4;
BA_ "UserSigValidity" SG_ 3221225472 RKE_BtnReq 0;
BA_ "GenSigTimeoutTime" SG_ 3221225472 RKE_BtnReq 0;
BA_ "NetworkRequest" SG_ 3221225472 RKE_BtnReq 0;
BA_ "NetworkRequestHoldingTime" SG_ 3221225472 RKE_BtnReq 5000;
BA_ "Version" SG_ 3221225472 RKE_BtnReq "17.12.00";
BA_ "Description" SG_ 3221225472 RKE_WdwUpDnReq "Remote Key Window Up and Down Request from Folding Key or Smart Key";
BA_ "GenSigSendType" SG_ 3221225472 RKE_WdwUpDnReq 4;
BA_ "UserSigValidity" SG_ 3221225472 RKE_WdwUpDnReq 0;
BA_ "GenSigTimeoutTime" SG_ 3221225472 RKE_WdwUpDnReq 0;
BA_ "NetworkRequest" SG_ 3221225472 RKE_WdwUpDnReq 0;
BA_ "NetworkRequestHoldingTime" SG_ 3221225472 RKE_WdwUpDnReq 5000;
BA_ "Version" SG_ 3221225472 RKE_WdwUpDnReq "17.12.00";
BA_ "Description" SG_ 3221225472 RKE_ID "Remote Key Window Up and Down Request from Folding Key or Smart Key



Folding key or smart key ID for recently received RF frame";
BA_ "GenSigSendType" SG_ 3221225472 RKE_ID 4;
BA_ "UserSigValidity" SG_ 3221225472 RKE_ID 0;
BA_ "GenSigTimeoutTime" SG_ 3221225472 RKE_ID 0;
BA_ "Version" SG_ 3221225472 RKE_ID "17.12.00";
BA_ "GenSigSendType" SG_ 3221225472 IAU_NFCWPCDeviceScanReq 4;
BA_ "UserSigValidity" SG_ 3221225472 IAU_NFCWPCDeviceScanReq 0;
BA_ "GenSigTimeoutTime" SG_ 3221225472 IAU_NFCWPCDeviceScanReq 0;
BA_ "NetworkRequest" SG_ 3221225472 IAU_NFCWPCDeviceScanReq 0;
BA_ "NetworkRequestHoldingTime" SG_ 3221225472 IAU_NFCWPCDeviceScanReq 5000;
BA_ "Version" SG_ 3221225472 IAU_NFCWPCDeviceScanReq "17.12.08";
BA_ "GenSigSendType" SG_ 3221225472 IAU_LftDrHndLockSnsrSta 4;
BA_ "UserSigValidity" SG_ 3221225472 IAU_LftDrHndLockSnsrSta 0;
BA_ "GenSigTimeoutTime" SG_ 3221225472 IAU_LftDrHndLockSnsrSta 0;
BA_ "NetworkRequest" SG_ 3221225472 IAU_LftDrHndLockSnsrSta 0;
BA_ "NetworkRequestHoldingTime" SG_ 3221225472 IAU_LftDrHndLockSnsrSta 5000;
BA_ "Version" SG_ 3221225472 IAU_LftDrHndLockSnsrSta "18.01.08";
BA_ "GenSigSendType" SG_ 3221225472 IAU_LftDrHndUnlockSnsrSta 4;
BA_ "UserSigValidity" SG_ 3221225472 IAU_LftDrHndUnlockSnsrSta 0;
BA_ "GenSigTimeoutTime" SG_ 3221225472 IAU_LftDrHndUnlockSnsrSta 0;
BA_ "NetworkRequest" SG_ 3221225472 IAU_LftDrHndUnlockSnsrSta 0;
BA_ "NetworkRequestHoldingTime" SG_ 3221225472 IAU_LftDrHndUnlockSnsrSta 5000;
BA_ "Version" SG_ 3221225472 IAU_LftDrHndUnlockSnsrSta "18.01.08";
BA_ "GenSigSendType" SG_ 3221225472 IAU_RtDrHndLockSnsrSta 4;
BA_ "UserSigValidity" SG_ 3221225472 IAU_RtDrHndLockSnsrSta 0;
BA_ "GenSigTimeoutTime" SG_ 3221225472 IAU_RtDrHndLockSnsrSta 0;
BA_ "NetworkRequest" SG_ 3221225472 IAU_RtDrHndLockSnsrSta 0;
BA_ "NetworkRequestHoldingTime" SG_ 3221225472 IAU_RtDrHndLockSnsrSta 5000;
BA_ "Version" SG_ 3221225472 IAU_RtDrHndLockSnsrSta "18.01.08";
BA_ "GenSigSendType" SG_ 3221225472 IAU_RtDrHndUnlockSnsrSta 4;
BA_ "UserSigValidity" SG_ 3221225472 IAU_RtDrHndUnlockSnsrSta 0;
BA_ "GenSigTimeoutTime" SG_ 3221225472 IAU_RtDrHndUnlockSnsrSta 0;
BA_ "NetworkRequest" SG_ 3221225472 IAU_RtDrHndUnlockSnsrSta 0;
BA_ "NetworkRequestHoldingTime" SG_ 3221225472 IAU_RtDrHndUnlockSnsrSta 5000;
BA_ "Version" SG_ 3221225472 IAU_RtDrHndUnlockSnsrSta "18.01.08";
BA_ "GenSigSendType" SG_ 3221225472 IAU_LftDrHndWlightSta 4;
BA_ "UserSigValidity" SG_ 3221225472 IAU_LftDrHndWlightSta 0;
BA_ "GenSigTimeoutTime" SG_ 3221225472 IAU_LftDrHndWlightSta 0;
BA_ "NetworkRequest" SG_ 3221225472 IAU_LftDrHndWlightSta 0;
BA_ "NetworkRequestHoldingTime" SG_ 3221225472 IAU_LftDrHndWlightSta 5000;
BA_ "Version" SG_ 3221225472 IAU_LftDrHndWlightSta "18.01.08";
BA_ "GenSigSendType" SG_ 3221225472 IAU_RtDrHndWlightSta 4;
BA_ "UserSigValidity" SG_ 3221225472 IAU_RtDrHndWlightSta 0;
BA_ "GenSigTimeoutTime" SG_ 3221225472 IAU_RtDrHndWlightSta 0;
BA_ "NetworkRequest" SG_ 3221225472 IAU_RtDrHndWlightSta 0;
BA_ "NetworkRequestHoldingTime" SG_ 3221225472 IAU_RtDrHndWlightSta 5000;
BA_ "Version" SG_ 3221225472 IAU_RtDrHndWlightSta "18.01.08";
BA_ "GenSigSendType" SG_ 3221225472 IAU_AuthDevice 4;
BA_ "UserSigValidity" SG_ 3221225472 IAU_AuthDevice 0;
BA_ "GenSigTimeoutTime" SG_ 3221225472 IAU_AuthDevice 0;
BA_ "NetworkRequest" SG_ 3221225472 IAU_AuthDevice 0;
BA_ "NetworkRequestHoldingTime" SG_ 3221225472 IAU_AuthDevice 5000;
BA_ "Version" SG_ 3221225472 IAU_AuthDevice "18.02.00";
BA_ "GenSigSendType" SG_ 3221225472 IAU_AuthResult 4;
BA_ "UserSigValidity" SG_ 3221225472 IAU_AuthResult 0;
BA_ "GenSigTimeoutTime" SG_ 3221225472 IAU_AuthResult 0;
BA_ "NetworkRequest" SG_ 3221225472 IAU_AuthResult 0;
BA_ "NetworkRequestHoldingTime" SG_ 3221225472 IAU_AuthResult 5000;
BA_ "Version" SG_ 3221225472 IAU_AuthResult "18.02.00";
BA_ "GenSigSendType" SG_ 3221225472 IAU_Msg01Develop0Val 4;
BA_ "UserSigValidity" SG_ 3221225472 IAU_Msg01Develop0Val 0;
BA_ "GenSigTimeoutTime" SG_ 3221225472 IAU_Msg01Develop0Val 0;
BA_ "NetworkRequest" SG_ 3221225472 IAU_Msg01Develop0Val 0;
BA_ "NetworkRequestHoldingTime" SG_ 3221225472 IAU_Msg01Develop0Val 5000;
BA_ "Version" SG_ 3221225472 IAU_Msg01Develop0Val "17.12.08";
BA_ "GenSigSendType" SG_ 3221225472 IAU_Msg01Develop1Val 4;
BA_ "UserSigValidity" SG_ 3221225472 IAU_Msg01Develop1Val 0;
BA_ "GenSigTimeoutTime" SG_ 3221225472 IAU_Msg01Develop1Val 0;
BA_ "NetworkRequest" SG_ 3221225472 IAU_Msg01Develop1Val 0;
BA_ "NetworkRequestHoldingTime" SG_ 3221225472 IAU_Msg01Develop1Val 5000;
BA_ "Version" SG_ 3221225472 IAU_Msg01Develop1Val "17.12.08";
BA_ "GenSigSendType" SG_ 3221225472 IAU_Msg01Develop2Val 4;
BA_ "UserSigValidity" SG_ 3221225472 IAU_Msg01Develop2Val 0;
BA_ "GenSigTimeoutTime" SG_ 3221225472 IAU_Msg01Develop2Val 0;
BA_ "NetworkRequest" SG_ 3221225472 IAU_Msg01Develop2Val 0;
BA_ "NetworkRequestHoldingTime" SG_ 3221225472 IAU_Msg01Develop2Val 5000;
BA_ "Version" SG_ 3221225472 IAU_Msg01Develop2Val "17.12.08";
BA_ "GenSigSendType" SG_ 3221225472 IAU_Msg01Develop3Val 4;
BA_ "UserSigValidity" SG_ 3221225472 IAU_Msg01Develop3Val 0;
BA_ "GenSigTimeoutTime" SG_ 3221225472 IAU_Msg01Develop3Val 0;
BA_ "NetworkRequest" SG_ 3221225472 IAU_Msg01Develop3Val 0;
BA_ "NetworkRequestHoldingTime" SG_ 3221225472 IAU_Msg01Develop3Val 5000;
BA_ "Version" SG_ 3221225472 IAU_Msg01Develop3Val "17.12.08";
BA_ "GenSigSendType" SG_ 3221225472 IAU_Msg01Develop4Val 4;
BA_ "UserSigValidity" SG_ 3221225472 IAU_Msg01Develop4Val 0;
BA_ "GenSigTimeoutTime" SG_ 3221225472 IAU_Msg01Develop4Val 0;
BA_ "NetworkRequest" SG_ 3221225472 IAU_Msg01Develop4Val 0;
BA_ "NetworkRequestHoldingTime" SG_ 3221225472 IAU_Msg01Develop4Val 5000;
BA_ "Version" SG_ 3221225472 IAU_Msg01Develop4Val "17.12.08";
BA_ "GenSigSendType" SG_ 3221225472 IAU_Msg01Develop5Val 4;
BA_ "UserSigValidity" SG_ 3221225472 IAU_Msg01Develop5Val 0;
BA_ "GenSigTimeoutTime" SG_ 3221225472 IAU_Msg01Develop5Val 0;
BA_ "NetworkRequest" SG_ 3221225472 IAU_Msg01Develop5Val 0;
BA_ "NetworkRequestHoldingTime" SG_ 3221225472 IAU_Msg01Develop5Val 5000;
BA_ "Version" SG_ 3221225472 IAU_Msg01Develop5Val "17.12.08";
BA_ "GenSigSendType" SG_ 3221225472 IAU_Msg01Develop6Val 4;
BA_ "UserSigValidity" SG_ 3221225472 IAU_Msg01Develop6Val 0;
BA_ "GenSigTimeoutTime" SG_ 3221225472 IAU_Msg01Develop6Val 0;
BA_ "NetworkRequest" SG_ 3221225472 IAU_Msg01Develop6Val 0;
BA_ "NetworkRequestHoldingTime" SG_ 3221225472 IAU_Msg01Develop6Val 5000;
BA_ "Version" SG_ 3221225472 IAU_Msg01Develop6Val "17.12.08";
BA_ "GenSigSendType" SG_ 3221225472 IAU_Msg01Develop7Val 4;
BA_ "UserSigValidity" SG_ 3221225472 IAU_Msg01Develop7Val 0;
BA_ "GenSigTimeoutTime" SG_ 3221225472 IAU_Msg01Develop7Val 0;
BA_ "NetworkRequest" SG_ 3221225472 IAU_Msg01Develop7Val 0;
BA_ "NetworkRequestHoldingTime" SG_ 3221225472 IAU_Msg01Develop7Val 5000;
BA_ "Version" SG_ 3221225472 IAU_Msg01Develop7Val "17.12.08";
BA_ "GenSigSendType" SG_ 3221225472 IAU_FOBSrch 4;
BA_ "UserSigValidity" SG_ 3221225472 IAU_FOBSrch 0;
BA_ "GenSigTimeoutTime" SG_ 3221225472 IAU_FOBSrch 0;
BA_ "NetworkRequest" SG_ 3221225472 IAU_FOBSrch 0;
BA_ "NetworkRequestHoldingTime" SG_ 3221225472 IAU_FOBSrch 5000;
BA_ "Version" SG_ 3221225472 IAU_FOBSrch "17.12.08";
BA_ "GenSigSendType" SG_ 3221225472 IAU_RandomNumVal 4;
BA_ "UserSigValidity" SG_ 3221225472 IAU_RandomNumVal 0;
BA_ "GenSigTimeoutTime" SG_ 3221225472 IAU_RandomNumVal 0;
BA_ "NetworkRequest" SG_ 3221225472 IAU_RandomNumVal 0;
BA_ "NetworkRequestHoldingTime" SG_ 3221225472 IAU_RandomNumVal 5000;
BA_ "Version" SG_ 3221225472 IAU_RandomNumVal "17.12.08";
BA_ "Description" SG_ 3221225472 WHL_SpdFLVal "This signal provides the wheel velocity of each wheel and have 14 bits length and a resolution of 0.03125 km^h.(This resolution is higher than that of signal in TCS5).

In case of failure of one wheel speed sensor, the value 3FFFH is used as error identi";
BA_ "UserSigValidity" SG_ 3221225472 WHL_SpdFLVal 3;
BA_ "RoutingFactor" SG_ 3221225472 WHL_SpdFLVal 5;
BA_ "Version" SG_ 3221225472 WHL_SpdFLVal "17.12.00";
BA_ "Description" SG_ 3221225472 WHL_SpdFRVal "This signal provides the wheel velocity of each wheel and have 14 bits length and a resolution of 0.03125 km^h.(This resolution is higher than that of signal in TCS5).

In case of failure of one wheel speed sensor, the value 3FFFH is used as error identi";
BA_ "UserSigValidity" SG_ 3221225472 WHL_SpdFRVal 3;
BA_ "RoutingFactor" SG_ 3221225472 WHL_SpdFRVal 5;
BA_ "Version" SG_ 3221225472 WHL_SpdFRVal "17.12.00";
BA_ "Description" SG_ 3221225472 WHL_SpdRLVal "This signal provides the wheel velocity of each wheel and have 14 bits length and a resolution of 0.03125 km^h.(This resolution is higher than that of signal in TCS5).

In case of failure of one wheel speed sensor, the value 3FFFH is used as error identi";
BA_ "UserSigValidity" SG_ 3221225472 WHL_SpdRLVal 3;
BA_ "RoutingFactor" SG_ 3221225472 WHL_SpdRLVal 5;
BA_ "Version" SG_ 3221225472 WHL_SpdRLVal "17.12.00";
BA_ "Description" SG_ 3221225472 WHL_SpdRRVal "This signal provides the wheel velocity of each wheel and have 14 bits length and a resolution of 0.03125 km^h.(This resolution is higher than that of signal in TCS5).

In case of failure of one wheel speed sensor, the value 3FFFH is used as error identi";
BA_ "UserSigValidity" SG_ 3221225472 WHL_SpdRRVal 3;
BA_ "RoutingFactor" SG_ 3221225472 WHL_SpdRRVal 5;
BA_ "Version" SG_ 3221225472 WHL_SpdRRVal "17.12.00";
BA_ "Description" SG_ 3221225472 WHL_Crc1Val "The CRC checking process calculates the CRC over the entire data block, including the CRC result.

- CRC Polynomial (0x1021) , Initial Value : 0xFFFF, XOR value : 0x0000

- The mathematical expression to 16 bit CRC polynomial is given here. G(x) = x16 + ";
BA_ "GenSigStartValue" SG_ 3221225472 WHL_Crc1Val 65535;
BA_ "UserSigValidity" SG_ 3221225472 WHL_Crc1Val 3;
BA_ "RoutingFactor" SG_ 3221225472 WHL_Crc1Val 5;
BA_ "Version" SG_ 3221225472 WHL_Crc1Val "17.11.00";
BA_ "Description" SG_ 3221225472 WHL_AlvCnt1Val "For the first transmission request for a data element the counter shall be initialized with 0 and shall be incremented by 1

for every subsequent send request. When the counter reaches the maximum value(0xFF), then it shall restart with ? for the next se";
BA_ "UserSigValidity" SG_ 3221225472 WHL_AlvCnt1Val 3;
BA_ "RoutingFactor" SG_ 3221225472 WHL_AlvCnt1Val 5;
BA_ "Version" SG_ 3221225472 WHL_AlvCnt1Val "17.11.00";
BA_ "Description" SG_ 3221225472 WHL_PlsFLVal "This signal indicates accumulated pulse counter of ABS^ESC wheel speed sensor (FL^FR^RL^RR)

Receiver unit uses this signal for calculation of vehicle movement distance.

Requested resolution of this signal is 0.5 pulses and refer to below (wheel sensor ";
BA_ "UserSigValidity" SG_ 3221225472 WHL_PlsFLVal 3;
BA_ "RoutingFactor" SG_ 3221225472 WHL_PlsFLVal 5;
BA_ "Version" SG_ 3221225472 WHL_PlsFLVal "17.12.00";
BA_ "Description" SG_ 3221225472 WHL_PlsFRVal "This signal indicates accumulated pulse counter of ABS^ESC wheel speed sensor (FL^FR^RL^RR)

Receiver unit uses this signal for calculation of vehicle movement distance.

Requested resolution of this signal is 0.5 pulses and refer to below (wheel sensor ";
BA_ "UserSigValidity" SG_ 3221225472 WHL_PlsFRVal 3;
BA_ "RoutingFactor" SG_ 3221225472 WHL_PlsFRVal 5;
BA_ "Version" SG_ 3221225472 WHL_PlsFRVal "17.12.00";
BA_ "Description" SG_ 3221225472 WHL_PlsRLVal "This signal indicates accumulated pulse counter of ABS^ESC wheel speed sensor (FL^FR^RL^RR)

Receiver unit uses this signal for calculation of vehicle movement distance.

Requested resolution of this signal is 0.5 pulses and refer to below (wheel sensor ";
BA_ "UserSigValidity" SG_ 3221225472 WHL_PlsRLVal 3;
BA_ "RoutingFactor" SG_ 3221225472 WHL_PlsRLVal 5;
BA_ "Version" SG_ 3221225472 WHL_PlsRLVal "17.12.00";
BA_ "Description" SG_ 3221225472 WHL_PlsRRVal "This signal indicates accumulated pulse counter of ABS^ESC wheel speed sensor (FL^FR^RL^RR)

Receiver unit uses this signal for calculation of vehicle movement distance.

Requested resolution of this signal is 0.5 pulses and refer to below (wheel sensor ";
BA_ "UserSigValidity" SG_ 3221225472 WHL_PlsRRVal 3;
BA_ "RoutingFactor" SG_ 3221225472 WHL_PlsRRVal 5;
BA_ "Version" SG_ 3221225472 WHL_PlsRRVal "17.12.00";
BA_ "Description" SG_ 3221225472 WHL_DirFLVal "This signal is used to check the moving direction of WHL_PUL_FL signal.";
BA_ "UserSigValidity" SG_ 3221225472 WHL_DirFLVal 3;
BA_ "RoutingFactor" SG_ 3221225472 WHL_DirFLVal 5;
BA_ "Version" SG_ 3221225472 WHL_DirFLVal "17.12.00";
BA_ "Description" SG_ 3221225472 WHL_DirFRVal "This signal is used to check the moving direction of WHL_PUL_FR signal.";
BA_ "UserSigValidity" SG_ 3221225472 WHL_DirFRVal 3;
BA_ "RoutingFactor" SG_ 3221225472 WHL_DirFRVal 5;
BA_ "Version" SG_ 3221225472 WHL_DirFRVal "17.12.00";
BA_ "Description" SG_ 3221225472 WHL_DirRLVal "This signal is used to check the moving direction of WHL_PUL_RL signal.";
BA_ "UserSigValidity" SG_ 3221225472 WHL_DirRLVal 3;
BA_ "RoutingFactor" SG_ 3221225472 WHL_DirRLVal 5;
BA_ "Version" SG_ 3221225472 WHL_DirRLVal "17.12.00";
BA_ "Description" SG_ 3221225472 WHL_DirRRVal "This signal is used to check the moving direction of WHL_PUL_RR signal.";
BA_ "UserSigValidity" SG_ 3221225472 WHL_DirRRVal 3;
BA_ "RoutingFactor" SG_ 3221225472 WHL_DirRRVal 5;
BA_ "Version" SG_ 3221225472 WHL_DirRRVal "17.12.00";
BA_ "Description" SG_ 3221225472 ENG_TrgtIdleRpmVal "The stationary target speed depends principally of the engine coolant temperature.

There is a difference between the target speed for manual transmission MT and automatic transmission (AT) in ’neutral’ and AT in ’drive’. 

- Immediately after start ";
BA_ "UserSigValidity" SG_ 3221225472 ENG_TrgtIdleRpmVal 3;
BA_ "RoutingFactor" SG_ 3221225472 ENG_TrgtIdleRpmVal 5;
BA_ "Version" SG_ 3221225472 ENG_TrgtIdleRpmVal "17.12.00";
BA_ "Description" SG_ 3221225472 ENG_GearShftUpDis "This signal represents gear shift up display status. EMS transmits gear shift up status to the cluster.";
BA_ "UserSigValidity" SG_ 3221225472 ENG_GearShftUpDis 3;
BA_ "RoutingFactor" SG_ 3221225472 ENG_GearShftUpDis 5;
BA_ "Version" SG_ 3221225472 ENG_GearShftUpDis "17.12.00";
BA_ "Description" SG_ 3221225472 ENG_GearShftDnDis "This signal represents gear shift down display status. EMS transmits gear shift down status to the cluster.";
BA_ "UserSigValidity" SG_ 3221225472 ENG_GearShftDnDis 3;
BA_ "RoutingFactor" SG_ 3221225472 ENG_GearShftDnDis 5;
BA_ "Version" SG_ 3221225472 ENG_GearShftDnDis "17.12.00";
BA_ "Description" SG_ 3221225472 ENG_DsrGearPosDis "This signal represents desirable gear position of current driving condition.

EMS transmits desirable gear position to the cluster.";
BA_ "UserSigValidity" SG_ 3221225472 ENG_DsrGearPosDis 3;
BA_ "RoutingFactor" SG_ 3221225472 ENG_DsrGearPosDis 5;
BA_ "Version" SG_ 3221225472 ENG_DsrGearPosDis "17.12.00";
BA_ "Description" SG_ 3221225472 ENG_SldFuncSta "This signal indicates that if speed limiter function is active or not.

If the speed limiter function is activated then CF_Ems_SldAct = 1. Although “SLD Main” switch is on, if the Speed limiter function is deactivated then CF_Ems_SldAct should be set t";
BA_ "UserSigValidity" SG_ 3221225472 ENG_SldFuncSta 3;
BA_ "RoutingFactor" SG_ 3221225472 ENG_SldFuncSta 5;
BA_ "Version" SG_ 3221225472 ENG_SldFuncSta "17.12.00";
BA_ "Description" SG_ 3221225472 ENG_SldActnSta "This signal indicates that if positive action of a driver at speed limiter function is active or not. If the positive action is activated then CF_Ems_SldPosAct = 1, which let the current vehicle speed to exceed the limit speed set from a driver.

If kick";
BA_ "UserSigValidity" SG_ 3221225472 ENG_SldActnSta 3;
BA_ "RoutingFactor" SG_ 3221225472 ENG_SldActnSta 5;
BA_ "Version" SG_ 3221225472 ENG_SldActnSta "17.12.00";
BA_ "Description" SG_ 3221225472 ENG_FuelTnkPrsrSta "This signal indicates that if fuel tank is high Pressure or not.

If the fuel tank is in high pressure status then CF_Ems_HPresStat = ‘1’.

If the fuel tank isn’t in high pressure status then CF_Ems_HPresStat should be set to ‘0’.";
BA_ "UserSigValidity" SG_ 3221225472 ENG_FuelTnkPrsrSta 3;
BA_ "RoutingFactor" SG_ 3221225472 ENG_FuelTnkPrsrSta 5;
BA_ "Version" SG_ 3221225472 ENG_FuelTnkPrsrSta "17.12.00";
BA_ "Description" SG_ 3221225472 ENG_IsgBzrReq "This signal is for Economy Type ISG. This signal is reminding for preventing sudden starting immediately just after engine restarted or driver shift gear N to D range without braking to make auto starting.

 It transfer first 3 times why if valid one is ";
BA_ "UserSigValidity" SG_ 3221225472 ENG_IsgBzrReq 3;
BA_ "RoutingFactor" SG_ 3221225472 ENG_IsgBzrReq 5;
BA_ "Version" SG_ 3221225472 ENG_IsgBzrReq "17.12.00";
BA_ "Description" SG_ 3221225472 ENG_IsgFuelCnsmptDis "This signal is the fuel consumption during Idle stop for display to cluster. 

It transfer first 3 times during 0.001L why if valid one is missing, other valid signals are used for extra signals. So, cluster displays 0.001L at only one among three signal";
BA_ "UserSigValidity" SG_ 3221225472 ENG_IsgFuelCnsmptDis 3;
BA_ "RoutingFactor" SG_ 3221225472 ENG_IsgFuelCnsmptDis 5;
BA_ "Version" SG_ 3221225472 ENG_IsgFuelCnsmptDis "17.12.00";
BA_ "Description" SG_ 3221225472 ENG_FuelCapOpnSta "This signal indicates that if fuel cap is opened or not.

If the fuel cap is opened then CF_Ems_FCopen = 1.

If the fuel tank isn’t opened then CF_Ems_FCopen should be set to ‘0’.";
BA_ "UserSigValidity" SG_ 3221225472 ENG_FuelCapOpnSta 3;
BA_ "RoutingFactor" SG_ 3221225472 ENG_FuelCapOpnSta 5;
BA_ "Version" SG_ 3221225472 ENG_FuelCapOpnSta "17.12.00";
BA_ "Description" SG_ 3221225472 ENG_EcoDrvActvSta "This signal indicates if Active Eco Drive function is active or not.

If Active Eco Drive function is active, then CF_Ems_ActEcoAct =1.";
BA_ "UserSigValidity" SG_ 3221225472 ENG_EcoDrvActvSta 3;
BA_ "RoutingFactor" SG_ 3221225472 ENG_EcoDrvActvSta 5;
BA_ "Version" SG_ 3221225472 ENG_EcoDrvActvSta "17.12.00";
BA_ "Description" SG_ 3221225472 ENG_EngRunSta "This signal is indicating normal engine running status. When engine is normal engine running state out of start, the signal turns to 1, otherwise 0 including engine stop & starting phase(cranking).";
BA_ "UserSigValidity" SG_ 3221225472 ENG_EngRunSta 3;
BA_ "RoutingFactor" SG_ 3221225472 ENG_EngRunSta 5;
BA_ "Version" SG_ 3221225472 ENG_EngRunSta "17.12.00";
BA_ "Description" SG_ 3221225472 ENG_Isg2Sta "1. ISG Status CAN message is divided by CF_EMS_IsgStat and CF_EMS_IsgStat2 

2. CF_EMS_IsgStat and CF_EMS_IsgStat2 do not duplicate the output condition

(EX: If CF_EMS_IsgStat2 is 01h~03h, CF_EMS_IsgStat is 00h)";
BA_ "UserSigValidity" SG_ 3221225472 ENG_Isg2Sta 3;
BA_ "RoutingFactor" SG_ 3221225472 ENG_Isg2Sta 5;
BA_ "Version" SG_ 3221225472 ENG_Isg2Sta "17.12.00";
BA_ "Description" SG_ 3221225472 ENG_IgnOnSta "Status of ignition lock.";
BA_ "GenSigStartValue" SG_ 3221225472 ENG_IgnOnSta 1;
BA_ "UserSigValidity" SG_ 3221225472 ENG_IgnOnSta 3;
BA_ "RoutingFactor" SG_ 3221225472 ENG_IgnOnSta 5;
BA_ "Version" SG_ 3221225472 ENG_IgnOnSta "17.12.00";
BA_ "Description" SG_ 3221225472 ENG_Ack4TcsSta "Monitoring of TCS message; the EMS checks whether at least one new message has been transferred within 500 ms, and whether there is no plausibility error in conjunction with a torque intervention. If this case occurs, the bit is set; otherwise it is rese";
BA_ "UserSigValidity" SG_ 3221225472 ENG_Ack4TcsSta 3;
BA_ "RoutingFactor" SG_ 3221225472 ENG_Ack4TcsSta 5;
BA_ "Version" SG_ 3221225472 ENG_Ack4TcsSta "17.12.00";
BA_ "Description" SG_ 3221225472 ENG_FuelCutOffSta "If the PUC_STAT - bit = 1 then the engine is in fuel cut off state, i.e. e. no injection is applied.";
BA_ "UserSigValidity" SG_ 3221225472 ENG_FuelCutOffSta 3;
BA_ "RoutingFactor" SG_ 3221225472 ENG_FuelCutOffSta 5;
BA_ "Version" SG_ 3221225472 ENG_FuelCutOffSta "17.12.00";
BA_ "Description" SG_ 3221225472 ENG_CrctTqSta "The information TQ_COR_STAT informs the TCS or the TCU whether and to which extent injection and ignition interventions are admitted.



0x0:The desired intervention regarding ignition angle retardation and cylinder shut-off is executed. (Default value)/";
BA_ "UserSigValidity" SG_ 3221225472 ENG_CrctTqSta 3;
BA_ "RoutingFactor" SG_ 3221225472 ENG_CrctTqSta 5;
BA_ "Version" SG_ 3221225472 ENG_CrctTqSta "17.12.02";
BA_ "Description" SG_ 3221225472 ENG_AirCompRlySta "The signal RLY_AC identifies the activation of the air conditioner compressor relay.";
BA_ "UserSigValidity" SG_ 3221225472 ENG_AirCompRlySta 3;
BA_ "RoutingFactor" SG_ 3221225472 ENG_AirCompRlySta 5;
BA_ "Version" SG_ 3221225472 ENG_AirCompRlySta "17.12.00";
BA_ "Description" SG_ 3221225472 ENG_LnchCntrlSta "State of Launch Control";
BA_ "UserSigValidity" SG_ 3221225472 ENG_LnchCntrlSta 3;
BA_ "RoutingFactor" SG_ 3221225472 ENG_LnchCntrlSta 5;
BA_ "Version" SG_ 3221225472 ENG_LnchCntrlSta "17.11.00";
BA_ "Description" SG_ 3221225472 ENG_EngSpdVal "This signal is generated by crankshaft segment period measurement (in case of an six-cylinder engine, this corresponds to a crankshaft angle of 120°) and measured with a resolution of 4 us.

This signal is represented as a 16 bit value.



The signal is";
BA_ "UserSigValidity" SG_ 3221225472 ENG_EngSpdVal 3;
BA_ "RoutingFactor" SG_ 3221225472 ENG_EngSpdVal 5;
BA_ "Version" SG_ 3221225472 ENG_EngSpdVal "17.12.00";
BA_ "Description" SG_ 3221225472 ENG_FuelCnsmptVal "The EMS uses the signal 'FCO' (FUEL CONSUMPTION) to inform other ECUs about the current consumption.";
BA_ "UserSigValidity" SG_ 3221225472 ENG_FuelCnsmptVal 3;
BA_ "RoutingFactor" SG_ 3221225472 ENG_FuelCnsmptVal 5;
BA_ "Version" SG_ 3221225472 ENG_FuelCnsmptVal "17.12.00";
BA_ "Description" SG_ 3221225472 ENG_TrgtFuelPmpPrsrVal "This signal indicates the Target Pressure of Fuel Pump";
BA_ "UserSigValidity" SG_ 3221225472 ENG_TrgtFuelPmpPrsrVal 3;
BA_ "RoutingFactor" SG_ 3221225472 ENG_TrgtFuelPmpPrsrVal 5;
BA_ "Version" SG_ 3221225472 ENG_TrgtFuelPmpPrsrVal "17.12.00";
BA_ "Description" SG_ 3221225472 ENG_VehSpdHiVal "This signal provides the one wheel velocity with resolution of 1 km/h,

and have 9 bits lengh.

In case of failure of sheel speed sensor, the value 1FF is used as error identifier";
BA_ "UserSigValidity" SG_ 3221225472 ENG_VehSpdHiVal 3;
BA_ "RoutingFactor" SG_ 3221225472 ENG_VehSpdHiVal 5;
BA_ "Version" SG_ 3221225472 ENG_VehSpdHiVal "18.01.01";
BA_ "Description" SG_ 3221225472 ENG_VehSpdLimVal "The vehicle speed which is measured by the EMS has to be sent to CLUSTER. This value is used for limiting speed of EMS. 

EMS limite vehicle speed as this value.";
BA_ "UserSigValidity" SG_ 3221225472 ENG_VehSpdLimVal 3;
BA_ "RoutingFactor" SG_ 3221225472 ENG_VehSpdLimVal 5;
BA_ "Version" SG_ 3221225472 ENG_VehSpdLimVal "18.01.01";
BA_ "Description" SG_ 3221225472 HUD_Crc1Val "The CRC checking process calculates the CRC over the entire data block, including the CRC result.

- CRC Polynomial (0x1021) , Initial Value : 0xFFFF, XOR value : 0x0000

- The mathematical expression to 16 bit CRC polynomial is given here. G(x) = x16 + ";
BA_ "GenSigStartValue" SG_ 3221225472 HUD_Crc1Val 65535;
BA_ "UserSigValidity" SG_ 3221225472 HUD_Crc1Val 3;
BA_ "GenSigTimeoutTime" SG_ 3221225472 HUD_Crc1Val 1500;
BA_ "RoutingFactor" SG_ 3221225472 HUD_Crc1Val 2;
BA_ "Version" SG_ 3221225472 HUD_Crc1Val "17.11.00";
BA_ "Description" SG_ 3221225472 HUD_AlvCnt1Val "For the first transmission request for a data element the counter shall be initialized with 0 and shall be incremented by 1

for every subsequent send request. When the counter reaches the maximum value(0xFF), then it shall restart with ? for the next se";
BA_ "UserSigValidity" SG_ 3221225472 HUD_AlvCnt1Val 3;
BA_ "GenSigTimeoutTime" SG_ 3221225472 HUD_AlvCnt1Val 1500;
BA_ "RoutingFactor" SG_ 3221225472 HUD_AlvCnt1Val 2;
BA_ "Version" SG_ 3221225472 HUD_AlvCnt1Val "17.11.00";
BA_ "Description" SG_ 3221225472 HUD_HghtSta "This signal indicates that the HUD Height Status.";
BA_ "GenSigStartValue" SG_ 3221225472 HUD_HghtSta 9;
BA_ "UserSigValidity" SG_ 3221225472 HUD_HghtSta 3;
BA_ "GenSigTimeoutTime" SG_ 3221225472 HUD_HghtSta 1500;
BA_ "RoutingFactor" SG_ 3221225472 HUD_HghtSta 2;
BA_ "Version" SG_ 3221225472 HUD_HghtSta "17.11.00";
BA_ "Description" SG_ 3221225472 HUD_PbackSta "Status signal for HUD interoperation with IMS

(The number of memory is expanded.)";
BA_ "UserSigValidity" SG_ 3221225472 HUD_PbackSta 3;
BA_ "GenSigTimeoutTime" SG_ 3221225472 HUD_PbackSta 1500;
BA_ "RoutingFactor" SG_ 3221225472 HUD_PbackSta 2;
BA_ "Version" SG_ 3221225472 HUD_PbackSta "17.11.00";
BA_ "Description" SG_ 3221225472 HUD_BrgtnsSta "This signal indicates that the Hud Brightness Status.";
BA_ "GenSigStartValue" SG_ 3221225472 HUD_BrgtnsSta 14;
BA_ "UserSigValidity" SG_ 3221225472 HUD_BrgtnsSta 3;
BA_ "GenSigTimeoutTime" SG_ 3221225472 HUD_BrgtnsSta 1500;
BA_ "RoutingFactor" SG_ 3221225472 HUD_BrgtnsSta 2;
BA_ "Version" SG_ 3221225472 HUD_BrgtnsSta "17.11.00";
BA_ "Description" SG_ 3221225472 HUD_Type "the type of head up display (ex : combiner type, windshield type)";
BA_ "UserSigValidity" SG_ 3221225472 HUD_Type 3;
BA_ "GenSigTimeoutTime" SG_ 3221225472 HUD_Type 1500;
BA_ "RoutingFactor" SG_ 3221225472 HUD_Type 2;
BA_ "Version" SG_ 3221225472 HUD_Type "18.03.01";
BA_ "Description" SG_ 3221225472 HUD_RotatSta "The status signal of HUD rotation";
BA_ "UserSigValidity" SG_ 3221225472 HUD_RotatSta 3;
BA_ "GenSigTimeoutTime" SG_ 3221225472 HUD_RotatSta 1500;
BA_ "RoutingFactor" SG_ 3221225472 HUD_RotatSta 2;
BA_ "Version" SG_ 3221225472 HUD_RotatSta "17.11.00";
BA_ "Description" SG_ 3221225472 HUD_setSW "the status of head up display on/off";
BA_ "UserSigValidity" SG_ 3221225472 HUD_setSW 3;
BA_ "GenSigTimeoutTime" SG_ 3221225472 HUD_setSW 1500;
BA_ "RoutingFactor" SG_ 3221225472 HUD_setSW 2;
BA_ "Version" SG_ 3221225472 HUD_setSW "18.03.01";
BA_ "Description" SG_ 3221225472 HUD_ContentsTBTStatus "this signal shows the display contents setting status of TBT on HUD";
BA_ "UserSigValidity" SG_ 3221225472 HUD_ContentsTBTStatus 3;
BA_ "GenSigTimeoutTime" SG_ 3221225472 HUD_ContentsTBTStatus 1500;
BA_ "RoutingFactor" SG_ 3221225472 HUD_ContentsTBTStatus 2;
BA_ "Version" SG_ 3221225472 HUD_ContentsTBTStatus "18.03.01";
BA_ "Description" SG_ 3221225472 HUD_ContentsDISStatus "this signal shows the display contents status of DIS on HUD";
BA_ "UserSigValidity" SG_ 3221225472 HUD_ContentsDISStatus 3;
BA_ "GenSigTimeoutTime" SG_ 3221225472 HUD_ContentsDISStatus 1500;
BA_ "RoutingFactor" SG_ 3221225472 HUD_ContentsDISStatus 2;
BA_ "Version" SG_ 3221225472 HUD_ContentsDISStatus "18.03.01";
BA_ "Description" SG_ 3221225472 HUD_ContentsSCCStatus "this signal shows the display contents status of SCC on HUD";
BA_ "UserSigValidity" SG_ 3221225472 HUD_ContentsSCCStatus 3;
BA_ "GenSigTimeoutTime" SG_ 3221225472 HUD_ContentsSCCStatus 1500;
BA_ "RoutingFactor" SG_ 3221225472 HUD_ContentsSCCStatus 2;
BA_ "Version" SG_ 3221225472 HUD_ContentsSCCStatus "18.03.01";
BA_ "Description" SG_ 3221225472 HUD_ContentsLKA_LDWStatus "this signal shows the display contents status of LKA/LDW on HUD";
BA_ "UserSigValidity" SG_ 3221225472 HUD_ContentsLKA_LDWStatus 3;
BA_ "GenSigTimeoutTime" SG_ 3221225472 HUD_ContentsLKA_LDWStatus 1500;
BA_ "RoutingFactor" SG_ 3221225472 HUD_ContentsLKA_LDWStatus 2;
BA_ "Version" SG_ 3221225472 HUD_ContentsLKA_LDWStatus "18.03.01";
BA_ "Description" SG_ 3221225472 HUD_ContentsBCWStatus "this signal shows the display contents status of BCW on HUD";
BA_ "UserSigValidity" SG_ 3221225472 HUD_ContentsBCWStatus 3;
BA_ "GenSigTimeoutTime" SG_ 3221225472 HUD_ContentsBCWStatus 1500;
BA_ "RoutingFactor" SG_ 3221225472 HUD_ContentsBCWStatus 2;
BA_ "Version" SG_ 3221225472 HUD_ContentsBCWStatus "18.03.01";
BA_ "Description" SG_ 3221225472 HUD_ContentsAVStatus "this signal shows the display contents status of AV on HUD";
BA_ "UserSigValidity" SG_ 3221225472 HUD_ContentsAVStatus 3;
BA_ "GenSigTimeoutTime" SG_ 3221225472 HUD_ContentsAVStatus 1500;
BA_ "RoutingFactor" SG_ 3221225472 HUD_ContentsAVStatus 2;
BA_ "Version" SG_ 3221225472 HUD_ContentsAVStatus "18.03.01";
BA_ "Description" SG_ 3221225472 HUD_FontColorStatus "this signal shows the font color status of HUD";
BA_ "UserSigValidity" SG_ 3221225472 HUD_FontColorStatus 3;
BA_ "GenSigTimeoutTime" SG_ 3221225472 HUD_FontColorStatus 1500;
BA_ "RoutingFactor" SG_ 3221225472 HUD_FontColorStatus 2;
BA_ "Version" SG_ 3221225472 HUD_FontColorStatus "18.03.01";
BA_ "Description" SG_ 3221225472 HUD_FontSizeStatus "this signal the font size status of HUD";
BA_ "UserSigValidity" SG_ 3221225472 HUD_FontSizeStatus 3;
BA_ "GenSigTimeoutTime" SG_ 3221225472 HUD_FontSizeStatus 1500;
BA_ "RoutingFactor" SG_ 3221225472 HUD_FontSizeStatus 2;
BA_ "Version" SG_ 3221225472 HUD_FontSizeStatus "18.03.01";
BA_ "Description" SG_ 3221225472 EMS_Crc1Val "The CRC checking process calculates the CRC over the entire data block, including the CRC result.

- CRC Polynomial (0x1021) , Initial Value : 0xFFFF, XOR value : 0x0000

- The mathematical expression to 16 bit CRC polynomial is given here. G(x) = x16 + ";
BA_ "GenSigStartValue" SG_ 3221225472 EMS_Crc1Val 65535;
BA_ "UserSigValidity" SG_ 3221225472 EMS_Crc1Val 3;
BA_ "RoutingFactor" SG_ 3221225472 EMS_Crc1Val 5;
BA_ "Version" SG_ 3221225472 EMS_Crc1Val "17.11.00";
BA_ "Description" SG_ 3221225472 EMS_AlvCnt1Val "For the first transmission request for a data element the counter shall be initialized with 0 and shall be incremented by 1

for every subsequent send request. When the counter reaches the maximum value(0xFF), then it shall restart with ? for the next se";
BA_ "UserSigValidity" SG_ 3221225472 EMS_AlvCnt1Val 3;
BA_ "RoutingFactor" SG_ 3221225472 EMS_AlvCnt1Val 5;
BA_ "Version" SG_ 3221225472 EMS_AlvCnt1Val "17.12.03";
BA_ "Description" SG_ 3221225472 ENG_CrctEngTqVal "This signal comprises the actual indicated engine torque (determined by calculation within the engine management system) (lambda control, knock control, catalyst overheating prevention function, temperature influences, TCS, TCU torque intervention etc. b";
BA_ "UserSigValidity" SG_ 3221225472 ENG_CrctEngTqVal 3;
BA_ "RoutingFactor" SG_ 3221225472 ENG_CrctEngTqVal 5;
BA_ "Version" SG_ 3221225472 ENG_CrctEngTqVal "18.01.03";
BA_ "Description" SG_ 3221225472 ENG_StndTqRatioVal "This factor is calculated inside the ECU to express the long-term changes of the engine torque capabilities due to special operating conditions. It takes into consideration mainly the ambient pressure, the ambient air temperature, and the fuel quality. I";
BA_ "GenSigStartValue" SG_ 3221225472 ENG_StndTqRatioVal 127;
BA_ "UserSigValidity" SG_ 3221225472 ENG_StndTqRatioVal 3;
BA_ "RoutingFactor" SG_ 3221225472 ENG_StndTqRatioVal 5;
BA_ "Version" SG_ 3221225472 ENG_StndTqRatioVal "17.12.00";
BA_ "Description" SG_ 3221225472 ENG_FrctTqVal "This signal identifies the current engine friction loss torque. It is stored as a function of 'EngClntTempVal' and 'EngSpdVal' (FrctTqVal = f(EngClntTempVal, EngSpdVal)) in terms of an index table.

The index table is corrected depending on the current l";
BA_ "UserSigValidity" SG_ 3221225472 ENG_FrctTqVal 3;
BA_ "RoutingFactor" SG_ 3221225472 ENG_FrctTqVal 5;
BA_ "Version" SG_ 3221225472 ENG_FrctTqVal "18.01.01";
BA_ "Description" SG_ 3221225472 ENG_IndTqVal "1) In cars equipped with gasoline engines with ETC system, the signal TQI is determined on the driver’s demand including cruise control and other functions and corresponds to the theoretical

engine torque. The signal comprises influences, such as the a";
BA_ "UserSigValidity" SG_ 3221225472 ENG_IndTqVal 3;
BA_ "RoutingFactor" SG_ 3221225472 ENG_IndTqVal 5;
BA_ "Version" SG_ 3221225472 ENG_IndTqVal "18.01.01";
BA_ "Description" SG_ 3221225472 ENG_IndTqBVal "TQI_B = f (actual torque + with the influence of TCS/ESC [without the influence of TCU interventions])

In cars equipped with gasoline engines with ETC system, the signal TQI is determined on actual torque.

The signal comprises influences, such as the a";
BA_ "UserSigValidity" SG_ 3221225472 ENG_IndTqBVal 3;
BA_ "RoutingFactor" SG_ 3221225472 ENG_IndTqBVal 5;
BA_ "Version" SG_ 3221225472 ENG_IndTqBVal "18.01.01";
BA_ "Description" SG_ 3221225472 ENG_EngSpdErrSta "This signal identifies an error on searching for a long tooth or on engine speed sensing.

Note : in some cases a limp-home function can be activated in the ECU (the engine speed signal is then based on the camshaft signal), and the engine may run even i";
BA_ "UserSigValidity" SG_ 3221225472 ENG_EngSpdErrSta 3;
BA_ "RoutingFactor" SG_ 3221225472 ENG_EngSpdErrSta 5;
BA_ "Version" SG_ 3221225472 ENG_EngSpdErrSta "17.12.00";
BA_ "Description" SG_ 3221225472 ENG_MafErrSta "This signal indicates error on MAF signal";
BA_ "UserSigValidity" SG_ 3221225472 ENG_MafErrSta 3;
BA_ "RoutingFactor" SG_ 3221225472 ENG_MafErrSta 5;
BA_ "Version" SG_ 3221225472 ENG_MafErrSta "17.12.00";
BA_ "Description" SG_ 3221225472 ENG_EtcLmphModSta "When ETC Mal-function occurred, EMS requests Cluster to indicate limphome mode driving and inform driver to go to AS center as soon as possible.

- In case of ETC malfunction, EMS finishes ETC control so that a vehicle goes to limphome mode driving (Forc";
BA_ "UserSigValidity" SG_ 3221225472 ENG_EtcLmphModSta 3;
BA_ "RoutingFactor" SG_ 3221225472 ENG_EtcLmphModSta 5;
BA_ "Version" SG_ 3221225472 ENG_EtcLmphModSta "17.12.00";
BA_ "Description" SG_ 3221225472 ENG_MaxAirconTqVal "EMS defines the maximum allowed A/C compressor torque for drivability and engine safety.

This signal offered to A/C ECU unit only in case of the external variable A/C system installed vehicle.";
BA_ "UserSigValidity" SG_ 3221225472 ENG_MaxAirconTqVal 3;
BA_ "RoutingFactor" SG_ 3221225472 ENG_MaxAirconTqVal 5;
BA_ "Version" SG_ 3221225472 ENG_MaxAirconTqVal "17.12.00";
VAL_ 3221225472 BCM_RVMSw 0 "RVM SW Off" 1 "RVM SW On" 2 "Not Used" 3 "Error Indicator" ;
VAL_ 3221225472 BCM_GearPosPSta 0 "Off" 1 "P" 2 "Not Used" 3 "Error Indicator" ;
VAL_ 3221225472 BCM_SunRoofOpnSta 0 "Close" 1 "Open" 2 "Not Used" 3 "Error Indicator" ;
VAL_ 3221225472 IAU_PhoneBDAdrRcvSta 0 "not received" 1 "received" 2 "Reserved" 3 "Invalid" ;
VAL_ 3221225472 IAU_PhoneBDAdrVal 0 "None" ;
VAL_ 3221225472 ILCULH_LowBeamAct_Sta 0 "Off" 1 "On" 2 "Not Used" 3 "Error Indicator" ;
VAL_ 3221225472 ILCULH_LowBeamLED_Sta 0 "Normal" 1 "Fail" 2 "Not Used" 3 "Error Indicator" ;
VAL_ 3221225472 ILCULH_PstnAct_Sta 0 "Off" 1 "On" 2 "Not Used" 3 "Error Indicator" ;
VAL_ 3221225472 ILCULH_PstnLED_Sta 0 "Normal" 1 "Fail" 2 "Not Used" 3 "Error Indicator" ;
VAL_ 3221225472 ILCULH_HighBeamAct_Sta 0 "Off" 1 "On" 2 "Not Used" 3 "Error Indicator" ;
VAL_ 3221225472 ILCULH_HighBeamLED_Sta 0 "Normal" 1 "Fail" 2 "Not Used" 3 "Error Indicator" ;
VAL_ 3221225472 ILCULH_DRLAct_Sta 0 "Off" 1 "On" 2 "Not Used" 3 "Error Indicator" ;
VAL_ 3221225472 ILCULH_DRLLED_Sta 0 "Normal" 1 "Fail" 2 "Not Used" 3 "Error Indicator" ;
VAL_ 3221225472 ILCULH_FrontTurnAct_Sta 0 "Off" 1 "On" 2 "Not Used" 3 "Error Indicator" ;
VAL_ 3221225472 ILCULH_FrontTurnLED_Sta 0 "Normal" 1 "Fail" 2 "Not Used" 3 "Error Indicator" ;
VAL_ 3221225472 ILCULH_System_Sta 0 "Normal" 1 "Reserved" 2 "Not Calibrated" 3 "Error Indicator" ;
VAL_ 3221225472 ILCULH_IFSOpt_Sta 0 "None IFS Option(Default)" 1 "IFS System Enable" 2 "Not Used" 3 "Error Indicator" ;
VAL_ 3221225472 ILCULH_IFSLamp_Act 0 "IFS Indicator Lamp Off (Default)" 1 "IFS Indicator Lamp On" 2 "Not Used" 3 "Error Indicator" ;
VAL_ 3221225472 ILCULH_IFSSysState_Sta 0 "Default(Disable)" 1 "IFS Enable & High Beam Off" 2 "IFS Enable & High Beam On" 3 "System Fail" ;
VAL_ 3221225472 ILCULH_IFSWarning_Sta 0 "Warning Indicator Lamp Off (Default)" 1 "Warning Indicator Lamp Blinking" 2 "Warning Indicator Lamp On" 3 "Error Indicator" ;
VAL_ 3221225472 ILCURH_LowBeamAct_Sta 0 "Off" 1 "On" 2 "Not Used" 3 "Error Indicator" ;
VAL_ 3221225472 ILCURH_LowBeamLED_Sta 0 "Normal" 1 "Fail" 2 "Not Used" 3 "Error Indicator" ;
VAL_ 3221225472 ILCURH_PstnAct_Sta 0 "Off" 1 "On" 2 "Not Used" 3 "Error Indicator" ;
VAL_ 3221225472 ILCURH_PstnLED_Sta 0 "Normal" 1 "Fail" 2 "Not Used" 3 "Error Indicator" ;
VAL_ 3221225472 ILCURH_HighBeamAct_Sta 0 "Off" 1 "On" 2 "Not Used" 3 "Error Indicator" ;
VAL_ 3221225472 ILCURH_HighBeamLED_Sta 0 "Normal" 1 "Fail" 2 "Not Used" 3 "Error Indicator" ;
VAL_ 3221225472 ILCURH_DRLAct_Sta 0 "Off" 1 "On" 2 "Not Used" 3 "Error Indicator" ;
VAL_ 3221225472 ILCURH_DRLLED_Sta 0 "Normal" 1 "Fail" 2 "Not Used" 3 "Error Indicator" ;
VAL_ 3221225472 ILCURH_FrontTurnAct_Sta 0 "Off" 1 "On" 2 "Not Used" 3 "Error Indicator" ;
VAL_ 3221225472 ILCURH_FrontTurnLED_Sta 0 "Normal" 1 "Fail" 2 "Not Used" 3 "Error Indicator" ;
VAL_ 3221225472 ILCURH_System_Sta 0 "Normal" 1 "Reserved" 2 "Not Calibrated" 3 "Error Indicator" ;
VAL_ 3221225472 ILCURH_IFSOpt_Sta 0 "None IFS Option(Default)" 1 "IFS System Enable" 2 "Not Used" 3 "Error Indicator" ;
VAL_ 3221225472 ILCURH_IFSLamp_Act 0 "IFS Indicator Lamp Off (Default)" 1 "IFS Indicator Lamp On" 2 "Not Used" 3 "Error Indicator" ;
VAL_ 3221225472 ILCURH_IFSSysState_Sta 0 "Default(Disable)" 1 "IFS Enable & High Beam Off" 2 "IFS Enable & High Beam On" 3 "System Fail" ;
VAL_ 3221225472 ILCURH_IFSWarning_Sta 0 "Warning Indicator Lamp Off (Default)" 1 "Warning Indicator Lamp Blinking" 2 "Warning Indicator Lamp On" 3 "Error Indicator" ;
VAL_ 3221225472 DATC_TunnelFuncOff4AutoDfgReq 0 "Default" 1 "Tunnel Turn off" 2 "Not Used" 3 "Error Indicator" ;
VAL_ 3221225472 DATC_ArClnSysSta 0 "Air Cleaning System OFF" 1 "Air Cleaning System ON" 2 "Air Cleaning System Not Support" 3 "Error Indicator (Initial)" ;
VAL_ 3221225472 DATC_DrvrStHtrUSMSta 0 "NOT APPLY" 1 "OFF" 2 "ON" 3 "Error Indicator" ;
VAL_ 3221225472 Warn_StrtStpBtnWrngSta 0 "Off" 1 "On" 2 "Not Used" 3 "Error Indicator" ;
VAL_ 3221225472 Warn_DeActvWrngSta 0 "Off" 1 "On" 2 "Not Used" 3 "Error Indicator" ;
VAL_ 3221225472 Warn_ExtrnlBuzWrngSta 0 "Off" 1 "SMK Door Lock1" 2 "SMK Door Lock2" 3 "ID Out" 4 "Trunk Warning" 5 "SMK Key Reminder2" 6 "SMK Door Lock3" 7 "Default" 8 "Reserved" 9 "Reserved" 10 "Reserved" 11 "Reserved" 12 "Reserved" 13 "Reserved" 14 "Not Used" 15 "Error Indicator" ;
VAL_ 3221225472 Warn_DisWrngSta 0 "Off" 1 "Shift_P_Warning" 2 "Key_Bat_Discharge_Warning" 3 "Not_Unlocked_Warning" 4 "AC_Plug_Connected_Warning" 5 "Escl_Ecu_Fail_Warning" 6 "Engine_Start_Operation_IND" 7 "Auth_Fail_Warning" 8 "Key_Removal_IND" 9 "SMK_Lamp_Warning" 10 "SSB_Warning" 11 "Auth_Fail_Warning2" 12 "Vehicle_Not_P_Warning" 13 "Stop Lamp Fuse Fail Warning" 14 "Not P_N Warning" 15 "Reserved" 16 "Reserved" 17 "Reserved" 18 "Reserved" 19 "Reserved" 20 "Reserved" 21 "Reserved" 22 "Reserved" 23 "Reserved" 24 "Reserved" 25 "Reserved" 26 "Reserved" 27 "Reserved" 28 "Reserved0x1D:Reserved" 30 "Not Used" 31 "Error Indicator" ;
VAL_ 3221225472 Warn_GearPosPWrngReq 0 "Warning Off" 1 "Warning On" 2 "Not Used" 3 "Error Indicator" ;
VAL_ 3221225472 Warn_IdOutWrngSta 0 "Off" 1 "On" 2 "Not Used" 3 "Error Indicator" ;
VAL_ 3221225472 Warn_KeyBattLoWrngSta 0 "Off" 1 "On" 2 "Not Used" 3 "Error Indicator" ;
VAL_ 3221225472 Warn_KeyOutLmpOnReq 0 "Off" 1 "On" 2 "Not Used" 3 "Error Indicator" ;
VAL_ 3221225472 Warn_NotGearPosPWrngSta 0 "Off" 1 "On" 2 "Not Used" 3 "Error Indicator" ;
VAL_ 3221225472 Warn_EsclFlWrngSta 0 "Off" 1 "On" 2 "Not Used" 3 "Error Indicator" ;
VAL_ 3221225472 Warn_EsclNotLkWrngSta 0 "Off" 1 "On" 2 "Not Used" 3 "Error Indicator" ;
VAL_ 3221225472 Warn_EsclNotUnLkWrngSta 0 "Off" 1 "On" 2 "Not Used" 3 "Error Indicator" ;
VAL_ 3221225472 Warn_ImmoLmpOnReq 0 "Off" 1 "On" 2 "Not Used" 3 "Error Indicator" ;
VAL_ 3221225472 RL_SHVU_SeatOptSta 0 "Init" 1 "Heater only 2step" 2 "Heater only 3step" 3 "Vent only 2step" 4 "Vent only 3step" 5 "Heater and Vent 2step" 6 "Heater and Vent 3step" 7 "Invalid" ;
VAL_ 3221225472 RL_SHVU_SeatHtOperSta 0 "Init" 1 "Unused" 2 "Heater & Vent OFF" 3 "Vent Low" 4 "Vent Mid" 5 "Vent High" 6 "Heater Low" 7 "Heater Mid" 8 "Heater High" 9 "Unused" 10 "Unused" 11 "Unused" 12 "Unused" 13 "Unused" 14 "Unused" 15 "Invalid" ;
VAL_ 3221225472 RL_CURTAIN_POSITION 0 "Bottom" 1 "Middle" 2 "Top" 3 "Unknown(Curtain not Initialized)" ;
VAL_ 3221225472 RR_CURTAIN_POSITION 0 "Bottom" 1 "Middle" 2 "Top" 3 "Unknown(Curtain not Initialized)" ;
VAL_ 3221225472 DLBCU_ActiveDis 0 "Default" 1 "Off" 2 "Mode1" 3 "Mode2" 4 "Mode3" 5 "Mode4" 6 "Reserved" 7 "Invalid" ;
VAL_ 3221225472 DLBCU_DrvModUSMSta 0 "Default" 1 "Off" 2 "On" 3 "Invalid" ;
VAL_ 3221225472 DLBCU_ActiveStrSta 0 "Default" 1 "Normal" 2 "Intensity" 3 "Invalid" ;
VAL_ 3221225472 DLBCU_ActiveTimeSta 0 "Default" 1 "10min" 2 "15min" 3 "20min" 4 "Reserved" 5 "Reserved" 6 "Reserved" 7 "Invalid" ;
VAL_ 3221225472 DLBCU_CushSoftSta 0 "Default" 1 "Soft" 2 "Mid" 3 "Hard" 4 "Reserved" 5 "Reserved" 6 "Reserved" 7 "Invalid" ;
VAL_ 3221225472 USM_EscrtHdLmpSta 0 "Default Value" 1 "Escort Off" 2 "Escort On" 3 "Invalid" 4 "Reserved" 5 "Reseved" 6 "Not Used" 7 "Error Indicator" ;
VAL_ 3221225472 USM_WlcmMirLtSystTitleOpt 0 "Default Value" 1 "Welcome Mirror Light" 2 "Welcome Mirror" 3 "Welcome Light" 4 "Reserved" 5 "Reseved" 6 "Not Used" 7 "Error Indicator" ;
VAL_ 3221225472 USM_UnlockWlcmSta 0 "Default Value" 1 "Off" 2 "On" 3 "Invalid" 4 "Reserved" 5 "Reseved" 6 "Not Used" 7 "Error Indicator" ;
VAL_ 3221225472 USM_SmrtWlcmSta 0 "Default Value" 1 "Off" 2 "On" 3 "Invalid" 4 "Reserved" 5 "Reseved" 6 "Not Used" 7 "Error Indicator" ;
VAL_ 3221225472 USM_RrWiperByGearPosRSta 0 "Default" 1 "Rear Wiper(reverse) Off" 2 "Rear Wiper(reverse) On" 3 "Invalid" 4 "Reserved" 5 "Reseved" 6 "Not Used" 7 "Error Indicator" ;
VAL_ 3221225472 USM_RrStRmndSta 0 "Default" 1 "Off(Disable)" 2 "On(Enable)" 3 "Invalid" 4 "Reserved" 5 "Reseved" 6 "Not Used" 7 "Error Indicator" ;
VAL_ 3221225472 USM_TunlModAutoWdwSta 0 "Default Value" 1 "Off" 2 "On" 3 "Invalid" 4 "Reserved" 5 "Reseved" 6 "Not Used" 7 "Error Indicator" ;
VAL_ 3221225472 SMK_AsstTgglBtnSta 0 "Off" 1 "On" 2 "Not Used" 3 "Error Indicator" ;
VAL_ 3221225472 SMK_DrvTglBtnSta 0 "Off" 1 "On" 2 "Not Used" 3 "Error Indicator" ;
VAL_ 3221225472 SMK_TgglBtnStuckSta 0 "Normal" 1 "Toggle Stuck" 2 "Not Used" 3 "Error Indicator" ;
VAL_ 3221225472 SMK_BrkSwSta 0 "Off" 1 "On" 2 "Not Used" 3 "Error Indicator" ;
VAL_ 3221225472 SMK_GearPosPSwSta 0 "Off" 1 "On" 2 "Not Used" 3 "Error Indicator" ;
VAL_ 3221225472 IAU_DigitalKeyOpt 0 "not applied (time out)" 1 "applied" 2 "reserved" 3 "Invalid" ;
VAL_ 3221225472 IAU_NFCDeviceDetectionSta 0 "Off" 1 "NFC Device Not Detected" 2 "NFC Device Detected" 3 "Reserved" 4 "Reserved" 5 "Reserved" 6 "Reserved" 7 "Invaild" ;
VAL_ 3221225472 IAU_PhoneAuthSta 0 "None" 1 "Auth Pending" 2 "Auth End" 3 "Auth Error" 4 "Reserved" 5 "Reserved" 6 "Reserved" 7 "Invalid" ;
VAL_ 3221225472 IAU_ProfileIDParingRVal 0 "Default" 1 "Disable" 2 "Enable" 3 "Invalid" ;
VAL_ 3221225472 IAU_ProfileIDRVal 0 "Default" 1 "Guest" 2 "Profile1" 3 "Profile2" 4 "Reserved" 5 "Reserved" 6 "Reserved" 7 "Reserved" 8 "Reserved" 9 "Reserved" 10 "Reserved" 11 "Reserved" 12 "Reserved" 13 "Reserved" 14 "Reserved" 15 "Invalid" ;
VAL_ 3221225472 IAU_DigitalKeyProcessingSta 0 "None" 1 "DeviceOnWPC" 2 "DeviceRegistering" 3 "PhoneRegistered" 4 "All Phone Key Deleted" 5 "NFCCard1Registered" 6 "NFCCard2Registered" 7 "NFCCard1Deleted" 8 "NFCCard2Deleted" 9 "Reserved" 10 "Reserved" 11 "Reserved" 12 "Reserved" 13 "Reserved" 14 "Reserved" 15 "Invalid" ;
VAL_ 3221225472 IAU_DigitalKeyExit 0 "Normal" 1 "Engine Not Running" 2 "Shift Lever Not P or Speed over 3km" 3 "Fob Not Detected" 4 "Canceled By User" 5 "Device not Available" 6 "ProcessFail" 7 "Card1 not Available" 8 "Card2 not Available" 9 "Exit by AVN" 10 "Reserved" 11 "Reserved" 12 "Reserved" 13 "Reserved" 14 "Reserved" 15 "Invalid" ;
VAL_ 3221225472 IAU_DigitalKeyEnblRVal 0 "Default" 1 "Disable" 2 "Enable" 3 "Invalid" ;
VAL_ 3221225472 IAU_OwnerPhnRegRVal 0 "Default" 1 "Disable" 2 "Enable" 3 "Invalid" ;
VAL_ 3221225472 IAU_NFCCard1RegRVal 0 "Default" 1 "Disable" 2 "Enable" 3 "Invalid" ;
VAL_ 3221225472 IAU_NFCCard2RegRVal 0 "Default" 1 "Disable" 2 "Enable" 3 "Invalid" ;
VAL_ 3221225472 IAU_RdyToSendAuthDataSta 0 "None" 1 "Ready to Send data" 2 "Not Used" 3 "Error Indicator" ;
VAL_ 3221225472 IAU_OptTyp 0 "None" 1 "NFC Option" 2 "FP Option" 3 "BLE Option" 4 "Reserved" 5 "Reserved" 6 "Reserved" 7 "Invalid" ;
VAL_ 3221225472 CF_AVN_PhoneParingNValueSet 0 "Default" 1 "Disable" 2 "Enable" 3 "Invalid" ;
VAL_ 3221225472 CF_AVN_ProfileIDNValueSet 0 "Default" 1 "Guest" 2 "Profile1" 3 "Profile2" 4 "Reserved" 5 "Reserved" 6 "Reserved" 7 "Reserved" 8 "Reserved" 9 "Reserved" 10 "Reserved" 11 "Reserved" 12 "Reserved" 13 "Reserved" 14 "Reserved" 15 "Invalid" ;
VAL_ 3221225472 NFC_Support_check_request 0 "Default" 1 "Request" 2 "Reserved" 3 "Invalid" ;
VAL_ 3221225472 CF_AVN_DigitKeyEnableNValueSet 0 "Default" 1 "Disable" 2 "Enable" 3 "Invalid" ;
VAL_ 3221225472 CF_AVN_OwnerPhoneNValueSet 0 "Default" 1 "Deleted" 2 "Registered" 3 "Invalid" ;
VAL_ 3221225472 CF_AVN_NFCCard1NValueSet 0 "Default" 1 "Disable" 2 "Enable" 3 "Invalid" ;
VAL_ 3221225472 CF_AVN_NFCCard2NValueSet 0 "Default" 1 "Disable" 2 "Enable" 3 "Invalid" ;
VAL_ 3221225472 CF_AVN_IMSProfileNValueSet 0 "Default" 1 "Disable" 2 "Enable for IMS1" 3 "Enable for IMS2" 4 "Reserved" 5 "Reserved" 6 "Reserved" 7 "Invalid" ;
VAL_ 3221225472 CF_AVN_DigitalKeyMenuExit 0 "Default" 1 "Cancel" 2 "OK" 3 "Invalid" ;
VAL_ 3221225472 BAlarm_AutoLockrReq 0 "Off" 1 "Lock" 2 "Not Used" 3 "Error Indicator" ;
VAL_ 3221225472 C_RH_Unfolding_SW 0 "Default" 1 "OFF" 2 "ON" 3 "Invalid" ;
VAL_ 3221225472 C_RH_Folding_SW 0 "Default" 1 "OFF" 2 "ON" 3 "Invalid" ;
VAL_ 3221225472 C_LH_Unfolding_SW 0 "Default" 1 "OFF" 2 "ON" 3 "Invalid" ;
VAL_ 3221225472 C_LH_Folding_SW 0 "Default" 1 "OFF" 2 "ON" 3 "Invalid" ;
VAL_ 3221225472 DrvIMS_MemoryP1Req 0 "None" 1 "P1" 2 "Not Used" 3 "Error Indicator" ;
VAL_ 3221225472 DrvIMS_MemoryP2Req 0 "None" 1 "P2" 2 "Not Used" 3 "Error Indicator" ;
VAL_ 3221225472 DrvIMS_MemorySetEnaSta 0 "Disable" 1 "Enable" 2 "Not Used" 3 "Error Indicator" ;
VAL_ 3221225472 DrvIMS_PlyBckP1Req 0 "None" 1 "P1" 2 "Not Used" 3 "Error Indicator" ;
VAL_ 3221225472 DrvIMS_PlyBckP2Req 0 "None" 1 "P2" 2 "Not Used" 3 "Error Indicator" ;
VAL_ 3221225472 DrvIMS_PlyBckStpReq 0 "Off" 1 "Stop" 2 "Not Used" 3 "Error Indicator" ;
VAL_ 3221225472 SmrtIMS_PlyBckReq 0 "None" 1 "1~0x97E:Smart IMS DB Number(1~2430)" 2430 "1~0x97E:Smart IMS DB Number(1~2430)" 4095 "Invalid" ;
VAL_ 3221225472 SmrtIMS_ImgDBVal 0 "none" 1 "Smart IMS Image DB 1~30" 2 "Smart IMS Image DB 1~30" 3 "Smart IMS Image DB 1~30" 4 "Smart IMS Image DB 1~30" 5 "Smart IMS Image DB 1~30" 6 "Smart IMS Image DB 1~30" 7 "Smart IMS Image DB 1~30" 8 "Smart IMS Image DB 1~30" 9 "Smart IMS Image DB 1~30" 10 "Smart IMS Image DB 1~30" 11 "Smart IMS Image DB 1~30" 12 "Smart IMS Image DB 1~30" 13 "Smart IMS Image DB 1~30" 14 "Smart IMS Image DB 1~30" 15 "Smart IMS Image DB 1~30" 16 "Smart IMS Image DB 1~30" 17 "Smart IMS Image DB 1~30" 18 "Smart IMS Image DB 1~30" 19 "Smart IMS Image DB 1~30" 20 "Smart IMS Image DB 1~30" 21 "Smart IMS Image DB 1~30" 22 "Smart IMS Image DB 1~30" 23 "Smart IMS Image DB 1~30" 24 "Smart IMS Image DB 1~30" 25 "Smart IMS Image DB 1~30" 26 "Smart IMS Image DB 1~30" 27 "Smart IMS Image DB 1~30" 28 "Smart IMS Image DB 1~30" 29 "Smart IMS Image DB 1~30" 30 "Smart IMS Image DB 1~30" 31 "Invalid" ;
VAL_ 3221225472 SmrtIMS_PlyBckStpReq 0 "OFF" 1 "On" 2 "Not Used" 3 "Error Indicator" ;
VAL_ 3221225472 SmrtIMS_EnterSwSta 0 "off" 1 "on" 2 "reserved" 3 "invalid" ;
VAL_ 3221225472 DrvIMS_BzrReq 0 "Off" 1 "On" 2 "Not Used" 3 "Error Indicator" ;
VAL_ 3221225472 DrvIMS_NotPWrngDis 0 "Off" 1 "On" 2 "Not Used" 3 "Error Indicator" ;
VAL_ 3221225472 C_TeleCrankingCmdIBOX 0 "default (off)" 1 "Cranking" 2 "stop" 3 "Invalid" ;
VAL_ 3221225472 Audio_VolEncoderSta 0 "Reserved" 1 "01~0x7F:Clockwise(Up)" 127 "01~0x7F:Clockwise(Up)" 128 "80~0xFE:Counterclockwise (Down)" 254 "80~0xFE:Counterclockwise (Down)" 255 "Invalid" ;
VAL_ 3221225472 Cluster_ScrlEncoderSta 0 "Reserved" 1 "01~0x7F:Clockwise(Up)" 127 "01~0x7F:Clockwise(Up)" 128 "80~0xFE:Counterclockwise (Down)" 254 "80~0xFE:Counterclockwise (Down)" 255 "Invalid" ;
VAL_ 3221225472 IFSref_VehRtAngl2Val 0 "0x000~0x191:-20.0~+20.0" 401 "0x000~0x191:-20.0~+20.0" 402 "192~0x1FD:Not used" 509 "192~0x1FD:Not used" 510 "Default" 511 "Error indicator" ;
VAL_ 3221225472 IFSref_VehLftAngl3Val 0 "0x000~0x191:-20.0~+20.0" 401 "0x000~0x191:-20.0~+20.0" 402 "192~0x1FD:Not used" 509 "192~0x1FD:Not used" 510 "Default" 511 "Error indicator" ;
VAL_ 3221225472 IFSref_VehRtAngl3Val 0 "0x000~0x191:-20.0~+20.0" 401 "0x000~0x191:-20.0~+20.0" 402 "192~0x1FD:Not used" 509 "192~0x1FD:Not used" 510 "Default" 511 "Error indicator" ;
VAL_ 3221225472 IFSref_VehLftAngl4Val 0 "0x000~0x191:-20.0~+20.0" 401 "0x000~0x191:-20.0~+20.0" 402 "192~0x1FD:Not used" 509 "192~0x1FD:Not used" 510 "Default" 511 "Error indicator" ;
VAL_ 3221225472 IFSref_VehRtAngl4Val 0 "0x000~0x191:-20.0~+20.0" 401 "0x000~0x191:-20.0~+20.0" 402 "192~0x1FD:Not used" 509 "192~0x1FD:Not used" 510 "Default" 511 "Error indicator" ;
VAL_ 3221225472 IFSref_VehLftAngl5Val 0 "0x000~0x191:-20.0~+20.0" 401 "0x000~0x191:-20.0~+20.0" 402 "192~0x1FD:Not used" 509 "192~0x1FD:Not used" 510 "Default" 511 "Error indicator" ;
VAL_ 3221225472 IFSref_VehRtAngl5Val 0 "0x000~0x191:-20.0~+20.0" 401 "0x000~0x191:-20.0~+20.0" 402 "192~0x1FD:Not used" 509 "192~0x1FD:Not used" 510 "Default" 511 "Error indicator" ;
VAL_ 3221225472 DoorLock_CtrlDrLkSwSta 0 "Off" 1 "On" 2 "Not Used" 3 "Error Indicator" ;
VAL_ 3221225472 DoorLock_CtrlDrUnLkSwSta 0 "Off" 1 "On" 2 "Not Used" 3 "Error Indicator" ;
VAL_ 3221225472 IFSref_VehLftAngl6Val 0 "0x000~0x191:-20.0~+20.0" 401 "0x000~0x191:-20.0~+20.0" 402 "192~0x1FD:Not used" 509 "192~0x1FD:Not used" 510 "Default" 511 "Error indicator" ;
VAL_ 3221225472 IFSref_VehRtAngl6Val 0 "0x000~0x191:-20.0~+20.0" 401 "0x000~0x191:-20.0~+20.0" 402 "192~0x1FD:Not used" 509 "192~0x1FD:Not used" 510 "Default" 511 "Error indicator" ;
VAL_ 3221225472 IFSref_VehLftAngl7Val 0 "0x000~0x191:-20.0~+20.0" 401 "0x000~0x191:-20.0~+20.0" 402 "192~0x1FD:Not used" 509 "192~0x1FD:Not used" 510 "Default" 511 "Error indicator" ;
VAL_ 3221225472 IFSref_VehRtAngl7Val 0 "0x000~0x191:-20.0~+20.0" 401 "0x000~0x191:-20.0~+20.0" 402 "192~0x1FD:Not used" 509 "192~0x1FD:Not used" 510 "Default" 511 "Error indicator" ;
VAL_ 3221225472 IFSref_VehLftAngl8Val 0 "0x000~0x191:-20.0~+20.0" 401 "0x000~0x191:-20.0~+20.0" 402 "192~0x1FD:Not used" 509 "192~0x1FD:Not used" 510 "Default" 511 "Error indicator" ;
VAL_ 3221225472 IFSref_VehRtAngl8Val 0 "0x000~0x191:-20.0~+20.0" 401 "0x000~0x191:-20.0~+20.0" 402 "192~0x1FD:Not used" 509 "192~0x1FD:Not used" 510 "Default" 511 "Error indicator" ;
VAL_ 3221225472 IFSref_FR_CMR_Sta 0 "None Option (Default)" 1 "Normal" 2 "Not used" 3 "Error Indicator" ;
VAL_ 3221225472 IFSref_VehNumVal 0 "0~8" 1 "0~8" 2 "0~8" 3 "0~8" 4 "0~8" 5 "0~8" 6 "0~8" 7 "0~8" 8 "0~8" 9 "Over than 8 vehicles" 10 "Not used" 11 "Not used" 12 "Not used" 13 "Not used" 14 "Not used" 15 "Error indicator" ;
VAL_ 3221225472 IFSref_ILLAmbtSta 0 "Bright" 1 "Dark" 2 "Not used" 3 "Error indicator" ;
VAL_ 3221225472 IFSref_VehLftAngl1Val 0 "0x000~0x191:-20.0~+20.0" 401 "0x000~0x191:-20.0~+20.0" 402 "192~0x1FD:Not used" 509 "192~0x1FD:Not used" 510 "Default" 511 "Error indicator" ;
VAL_ 3221225472 IFSref_VehRtAngl1Val 0 "0x000~0x191:-20.0~+20.0" 401 "0x000~0x191:-20.0~+20.0" 402 "192~0x1FD:Not used" 509 "192~0x1FD:Not used" 510 "Default" 511 "Error indicator" ;
VAL_ 3221225472 IFSref_VehLftAngl2Val 0 "0x000~0x191:-20.0~+20.0" 401 "0x000~0x191:-20.0~+20.0" 402 "192~0x1FD:Not used" 509 "192~0x1FD:Not used" 510 "Default" 511 "Error indicator" ;
VAL_ 3221225472 Navi_TunnelDistance 0 "0x0~0x3FD:distance (m)" 1021 "0x0~0x3FD:distance (m)" 1022 "Out of range" 1023 "Invalid" ;
VAL_ 3221225472 Navi_TunnelRoadClass 0 "Unknown" 1 "Freeway" 2 "Arterial" 3 "County" 4 "Collector" 5 "Local" 6 "Etc" 7 "Invalid" ;
VAL_ 3221225472 Navi_TunnelExist 0 "None" 1 "Exist" 2 "Reserved" 3 "Invalid" ;
VAL_ 3221225472 Navi_ParkingLot 0 "Unknown" 1 "Parking Garage (폐쇄형 주차장)" 2 "Reserved" 3 "Invalid" ;
VAL_ 3221225472 HU_DistanceUnit 0 "Km" 1 "Mile" 2 "Reserved" 3 "Invalid" ;
VAL_ 3221225472 HU_AliveStatus 0 "Not Ready" 1 "On Mode" 2 "Head Unit Update Mode" 3 "Invalid" ;
VAL_ 3221225472 HU_MicActivity 0 "Deactivated" 1 "Activated" 2 "reserved" 3 "Invalid" ;
VAL_ 3221225472 AVN_RSPA_CancelInput 0 "Init" 1 "No Input" 2 "Cancel Input" 3 "Invalid" ;
VAL_ 3221225472 AVN_RSPA_ModeSetStat 0 "None" 1 "1st menu from the leftmost" 2 "2nd menu from the leftmost" 3 "3rd menu from the leftmost" 4 "4th menu from the leftmost" 5 "5th menu from the leftmost" 6 "6th menu from the leftmost" 7 "7th menu from the leftmost" 8 "8th menu from the leftmost" 9 "Reserved" 10 "Reserved" 11 "Reserved" 12 "Reserved" 13 "Reserved" 14 "Reserved" 15 "Invalid" ;
VAL_ 3221225472 HU_TempUnit 0 "Off" 1 "℃(Centigrade)" 2 "℉(Fahrenheit)" 3 "Invalid" ;
VAL_ 3221225472 AVN_RSPA_Disp_Rdy 0 "Impossible to display" 1 "Possible to display" 2 "Reserved" 3 "Invalid" ;
VAL_ 3221225472 HazardFromHUSVM 0 "inactive" 1 "active" 2 "reserved" 3 "invalid" ;
VAL_ 3221225472 OMUOSMirCtrl 0 "Off" 1 "Fold" 2 "Unfold" 3 "invalid" ;
VAL_ 3221225472 AVN_PDW_Input 0 "Init" 1 "No input" 2 "PDW softkey touch input" 3 "Invalid" ;
VAL_ 3221225472 AVN_RSPA_Input 0 "Init" 1 "No input" 2 "RSPA on request" 3 "Invalid" ;
VAL_ 3221225472 AVN_ParkingSW 0 "Released(off)" 1 "Pressed" 2 "Reserved" 3 "Reserved" 4 "Reserved" 5 "Reserved" 6 "Reserved" 7 "Invalid" ;
VAL_ 3221225472 DoorLock_PsvDrLkReq 0 "None" 1 "Lock" 2 "PassiveTrunkLock" 3 "Reserved" 4 "Reserved" 5 "Reseved" 6 "Not Used" 7 "Error Indicator" ;
VAL_ 3221225472 DoorLock_PsvDrUnLkReq 0 "None" 1 "UnLock" 2 "Unlock only DRV Door" 3 "PIC_Key_Reminder" 4 "Reserved" 5 "Reseved" 6 "Not Used" 7 "Error Indicator" ;
VAL_ 3221225472 DoorLock_DrvDrPsvAcsReq 0 "Off" 1 "On" 2 "Not Used" 3 "Error Indicator" ;
VAL_ 3221225472 DoorLock_AsstDrPsvAcsReq 0 "Off" 1 "On" 2 "Not Used" 3 "Error Indicator" ;
VAL_ 3221225472 DoorLock_TrnkTlgtPsvAcsReq 0 "Off" 1 "On" 2 "Not Used" 3 "Error Indicator" ;
VAL_ 3221225472 Auth_Req 0 "None" 1 "Auth Request" 2 "Reserved" 3 "Reserved" 4 "Reserved" 5 "Reserved" 6 "Reserved" 7 "Reserved" ;
VAL_ 3221225472 RSPA_CanTmotFlagSta 0 "Default(No Timeout)" 1 "RSPA CAN Timeout" 2 "Not Used" 3 "Error Indicator" ;
VAL_ 3221225472 Mirror_SmrtWlcmMirrReq 0 "Default" 1 "Fold(Away)" 2 "Unfold(Access)" 3 "Error Indicator" ;
VAL_ 3221225472 RKE_BtnReq 0 "None" 1 "Lock" 2 "Unlock" 3 "Trunk(Or Tail Gate)" 4 "Panic" 5 "Panic Stop" 6 "0x6:Two Step Unlock Warning" 7 "Remote Cranking Stop" 8 "Remote Cranking Start" 9 "Forward(RSPA)" 10 "Backward/Parking(RSPA)" 11 "Pause(RSPA)" 12 "Reserved" 13 "Reserved" 14 "Not Used" 15 "Error Indicator" ;
VAL_ 3221225472 RKE_WdwUpDnReq 0 "None" 1 "Remote Window Open" 2 "Remote Window Close" 3 "Remote Window Stop" 4 "Reseved" 5 "Reseved" 6 "Not Used" 7 "Error Indicator" ;
VAL_ 3221225472 RKE_ID 0 "None" 1 "ID1" 2 "ID2" 3 "ID3" 4 "ID4" 5 "Reseved" 6 "Not Used" 7 "Error Indicator" ;
VAL_ 3221225472 IAU_NFCWPCDeviceScanReq 0 "None" 1 "Scan Start" 2 "Scan Stop" 3 "Invalid" ;
VAL_ 3221225472 IAU_LftDrHndLockSnsrSta 0 "Off" 1 "On" 2 "Not Used" 3 "Error Indicator" ;
VAL_ 3221225472 IAU_LftDrHndUnlockSnsrSta 0 "Off" 1 "On" 2 "Not Used" 3 "Error Indicator" ;
VAL_ 3221225472 IAU_RtDrHndLockSnsrSta 0 "Off" 1 "On" 2 "Not Used" 3 "Error Indicator" ;
VAL_ 3221225472 IAU_RtDrHndUnlockSnsrSta 0 "Off" 1 "On" 2 "Not Used" 3 "Error Indicator" ;
VAL_ 3221225472 IAU_LftDrHndWlightSta 0 "Off" 1 "On" 2 "Not Used" 3 "Error Indicator" ;
VAL_ 3221225472 IAU_RtDrHndWlightSta 0 "Off" 1 "On" 2 "Not Used" 3 "Error Indicator" ;
VAL_ 3221225472 IAU_AuthDevice 0 "None" 1 "DRV Door" 2 "AST Door" 3 "SSB" 4 "WPC" 5 "Reserved" 6 "Reserved" 7 "Reserved" ;
VAL_ 3221225472 IAU_AuthResult 0 "Default" 1 "Success" 2 "Failure" 3 "Not Available" 4 "Reserved" 5 "Reserved" 6 "Reserved" 7 "Reserved" ;
VAL_ 3221225472 IAU_FOBSrch 0 "None" 1 "Search a fob inside" 2 "reserved" 3 "reserved" 4 "reserved" 5 "reserved" 6 "reserved" 7 "reserved" ;
VAL_ 3221225472 WHL_SpdFLVal 16383 "Error" ;
VAL_ 3221225472 WHL_SpdFRVal 16383 "Error" ;
VAL_ 3221225472 WHL_SpdRLVal 16383 "Error" ;
VAL_ 3221225472 WHL_SpdRRVal 16383 "Error" ;
VAL_ 3221225472 WHL_PlsFLVal 255 "Error" ;
VAL_ 3221225472 WHL_PlsFRVal 255 "Error" ;
VAL_ 3221225472 WHL_PlsRLVal 255 "Error" ;
VAL_ 3221225472 WHL_PlsRRVal 255 "Error" ;
VAL_ 3221225472 WHL_DirFLVal 0 "Unknown (Wheel moving stop state or Not applied wheel sensor for direction)" 1 "Forward direction" 2 "Backward direction" 3 "Error identifier" ;
VAL_ 3221225472 WHL_DirFRVal 0 "Unknown (Wheel moving stop state or Not applied wheel sensor for direction)" 1 "Forward direction" 2 "Backward direction" 3 "Error identifier" ;
VAL_ 3221225472 WHL_DirRLVal 0 "Unknown (Wheel moving stop state or Not applied wheel sensor for direction)" 1 "Forward direction" 2 "Backward direction" 3 "Error identifier" ;
VAL_ 3221225472 WHL_DirRRVal 0 "Unknown (Wheel moving stop state or Not applied wheel sensor for direction)" 1 "Forward direction" 2 "Backward direction" 3 "Error identifier" ;
VAL_ 3221225472 ENG_TrgtIdleRpmVal 255 "Error indicator" ;
VAL_ 3221225472 ENG_GearShftUpDis 0 "Gear Shiftup Display Off" 1 "Gear Shiftup Display On" 2 "Not used" 3 "Error indicator" ;
VAL_ 3221225472 ENG_GearShftDnDis 0 "Gear Shiftdown Display Off" 1 "Gear Shiftdown Display On" 2 "Not used" 3 "Error indicator" ;
VAL_ 3221225472 ENG_DsrGearPosDis 0 "No display" 1 "Gear Position 1 display" 2 "Gear Position 2 display" 3 "Gear Position 3 display" 4 "Gear Position 4 display" 5 "Gear Position 5 display" 6 "Gear Position 6 display" 7 "Gear Position 7 display" 8 "Gear Position 8 display" 9 "Gear Position 9 display" 10 "Gear Position 10 display" 15 "Error indicator" ;
VAL_ 3221225472 ENG_SldFuncSta 0 "Speed limiter function is not active" 1 "Speed limiter function is active" 2 "Not used" 3 "Error indicator" ;
VAL_ 3221225472 ENG_SldActnSta 0 "Positive action is not active" 1 "Positive action is active" 2 "Not used" 3 "Error indicator" ;
VAL_ 3221225472 ENG_FuelTnkPrsrSta 0 "Fuel Tank is not in high Pressure" 1 "Fuel Tank is in high Pressure" 2 "Not used" 3 "Error indicator" ;
VAL_ 3221225472 ENG_IsgBzrReq 0 "Request buzzer OFF" 1 "Request buzzer ON" 2 "Not used" 3 "Error indicator" ;
VAL_ 3221225472 ENG_IsgFuelCnsmptDis 0 "Not fuel consumption" 1 "Fuel consumption(=1mL)" 2 "Not used" 3 "Error indicator" ;
VAL_ 3221225472 ENG_FuelCapOpnSta 0 "Fuel cap isn't opened" 1 "Fuel cap is opened" 2 "Not used" 3 "Error indicator" ;
VAL_ 3221225472 ENG_EcoDrvActvSta 0 "Active Eco Drive is not active" 1 "Active Eco Drive is active" 2 "Not used" 3 "Error indicator" ;
VAL_ 3221225472 ENG_EngRunSta 0 "Engine Stop or Starting Phase" 1 "Engine Running" 2 "Not used" 3 "Error indicator" ;
VAL_ 3221225472 ENG_Isg2Sta 0 "Default" 1 "The condition for not-activated battery sensor. (Except EOL condition.)" 2 "In Auto Start status, when rapidly accelerating before complete gear shift. (Economy ISG Only)" 3 "Error indicator" ;
VAL_ 3221225472 ENG_IgnOnSta 0 "KEY OFF, control unit in self-holding phase" 1 "KEY ON" 2 "Not used" 3 "Error indicator" ;
VAL_ 3221225472 ENG_Ack4TcsSta 0 "TCS message not received within the last 500 ms, or a plausibility error in torque intervention is ON" 1 "TCS message received, and no plausibility error" 2 "Not used" 3 "Error indicator" ;
VAL_ 3221225472 ENG_FuelCutOffSta 0 "Engine not in fuel cut off" 1 "Engine in fuel cut off" 2 "Not used" 3 "Error indicator" ;
VAL_ 3221225472 ENG_CrctTqSta 0 "The desired intervention regarding ignition angle retardation and cylinder shut-off is executed. (Default value)" 1 "The desired intervention regarding ignition angle retardation and cylinder shut-off is executed; however, the requested target torque can not be adjusted precisely (torque steps)" 2 "The torque reduction regarding the ignition angle retardation cannot be completely executed. A cylinder shut-off is not possible at this time." 3 "Due to a failure detected the desired torque intervention for TCS regarding the ignition angle and cylinder shut-off is no longer executed." ;
VAL_ 3221225472 ENG_AirCompRlySta 0 "Air conditioner compressor relay OFF" 1 "Air conditioner compressor relay ON" 2 "Not used" 3 "Error indicator" ;
VAL_ 3221225472 ENG_LnchCntrlSta 0 "Off state" 1 "Standby" 2 "Ready" 3 "Lanch" 4 "Error indicator" ;
VAL_ 3221225472 ENG_VehSpdHiVal 511 "Error indicator" ;
VAL_ 3221225472 ENG_VehSpdLimVal 511 "Error indicator" ;
VAL_ 3221225472 HUD_HghtSta 0 "Step 1" 1 "Step 2" 2 "Step 3" 3 "Step 4" 4 "Step 5" 5 "Step 6" 6 "Step 7" 7 "Step 8" 8 "Step 9" 9 "Step 10" 10 "Step 11" 11 "Step 12" 12 "Step 13" 13 "Step 14" 14 "Step 15" 15 "Step 16" 16 "Step 17" 17 "Step 18" 18 "Step 19" 19 "Step 20" ;
VAL_ 3221225472 HUD_PbackSta 0 "Stop" 1 "Play 1" 2 "Play 2" 3 "Health Care IMS" 4 "Reserved" 5 "Reserved" 6 "Reserved" 7 "Invalid" ;
VAL_ 3221225472 HUD_BrgtnsSta 0 "Step 1" 1 "Step 2" 2 "Step 3" 3 "Step 4" 4 "Step 5" 5 "Step 6" 6 "Step 7" 7 "Step 8" 8 "Step 9" 9 "Step 10" 10 "Step 11" 11 "Step 12" 12 "Step 13" 13 "Step 14" 14 "Step 15" 15 "Step 16" 16 "Step 17" 17 "Step 18" 18 "Step 19" 19 "Step 20" ;
VAL_ 3221225472 HUD_Type 0 "windshield type" 1 "combiner type" 2 "reserved" 3 "invalid" ;
VAL_ 3221225472 HUD_RotatSta 0 "CENTER" 1 "CW 1" 2 "CW 2" 3 "CW 3" 4 "CW 4" 5 "CW 5" 6 "CW 6" 7 "CW 7" 8 "CW 8" 9 "CW 9" 10 "CW 10" 17 "CCW 1" 18 "CCW 2" 19 "CCW 3" 20 "CCW 4" 21 "CCW 5" 22 "CCW 6" 23 "CCW 7" 24 "CCW 8" 25 "CCW 9" 26 "CCW 10" ;
VAL_ 3221225472 HUD_setSW 0 "OFF" 1 "ON" 2 "reserved" 3 "invalid" ;
VAL_ 3221225472 HUD_ContentsTBTStatus 0 "OFF" 1 "ON" 2 "reserved" 3 "invalid" ;
VAL_ 3221225472 HUD_ContentsDISStatus 0 "OFF" 1 "ON" 2 "reserved" 3 "invalid" ;
VAL_ 3221225472 HUD_ContentsSCCStatus 0 "OFF" 1 "ON" 2 "reserved" 3 "invalid" ;
VAL_ 3221225472 HUD_ContentsLKA_LDWStatus 0 "OFF" 1 "ON" 2 "reserved" 3 "invalid" ;
VAL_ 3221225472 HUD_ContentsBCWStatus 0 "OFF" 1 "ON" 2 "reserved" 3 "invalid" ;
VAL_ 3221225472 HUD_ContentsAVStatus 0 "OFF" 1 "ON" 2 "reserved" 3 "invalid" ;
VAL_ 3221225472 HUD_FontColorStatus 0 "white" 1 "yellow" 2 "green" 3 "invaild" ;
VAL_ 3221225472 HUD_FontSizeStatus 0 "Large" 1 "Mid" 2 "Small" 3 "invalid" ;
VAL_ 3221225472 EMS_Crc1Val 65535 "Signal Invalid (Message with unused CRC. CRC signal is transmitted fixed value)" ;
VAL_ 3221225472 EMS_AlvCnt1Val 255 "Signal Invalid (Message with unused Alive counter. Alive counter signal is transmitted fixed value)" ;
VAL_ 3221225472 ENG_EngSpdErrSta 0 "No error" 1 "Engine speed sensor defective" 2 "Not used" 3 "Error indicator" ;
VAL_ 3221225472 ENG_MafErrSta 0 "No error" 1 "Error on Torque Measurement" 2 "Not used" 3 "Error indicator" ;
VAL_ 3221225472 ENG_EtcLmphModSta 0 "Engine control is available" 1 "ETC Limphome mode by ECU" 2 "Not used" 3 "Error indicator" ;
VAL_ 3221225472 ENG_MaxAirconTqVal 255 "Error indicator" ;
