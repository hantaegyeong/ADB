VERSION ""

NS_ :

BS_:

BU_: MLM IBU_HS ILCU_RH MFSW DPSU ILCU_LH PSB APSU DPSS SWRC CGW PTGM DLBCU SCM DAU WPC IAU eCall PFSU RDC PSM

BO_ 3221225472 VECTOR__INDEPENDENT_SIG_MSG: 0 Vector__XXX
 SG_ FCA_FullActvReq : 0|2@1+ (1,0) [0|0] "" Vector__XXX
 SG_ FCA_SnstvtyModRetVal : 0|3@1+ (1,0) [0|0] "" Vector__XXX
 SG_ FCA_RelVel : 0|9@1+ (0.1,0) [0|0] "m/s" Vector__XXX
 SG_ FCA_TimetoCllsn : 0|8@1+ (10,0) [0|0] "ms" Vector__XXX
 SG_ Nmode_FCAOff_Sta : 0|2@1+ (1,0) [0|0] "" Vector__XXX
 SG_ FCA_Jnctn_OnOffEquipSta : 0|2@1+ (1,0) [0|0] "" Vector__XXX
 SG_ FCA_WrngTrgtDis : 0|5@1+ (1,0) [0|0] "" Vector__XXX
 SG_ IAU_GST_Byte0 : 0|8@1+ (1,0) [0|0] "" Vector__XXX
 SG_ IAU_GST_Byte1 : 0|8@1+ (1,0) [0|0] "" Vector__XXX
 SG_ IAU_GST_Byte2 : 0|8@1+ (1,0) [0|0] "" Vector__XXX
 SG_ IAU_GST_Byte3 : 0|8@1+ (1,0) [0|0] "" Vector__XXX
 SG_ IAU_GST_Byte4 : 0|8@1+ (1,0) [0|0] "" Vector__XXX
 SG_ IAU_GST_Byte5 : 0|8@1+ (1,0) [0|0] "" Vector__XXX
 SG_ IAU_GST_Byte6 : 0|8@1+ (1,0) [0|0] "" Vector__XXX
 SG_ IAU_GST_Byte7 : 0|8@1+ (1,0) [0|0] "" Vector__XXX
 SG_ RSPA_BxHght : 0|8@1+ (10,3500) [0|0] "" Vector__XXX
 SG_ RSPA_BxWidth : 0|8@1+ (5,1000) [0|0] "" Vector__XXX
 SG_ RSPA_RtTrgtPosX : 0|8@1+ (10,0) [0|0] "" Vector__XXX
 SG_ RSPA_RtTrgtPosY : 0|8@1+ (10,0) [0|0] "" Vector__XXX
 SG_ RSPA_LftTrgtPosX : 0|8@1+ (10,0) [0|0] "" Vector__XXX
 SG_ RSPA_LftTrgtPosY : 0|8@1+ (10,0) [0|0] "" Vector__XXX
 SG_ RSPA_Sta : 0|4@1+ (1,0) [0|0] "" Vector__XXX
 SG_ RSPA_Actv : 0|2@1+ (1,0) [0|0] "" Vector__XXX
 SG_ GST_RRHVU_Byte0 : 0|8@1+ (1,0) [0|0] "" Vector__XXX
 SG_ GST_RRHVU_Byte1 : 0|8@1+ (1,0) [0|0] "" Vector__XXX
 SG_ GST_RRHVU_Byte2 : 0|8@1+ (1,0) [0|0] "" Vector__XXX
 SG_ GST_RRHVU_Byte3 : 0|8@1+ (1,0) [0|0] "" Vector__XXX
 SG_ GST_RRHVU_Byte4 : 0|8@1+ (1,0) [0|0] "" Vector__XXX
 SG_ GST_RRHVU_Byte5 : 0|8@1+ (1,0) [0|0] "" Vector__XXX
 SG_ GST_RRHVU_Byte6 : 0|8@1+ (1,0) [0|0] "" Vector__XXX
 SG_ GST_RRHVU_Byte7 : 0|8@1+ (1,0) [0|0] "" Vector__XXX
 SG_ RSPA_TrgtGearSta : 0|3@1+ (1,0) [0|0] "" Vector__XXX
 SG_ RSPA_EpbReq : 0|2@1+ (1,0) [0|0] "" Vector__XXX
 SG_ RSPA_ExtLampReq : 0|3@1+ (1,0) [0|0] "" Vector__XXX
 SG_ RSPA_CrankingReq : 0|2@1+ (1,0) [0|0] "" Vector__XXX
 SG_ RSPA_IdOutWarnReq : 0|2@1+ (1,0) [0|0] "" Vector__XXX
 SG_ RSPA_IndBlnkReq : 0|3@1+ (1,0) [0|0] "" Vector__XXX
 SG_ RSPA_DccCmd : 0|2@1+ (1,0) [0|0] "" Vector__XXX
 SG_ RSPA_StopReq : 0|2@1+ (1,0) [0|0] "" Vector__XXX
 SG_ RSPA_TrgtVehSpdVal : 0|10@1+ (0.01,0) [0|0] "" Vector__XXX
 SG_ RSPA_AddtnlAccelActv : 0|2@1+ (1,0) [0|0] "" Vector__XXX
 SG_ RSPA_Opt : 0|2@1+ (1,0) [0|0] "" Vector__XXX
 SG_ RSPA_TrgtTqVal : 0|12@1- (1,0) [0|0] "Nm" Vector__XXX
 SG_ RSPA_DCTTrgtTqVal : 0|16@1+ (0.3906,0) [0|0] "" Vector__XXX
 SG_ GST_MLM_Byte0 : 0|8@1+ (1,0) [0|0] "" Vector__XXX
 SG_ GST_MLM_Byte1 : 0|8@1+ (1,0) [0|0] "" Vector__XXX
 SG_ GST_MLM_Byte2 : 0|8@1+ (1,0) [0|0] "" Vector__XXX
 SG_ GST_MLM_Byte3 : 0|8@1+ (1,0) [0|0] "" Vector__XXX
 SG_ GST_MLM_Byte4 : 0|8@1+ (1,0) [0|0] "" Vector__XXX
 SG_ GST_MLM_Byte5 : 0|8@1+ (1,0) [0|0] "" Vector__XXX
 SG_ GST_MLM_Byte6 : 0|8@1+ (1,0) [0|0] "" Vector__XXX
 SG_ GST_MLM_Byte7 : 0|8@1+ (1,0) [0|0] "" Vector__XXX
 SG_ GST_IAU_Byte0 : 0|8@1+ (1,0) [0|0] "" Vector__XXX
 SG_ GST_IAU_Byte1 : 0|8@1+ (1,0) [0|0] "" Vector__XXX
 SG_ GST_IAU_Byte2 : 0|8@1+ (1,0) [0|0] "" Vector__XXX
 SG_ GST_IAU_Byte3 : 0|8@1+ (1,0) [0|0] "" Vector__XXX
 SG_ GST_IAU_Byte4 : 0|8@1+ (1,0) [0|0] "" Vector__XXX
 SG_ GST_IAU_Byte5 : 0|8@1+ (1,0) [0|0] "" Vector__XXX
 SG_ GST_IAU_Byte6 : 0|8@1+ (1,0) [0|0] "" Vector__XXX
 SG_ GST_IAU_Byte7 : 0|8@1+ (1,0) [0|0] "" Vector__XXX
 SG_ ADAS_PRK_Crc3Val : 0|16@1+ (1,0) [0|0] "" Vector__XXX
 SG_ ADAS_PRK_AlvCnt3Val : 0|8@1+ (1,0) [0|0] "" Vector__XXX
 SG_ RSPA_AvnDis : 0|2@1+ (1,0) [0|0] "" Vector__XXX
 SG_ RSPA_AvnModDis : 0|2@1+ (1,0) [0|0] "" Vector__XXX
 SG_ RSPA_AvnModNumDis : 0|3@1+ (1,0) [0|0] "" Vector__XXX
 SG_ RSPA_AvnSubViewDis : 0|2@1+ (1,0) [0|0] "" Vector__XXX
 SG_ RSPA_AvnModADLDis : 0|2@1+ (1,0) [0|0] "" Vector__XXX
 SG_ RSPA_AvnModPDFLDis : 0|2@1+ (1,0) [0|0] "" Vector__XXX
 SG_ RSPA_AvnModPLDis : 0|2@1+ (1,0) [0|0] "" Vector__XXX
 SG_ RSPA_AvnModPDRLDis : 0|2@1+ (1,0) [0|0] "" Vector__XXX
 SG_ RSPA_AvnModPDRRDis : 0|2@1+ (1,0) [0|0] "" Vector__XXX
 SG_ RSPA_AvnModPRDis : 0|2@1+ (1,0) [0|0] "" Vector__XXX
 SG_ RSPA_AvnModPDFRDis : 0|2@1+ (1,0) [0|0] "" Vector__XXX
 SG_ RSPA_AvnModADRDis : 0|2@1+ (1,0) [0|0] "" Vector__XXX
 SG_ RSPA_CamDis : 0|3@1+ (1,0) [0|0] "" Vector__XXX
 SG_ RSPA_AvnHmiDis : 0|8@1+ (1,0) [0|0] "" Vector__XXX
 SG_ PSB_Crc1Val : 0|8@1+ (1,0) [0|0] "" Vector__XXX
 SG_ PSB_AlvCnt1Val : 0|4@1+ (1,0) [0|0] "" Vector__XXX
 SG_ PSB_LHFlrSta : 0|2@1+ (1,0) [0|0] "" Vector__XXX
 SG_ PSB_LHActvSta : 0|4@1+ (1,0) [0|0] "" Vector__XXX
 SG_ PSB_RHFlrSta : 0|2@1+ (1,0) [0|0] "" Vector__XXX
 SG_ PSB_RHActvSta : 0|4@1+ (1,0) [0|0] "" Vector__XXX
 SG_ PSB_ActForAcu : 0|4@1+ (1,0) [0|0] "" Vector__XXX
 SG_ PTGM_Crc1Val : 0|8@1+ (1,0) [0|0] "" Vector__XXX
 SG_ PTGM_AlvCnt1Val : 0|4@1+ (1,0) [0|0] "" Vector__XXX
 SG_ PTGM_HazardSta : 0|2@1+ (1,0) [0|0] "" Vector__XXX
 SG_ PTGM_ModSta : 0|2@1+ (1,0) [0|0] "" Vector__XXX
 SG_ PTGM_MovSta : 0|2@1+ (1,0) [0|0] "" Vector__XXX
 SG_ PTGM_OptTyp : 0|2@1+ (1,0) [0|0] "" Vector__XXX
 SG_ PTGM_ReleaseRlySta : 0|2@1+ (1,0) [0|0] "" Vector__XXX
 SG_ PTGM_TrnkLkSwSta : 0|2@1+ (1,0) [0|0] "" Vector__XXX
 SG_ PTGM_UsmSetSta : 0|2@1+ (1,0) [0|0] "" Vector__XXX
 SG_ GST_RLHVU_Byte0 : 0|8@1+ (1,0) [0|0] "" Vector__XXX
 SG_ GST_RLHVU_Byte1 : 0|8@1+ (1,0) [0|0] "" Vector__XXX
 SG_ GST_RLHVU_Byte2 : 0|8@1+ (1,0) [0|0] "" Vector__XXX
 SG_ GST_RLHVU_Byte3 : 0|8@1+ (1,0) [0|0] "" Vector__XXX
 SG_ GST_RLHVU_Byte4 : 0|8@1+ (1,0) [0|0] "" Vector__XXX
 SG_ GST_RLHVU_Byte5 : 0|8@1+ (1,0) [0|0] "" Vector__XXX
 SG_ GST_RLHVU_Byte6 : 0|8@1+ (1,0) [0|0] "" Vector__XXX
 SG_ GST_RLHVU_Byte7 : 0|8@1+ (1,0) [0|0] "" Vector__XXX
 SG_ ADAS_CMD_Crc40Val : 0|16@1+ (1,0) [0|0] "" Vector__XXX
 SG_ ADAS_CMD_AlvCnt40Val : 0|8@1+ (1,0) [0|0] "" Vector__XXX
 SG_ BCW_Sta : 0|4@1+ (1,0) [0|0] "" Vector__XXX
 SG_ BCW_OnOffEquipSta : 0|2@1+ (1,0) [0|0] "" Vector__XXX
 SG_ BCW_LftIndSta : 0|2@1+ (1,0) [0|0] "" Vector__XXX
 SG_ BCW_RtIndSta : 0|2@1+ (1,0) [0|0] "" Vector__XXX
 SG_ BCW_LftSndWrngSta : 0|2@1+ (1,0) [0|0] "" Vector__XXX
 SG_ BCW_RtSndWrngSta : 0|2@1+ (1,0) [0|0] "" Vector__XXX
 SG_ BCW_LftIndBriLvlVal : 0|8@1+ (1,0) [0|0] "" Vector__XXX
 SG_ BCW_RtIndBriLvlVal : 0|8@1+ (1,0) [0|0] "" Vector__XXX
 SG_ BCW_SnstvtyModRetVal : 0|3@1+ (1,0) [0|0] "" Vector__XXX
 SG_ BCA_Sta : 0|4@1+ (1,0) [0|0] "" Vector__XXX
 SG_ BCA_OnOffEquipSta : 0|3@1+ (1,0) [0|0] "" Vector__XXX
 SG_ BCA_LftWrngSta : 0|2@1+ (1,0) [0|0] "" Vector__XXX
 SG_ BCA_RtWrngSta : 0|2@1+ (1,0) [0|0] "" Vector__XXX
 SG_ BCA_Plus_Deccel_Req : 0|4@1+ (0.04,0) [0|0] "Sec" Vector__XXX
 SG_ BCA_Plus_BrkCmdSta : 0|2@1+ (1,0) [0|0] "" Vector__XXX
 SG_ BCA_Plus_LftWrngSta : 0|2@1+ (1,0) [0|0] "" Vector__XXX
 SG_ BCA_Plus_RtWrngSta : 0|2@1+ (1,0) [0|0] "" Vector__XXX
 SG_ BCA_Plus_OnOffEquipSta : 0|3@1+ (1,0) [0|0] "" Vector__XXX
 SG_ BCA_Plus_FuncStat : 0|2@1+ (1,0) [0|0] "" Vector__XXX
 SG_ BCA_Plus_Sta : 0|4@1+ (1,0) [0|0] "" Vector__XXX
 SG_ RLHVU_GST_Byte0 : 0|8@1+ (1,0) [0|0] "" Vector__XXX
 SG_ RLHVU_GST_Byte1 : 0|8@1+ (1,0) [0|0] "" Vector__XXX
 SG_ RLHVU_GST_Byte2 : 0|8@1+ (1,0) [0|0] "" Vector__XXX
 SG_ RLHVU_GST_Byte3 : 0|8@1+ (1,0) [0|0] "" Vector__XXX
 SG_ RLHVU_GST_Byte4 : 0|8@1+ (1,0) [0|0] "" Vector__XXX
 SG_ RLHVU_GST_Byte5 : 0|8@1+ (1,0) [0|0] "" Vector__XXX
 SG_ RLHVU_GST_Byte6 : 0|8@1+ (1,0) [0|0] "" Vector__XXX
 SG_ RLHVU_GST_Byte7 : 0|8@1+ (1,0) [0|0] "" Vector__XXX
 SG_ GST_ALL_Byte0 : 0|8@1+ (1,0) [0|0] "" Vector__XXX
 SG_ GST_ALL_Byte1 : 0|8@1+ (1,0) [0|0] "" Vector__XXX
 SG_ GST_ALL_Byte2 : 0|8@1+ (1,0) [0|0] "" Vector__XXX
 SG_ GST_ALL_Byte3 : 0|8@1+ (1,0) [0|0] "" Vector__XXX
 SG_ GST_ALL_Byte4 : 0|8@1+ (1,0) [0|0] "" Vector__XXX
 SG_ GST_ALL_Byte5 : 0|8@1+ (1,0) [0|0] "" Vector__XXX
 SG_ GST_ALL_Byte6 : 0|8@1+ (1,0) [0|0] "" Vector__XXX
 SG_ GST_ALL_Byte7 : 0|8@1+ (1,0) [0|0] "" Vector__XXX
 SG_ ILCU_LH_GST_Byte0 : 0|8@1+ (1,0) [0|0] "" Vector__XXX
 SG_ ILCU_LH_GST_Byte1 : 0|8@1+ (1,0) [0|0] "" Vector__XXX
 SG_ ILCU_LH_GST_Byte2 : 0|8@1+ (1,0) [0|0] "" Vector__XXX
 SG_ ILCU_LH_GST_Byte3 : 0|8@1+ (1,0) [0|0] "" Vector__XXX
 SG_ ILCU_LH_GST_Byte4 : 0|8@1+ (1,0) [0|0] "" Vector__XXX
 SG_ ILCU_LH_GST_Byte5 : 0|8@1+ (1,0) [0|0] "" Vector__XXX
 SG_ ILCU_LH_GST_Byte6 : 0|8@1+ (1,0) [0|0] "" Vector__XXX
 SG_ ILCU_LH_GST_Byte7 : 0|8@1+ (1,0) [0|0] "" Vector__XXX
 SG_ ILCU_RH_GST_Byte0 : 0|8@1+ (1,0) [0|0] "" Vector__XXX
 SG_ ILCU_RH_GST_Byte1 : 0|8@1+ (1,0) [0|0] "" Vector__XXX
 SG_ ILCU_RH_GST_Byte2 : 0|8@1+ (1,0) [0|0] "" Vector__XXX
 SG_ ILCU_RH_GST_Byte3 : 0|8@1+ (1,0) [0|0] "" Vector__XXX
 SG_ ILCU_RH_GST_Byte4 : 0|8@1+ (1,0) [0|0] "" Vector__XXX
 SG_ ILCU_RH_GST_Byte5 : 0|8@1+ (1,0) [0|0] "" Vector__XXX
 SG_ ILCU_RH_GST_Byte6 : 0|8@1+ (1,0) [0|0] "" Vector__XXX
 SG_ ILCU_RH_GST_Byte7 : 0|8@1+ (1,0) [0|0] "" Vector__XXX
 SG_ GST_ALU_Byte0 : 0|8@1+ (1,0) [0|0] "" Vector__XXX
 SG_ GST_ALU_Byte1 : 0|8@1+ (1,0) [0|0] "" Vector__XXX
 SG_ GST_ALU_Byte2 : 0|8@1+ (1,0) [0|0] "" Vector__XXX
 SG_ GST_ALU_Byte3 : 0|8@1+ (1,0) [0|0] "" Vector__XXX
 SG_ GST_ALU_Byte4 : 0|8@1+ (1,0) [0|0] "" Vector__XXX
 SG_ GST_ALU_Byte5 : 0|8@1+ (1,0) [0|0] "" Vector__XXX
 SG_ GST_ALU_Byte6 : 0|8@1+ (1,0) [0|0] "" Vector__XXX
 SG_ GST_ALU_Byte7 : 0|8@1+ (1,0) [0|0] "" Vector__XXX
 SG_ GST_PFSU_Byte0 : 0|8@1+ (1,0) [0|0] "" Vector__XXX
 SG_ GST_PFSU_Byte1 : 0|8@1+ (1,0) [0|0] "" Vector__XXX
 SG_ GST_PFSU_Byte2 : 0|8@1+ (1,0) [0|0] "" Vector__XXX
 SG_ GST_PFSU_Byte3 : 0|8@1+ (1,0) [0|0] "" Vector__XXX
 SG_ GST_PFSU_Byte4 : 0|8@1+ (1,0) [0|0] "" Vector__XXX
 SG_ GST_PFSU_Byte5 : 0|8@1+ (1,0) [0|0] "" Vector__XXX
 SG_ GST_PFSU_Byte6 : 0|8@1+ (1,0) [0|0] "" Vector__XXX
 SG_ GST_PFSU_Byte7 : 0|8@1+ (1,0) [0|0] "" Vector__XXX
 SG_ GST_PSB_Byte0 : 0|8@1+ (1,0) [0|0] "" Vector__XXX
 SG_ GST_PSB_Byte1 : 0|8@1+ (1,0) [0|0] "" Vector__XXX
 SG_ GST_PSB_Byte2 : 0|8@1+ (1,0) [0|0] "" Vector__XXX
 SG_ GST_PSB_Byte3 : 0|8@1+ (1,0) [0|0] "" Vector__XXX
 SG_ GST_PSB_Byte4 : 0|8@1+ (1,0) [0|0] "" Vector__XXX
 SG_ GST_PSB_Byte5 : 0|8@1+ (1,0) [0|0] "" Vector__XXX
 SG_ GST_PSB_Byte6 : 0|8@1+ (1,0) [0|0] "" Vector__XXX
 SG_ GST_PSB_Byte7 : 0|8@1+ (1,0) [0|0] "" Vector__XXX
 SG_ CLU_Crc1Val : 0|16@1+ (1,0) [0|0] "" Vector__XXX
 SG_ CLU_AlvCnt1Val : 0|8@1+ (1,0) [0|0] "" Vector__XXX
 SG_ CLU_PrtyBitSta : 0|2@1+ (1,0) [0|0] "pulse count" Vector__XXX
 SG_ CLU_PdwDisTyp : 0|2@1+ (1,0) [0|0] "" Vector__XXX
 SG_ CLU_DtntOutSta : 0|2@1+ (1,0) [0|0] "" Vector__XXX
 SG_ CLU_SpdUnitTyp : 0|2@1+ (1,0) [0|0] "" Vector__XXX
 SG_ CLU_DisSpdDcmlVal : 0|2@1+ (0.125,0) [0|0] "" Vector__XXX
 SG_ CLU_RhstaLvlSta : 0|5@1+ (1,0) [0|0] "" Vector__XXX
 SG_ CLU_DisSpdVal : 0|10@1+ (0.5,0) [0|0] "km/h or MPH" Vector__XXX
 SG_ GST_APSS_Byte0 : 0|8@1+ (1,0) [0|0] "" Vector__XXX
 SG_ GST_APSS_Byte1 : 0|8@1+ (1,0) [0|0] "" Vector__XXX
 SG_ GST_APSS_Byte2 : 0|8@1+ (1,0) [0|0] "" Vector__XXX
 SG_ GST_APSS_Byte3 : 0|8@1+ (1,0) [0|0] "" Vector__XXX
 SG_ GST_APSS_Byte4 : 0|8@1+ (1,0) [0|0] "" Vector__XXX
 SG_ GST_APSS_Byte5 : 0|8@1+ (1,0) [0|0] "" Vector__XXX
 SG_ GST_APSS_Byte6 : 0|8@1+ (1,0) [0|0] "" Vector__XXX
 SG_ GST_APSS_Byte7 : 0|8@1+ (1,0) [0|0] "" Vector__XXX
 SG_ VCRM_CluSrvRmndrDaySta : 0|7@1+ (1,0) [0|0] "" Vector__XXX
 SG_ VCRM_CluSrvRmndrDstSta : 0|10@1+ (1,0) [0|0] "" Vector__XXX
 SG_ VCRM_CluVcAlrmVolSta : 0|3@1+ (1,0) [0|0] "" Vector__XXX
 SG_ GST_eCall_Byte0 : 0|8@1+ (1,0) [0|0] "" Vector__XXX
 SG_ GST_eCall_Byte1 : 0|8@1+ (1,0) [0|0] "" Vector__XXX
 SG_ GST_eCall_Byte2 : 0|8@1+ (1,0) [0|0] "" Vector__XXX
 SG_ GST_eCall_Byte3 : 0|8@1+ (1,0) [0|0] "" Vector__XXX
 SG_ GST_eCall_Byte4 : 0|8@1+ (1,0) [0|0] "" Vector__XXX
 SG_ GST_eCall_Byte5 : 0|8@1+ (1,0) [0|0] "" Vector__XXX
 SG_ GST_eCall_Byte6 : 0|8@1+ (1,0) [0|0] "" Vector__XXX
 SG_ GST_eCall_Byte7 : 0|8@1+ (1,0) [0|0] "" Vector__XXX
 SG_ CLU_Crc3Val : 0|16@1+ (1,0) [0|0] "" Vector__XXX
 SG_ CLU_AlvCnt3Val : 0|8@1+ (1,0) [0|0] "" Vector__XXX
 SG_ VCRM_CluDISWrngSta : 0|2@1+ (1,0) [0|0] "" Vector__XXX
 SG_ VCRM_CluFuelConsmptnUnitSta : 0|2@1+ (1,0) [0|0] "" Vector__XXX
 SG_ VCRM_CluGearPosPopupSta : 0|2@1+ (1,0) [0|0] "" Vector__XXX
 SG_ VCRM_CluMFSWPopupSta : 0|2@1+ (1,0) [0|0] "" Vector__XXX
 SG_ VCRM_CluSrvRmndrSta : 0|2@1+ (1,0) [0|0] "" Vector__XXX
 SG_ VCRM_CluSpdmtrSta : 0|2@1+ (1,0) [0|0] "" Vector__XXX
 SG_ VCRM_CluStrWhlAlignSta : 0|2@1+ (1,0) [0|0] "" Vector__XXX
 SG_ VCRM_CluWlcmSndSta : 0|2@1+ (1,0) [0|0] "" Vector__XXX
 SG_ VCRM_CluDisGrpSta : 0|4@1+ (1,0) [0|0] "" Vector__XXX
 SG_ VCRM_CluDisModSta : 0|4@1+ (1,0) [0|0] "" Vector__XXX
 SG_ VCRM_CluAvgFuelCnsmptnAutoRstSta : 0|3@1+ (1,0) [0|0] "" Vector__XXX
 SG_ VCRM_CluTxtSizeSta : 0|3@1+ (1,0) [0|0] "" Vector__XXX
 SG_ VCRM_CluLngSetSta : 0|6@1+ (1,0) [0|0] "" Vector__XXX
 SG_ CLU_DisSpdVal_KPH : 0|9@1+ (1,0) [0|0] "km/h" Vector__XXX
 SG_ PSM_DrvStReclnePosVal : 0|3@1+ (1,0) [0|0] "" Vector__XXX
 SG_ PSM_DrvStSldPosVal : 0|3@1+ (1,0) [0|0] "" Vector__XXX
 SG_ PSM_EsyAcsGetOnSta : 0|2@1+ (1,0) [0|0] "" Vector__XXX
 SG_ PSM_EsyAcsGetOffSta : 0|2@1+ (1,0) [0|0] "" Vector__XXX
 SG_ PSM_EsyAcsStpSta : 0|2@1+ (1,0) [0|0] "" Vector__XXX
 SG_ ADAS_CMD_Crc20Val : 0|16@1+ (1,0) [0|0] "" Vector__XXX
 SG_ ADAS_CMD_AlvCnt20Val : 0|8@1+ (1,0) [0|0] "" Vector__XXX
 SG_ SCC_ObjDstVal : 0|11@1+ (0.1,0) [0|0] "m" Vector__XXX
 SG_ SCC_ObjRelSpdVal : 0|12@1+ (0.1,-170) [0|0] "m/s" Vector__XXX
 SG_ SCC_ObjLatPosVal : 0|9@1+ (0.1,-20) [0|0] "m" Vector__XXX
 SG_ PSM_DrvStSldFwdDis : 0|2@1+ (1,0) [0|0] "" Vector__XXX
 SG_ PSM_DrvStSldBckwdDis : 0|2@1+ (1,0) [0|0] "" Vector__XXX
 SG_ PSM_DrvStReclneFwdDis : 0|2@1+ (1,0) [0|0] "" Vector__XXX
 SG_ PSM_DrvStReclneBckwdDis : 0|2@1+ (1,0) [0|0] "" Vector__XXX
 SG_ PSM_DrvStTiltUpDis : 0|2@1+ (1,0) [0|0] "" Vector__XXX
 SG_ PSM_DrvStTiltDnDis : 0|2@1+ (1,0) [0|0] "" Vector__XXX
 SG_ PSM_DrvStHghtUpDis : 0|2@1+ (1,0) [0|0] "" Vector__XXX
 SG_ PSM_DrvStHghtDnDis : 0|2@1+ (1,0) [0|0] "" Vector__XXX
 SG_ PSM_DrvStCushExtBckwdDis : 0|2@1+ (1,0) [0|0] "" Vector__XXX
 SG_ PSM_DrvStCushExtFwdDis : 0|2@1+ (1,0) [0|0] "" Vector__XXX
 SG_ PSM_DrvStLmbrDefDis : 0|2@1+ (1,0) [0|0] "" Vector__XXX
 SG_ PSM_DrvStLmbrLoDis : 0|2@1+ (1,0) [0|0] "" Vector__XXX
 SG_ PSM_DrvStLmbrMdlDis : 0|2@1+ (1,0) [0|0] "" Vector__XXX
 SG_ PSM_DrvStLmbrUpDis : 0|2@1+ (1,0) [0|0] "" Vector__XXX
 SG_ PSM_LmbrSigSrcTyp : 0|2@1+ (1,0) [0|0] "" Vector__XXX
 SG_ ALU_GST_Byte0 : 0|8@1+ (1,0) [0|0] "" Vector__XXX
 SG_ ALU_GST_Byte1 : 0|8@1+ (1,0) [0|0] "" Vector__XXX
 SG_ ALU_GST_Byte2 : 0|8@1+ (1,0) [0|0] "" Vector__XXX
 SG_ ALU_GST_Byte3 : 0|8@1+ (1,0) [0|0] "" Vector__XXX
 SG_ ALU_GST_Byte4 : 0|8@1+ (1,0) [0|0] "" Vector__XXX
 SG_ ALU_GST_Byte5 : 0|8@1+ (1,0) [0|0] "" Vector__XXX
 SG_ ALU_GST_Byte6 : 0|8@1+ (1,0) [0|0] "" Vector__XXX
 SG_ ALU_GST_Byte7 : 0|8@1+ (1,0) [0|0] "" Vector__XXX
 SG_ PFSU_GST_Byte0 : 0|8@1+ (1,0) [0|0] "" Vector__XXX
 SG_ PFSU_GST_Byte1 : 0|8@1+ (1,0) [0|0] "" Vector__XXX
 SG_ PFSU_GST_Byte2 : 0|8@1+ (1,0) [0|0] "" Vector__XXX
 SG_ PFSU_GST_Byte3 : 0|8@1+ (1,0) [0|0] "" Vector__XXX
 SG_ PFSU_GST_Byte4 : 0|8@1+ (1,0) [0|0] "" Vector__XXX
 SG_ PFSU_GST_Byte5 : 0|8@1+ (1,0) [0|0] "" Vector__XXX
 SG_ PFSU_GST_Byte6 : 0|8@1+ (1,0) [0|0] "" Vector__XXX
 SG_ PFSU_GST_Byte7 : 0|8@1+ (1,0) [0|0] "" Vector__XXX
 SG_ PSM_DrvStEsyAcsUSMSta : 0|3@1+ (1,0) [0|0] "" Vector__XXX
 SG_ PSM_AutoHtrCtrlUSMSta : 0|2@1+ (1,0) [0|0] "" Vector__XXX
 SG_ PSM_IMSOptTyp : 0|2@1+ (1,0) [0|0] "" Vector__XXX
 SG_ Profile_IMSIDSelUSMSta : 0|3@1+ (1,0) [0|0] "" Vector__XXX
 SG_ Profile_IMSIDSelErrSta : 0|2@1+ (1,0) [0|0] "" Vector__XXX
 SG_ PSM_DrvStHtrVntTyp : 0|3@1+ (1,0) [0|0] "" Vector__XXX
 SG_ PSM_DrvStHtrVntSta : 0|4@1+ (1,0) [0|0] "" Vector__XXX
 SG_ SmrtIMS_StatureRspVal : 0|4@1+ (1,0) [0|0] "" Vector__XXX
 SG_ SmrtIMS_SeatedHghtRspVal : 0|4@1+ (1,0) [0|0] "" Vector__XXX
 SG_ SmrtIMS_WghtRspVal : 0|4@1+ (1,0) [0|0] "" Vector__XXX
 SG_ SmartIMS_DisReq : 0|3@1+ (1,0) [0|0] "" Vector__XXX
 SG_ SmrtIMS_ExitSta : 0|3@1+ (1,0) [0|0] "" Vector__XXX
 SG_ SCC_AccelReqVal : 0|11@1+ (0.01,-10.23) [0|0] "m/s^2" Vector__XXX
 SG_ SCC_AccelReqRawVal : 0|11@1+ (0.01,-10.23) [0|0] "m/s^2" Vector__XXX
 SG_ SCC_JrkUppLimVal : 0|7@1+ (0.1,0) [0|0] "m/s^3" Vector__XXX
 SG_ SCC_JrkLwrLimVal : 0|7@1+ (0.1,0) [0|0] "m/s^3" Vector__XXX
 SG_ SCC_AccelLimBandUppVal : 0|6@1+ (0.02,0) [0|0] "m/s^2" Vector__XXX
 SG_ SCC_AccelLimBandLwrVal : 0|6@1+ (0.02,0) [0|0] "m/s^2" Vector__XXX
 SG_ SCC_VehStpReq : 0|2@1+ (1,0) [0|0] "" Vector__XXX
 SG_ SCC_DclModReq : 0|2@1+ (1,0) [0|0] "" Vector__XXX
 SG_ PSB_GST_Byte0 : 0|8@1+ (1,0) [0|0] "" Vector__XXX
 SG_ PSB_GST_Byte1 : 0|8@1+ (1,0) [0|0] "" Vector__XXX
 SG_ PSB_GST_Byte2 : 0|8@1+ (1,0) [0|0] "" Vector__XXX
 SG_ PSB_GST_Byte3 : 0|8@1+ (1,0) [0|0] "" Vector__XXX
 SG_ PSB_GST_Byte4 : 0|8@1+ (1,0) [0|0] "" Vector__XXX
 SG_ PSB_GST_Byte5 : 0|8@1+ (1,0) [0|0] "" Vector__XXX
 SG_ PSB_GST_Byte6 : 0|8@1+ (1,0) [0|0] "" Vector__XXX
 SG_ PSB_GST_Byte7 : 0|8@1+ (1,0) [0|0] "" Vector__XXX
 SG_ SCC_SysFlrSta : 0|2@1+ (1,0) [0|0] "" Vector__XXX
 SG_ SCC_MainOnOffSta : 0|2@1+ (1,0) [0|0] "" Vector__XXX
 SG_ SCC_OpSta : 0|3@1+ (1,0) [0|0] "" Vector__XXX
 SG_ SCC_TakeoverReq : 0|2@1+ (1,0) [0|0] "" Vector__XXX
 SG_ SCC_InfoDis : 0|3@1+ (1,0) [0|0] "" Vector__XXX
 SG_ SCC_DrvAlrtDis : 0|2@1+ (1,0) [0|0] "" Vector__XXX
 SG_ SCC_ObjDstLvlVal : 0|8@1+ (1,0) [0|0] "" Vector__XXX
 SG_ SCC_HeadwayDstSetVal : 0|4@1+ (1,0) [0|0] "" Vector__XXX
 SG_ SCC_EquipSta : 0|2@1+ (1,0) [0|0] "" Vector__XXX
 SG_ SCC_TrgtSpdSetVal : 0|8@1+ (1,0) [0|0] "km/h or MPH" Vector__XXX
 SG_ SCC_NSCCOpSta : 0|2@1+ (1,0) [0|0] "" Vector__XXX

CM_ SG_ 3221225472 FCA_FullActvReq "FCA_FullActivateRequest";
CM_ SG_ 3221225472 FCA_SnstvtyModRetVal "FCA_SensitivityModeReturnValue ##2G##FCA - FCA12 - FCA_DrvSetState";
CM_ SG_ 3221225472 FCA_RelVel "FCA_RelativeVelocity ##2G##FCA - FCA11_FS - FCA_RelativeVelocity";
CM_ SG_ 3221225472 FCA_TimetoCllsn "FCA_TimetoCollision ##2G##FCA - FCA11_FS - FCA_TimetoCollision";
CM_ SG_ 3221225472 Nmode_FCAOff_Sta "Nmode_FCAOff_Status ##2G##FCA - FCA12 - Nmode_FCAOff_Status";
CM_ SG_ 3221225472 FCA_Jnctn_OnOffEquipSta "FCA_Junction_OnOffEquipStatus";
CM_ SG_ 3221225472 FCA_WrngTrgtDis "FCA_WarningTargetDisplay";
CM_ SG_ 3221225472 RSPA_BxHght "RSPA_BoxHeight";
CM_ SG_ 3221225472 RSPA_BxWidth "RSPA_BoxWidth";
CM_ SG_ 3221225472 RSPA_RtTrgtPosX "RSPA_RightTargetPosX";
CM_ SG_ 3221225472 RSPA_RtTrgtPosY "RSPA_RightTargetPosY";
CM_ SG_ 3221225472 RSPA_LftTrgtPosX "RSPA_LeftTargetPosX";
CM_ SG_ 3221225472 RSPA_LftTrgtPosY "RSPA_LeftTargetPosY";
CM_ SG_ 3221225472 RSPA_Sta "RSPA_Status";
CM_ SG_ 3221225472 RSPA_Actv "RSPA_Actvation";
CM_ SG_ 3221225472 RSPA_TrgtGearSta "RSPA_TargetGearStatus";
CM_ SG_ 3221225472 RSPA_EpbReq "RSPA_EPBRequest";
CM_ SG_ 3221225472 RSPA_ExtLampReq "RSPA_ExternalLampRequest";
CM_ SG_ 3221225472 RSPA_CrankingReq "RSPA_CrankingRequest";
CM_ SG_ 3221225472 RSPA_IdOutWarnReq "RSPA_IdOutWarningRequest";
CM_ SG_ 3221225472 RSPA_IndBlnkReq "RSPA_IndicatorBlinkingRequest";
CM_ SG_ 3221225472 RSPA_DccCmd "RSPA_DccelerationCommand";
CM_ SG_ 3221225472 RSPA_StopReq "RSPA_StopRequest";
CM_ SG_ 3221225472 RSPA_TrgtVehSpdVal "RSPA_TargetVehicleSpeedValue";
CM_ SG_ 3221225472 RSPA_AddtnlAccelActv "RSPA_AdditionalAccelarationActivation";
CM_ SG_ 3221225472 RSPA_Opt "RSPA_Option";
CM_ SG_ 3221225472 RSPA_TrgtTqVal "RSPA_TargetTorqueValue";
CM_ SG_ 3221225472 RSPA_DCTTrgtTqVal "RSPA_DCTTargetTorqueValue";
CM_ SG_ 3221225472 ADAS_PRK_Crc3Val "ADAS_PRK_CyclicRedundancyCheck3Value";
CM_ SG_ 3221225472 ADAS_PRK_AlvCnt3Val "ADAS_PRK_AliveCounter3Value";
CM_ SG_ 3221225472 RSPA_AvnDis "RSPA_AvnDisplay";
CM_ SG_ 3221225472 RSPA_AvnModDis "RSPA_AvnModeDisplay";
CM_ SG_ 3221225472 RSPA_AvnModNumDis "RSPA_AvnModeNumberDisplay";
CM_ SG_ 3221225472 RSPA_AvnSubViewDis "RSPA_AvnSubViewDisplay";
CM_ SG_ 3221225472 RSPA_AvnModADLDis "RSPA_AvnModeAngleDLeftDisplay";
CM_ SG_ 3221225472 RSPA_AvnModPDFLDis "RSPA_AvnModePerpenDicularFowardLeftDisplay";
CM_ SG_ 3221225472 RSPA_AvnModPLDis "RSPA_AvnModeParallelLeftDisplay";
CM_ SG_ 3221225472 RSPA_AvnModPDRLDis "RSPA_AvnModPerpenDicularRearLeftDisplay";
CM_ SG_ 3221225472 RSPA_AvnModPDRRDis "RSPA_AvnModePerpenDicularRearRightDisplay";
CM_ SG_ 3221225472 RSPA_AvnModPRDis "RSPA_AvnModeParallelRightDisplay";
CM_ SG_ 3221225472 RSPA_AvnModPDFRDis "RSPA_AvnModePerpenDicularForwardRightDisplay";
CM_ SG_ 3221225472 RSPA_AvnModADRDis "RSPA_AvnModeAngleDRightDisplay";
CM_ SG_ 3221225472 RSPA_CamDis "RSPA_CameraDisplay";
CM_ SG_ 3221225472 RSPA_AvnHmiDis "RSPA_AvnHmiDisplay";
CM_ SG_ 3221225472 PSB_Crc1Val "PSB_CyclicRedundancyCheck1Value";
CM_ SG_ 3221225472 PSB_AlvCnt1Val "PSB_AliveCounter1Value";
CM_ SG_ 3221225472 PSB_LHFlrSta "PSB_LeftHandedFailureStatus";
CM_ SG_ 3221225472 PSB_LHActvSta "PSB_LeftHandedActiveStatus";
CM_ SG_ 3221225472 PSB_RHFlrSta "PSB_RightHandedFailureStatus";
CM_ SG_ 3221225472 PSB_RHActvSta "PSB_RightHandedActiveStatus";
CM_ SG_ 3221225472 PSB_ActForAcu "PSB_ActiveForAcu";
CM_ SG_ 3221225472 PTGM_Crc1Val "PTGM_CyclicRedundancyCheck1Value";
CM_ SG_ 3221225472 PTGM_AlvCnt1Val "PTGM_AliveCounter1Value";
CM_ SG_ 3221225472 PTGM_HazardSta "PTGM_HazardStatus";
CM_ SG_ 3221225472 PTGM_ModSta "PTGM_ModuleStatus";
CM_ SG_ 3221225472 PTGM_MovSta "PTGM_MovingStatus";
CM_ SG_ 3221225472 PTGM_OptTyp "PTGM_OptionType";
CM_ SG_ 3221225472 PTGM_ReleaseRlySta "PTGM_ReleaseRelayStatus";
CM_ SG_ 3221225472 PTGM_TrnkLkSwSta "PTGM_TrunkLockSwitchStatus";
CM_ SG_ 3221225472 PTGM_UsmSetSta "PTGM_UsmSettingStatus";
CM_ SG_ 3221225472 ADAS_CMD_Crc40Val "ADAS_CMD_CyclicRedundancyCheck40Value ##2G##BCW - BCA11 - Check_Sum";
CM_ SG_ 3221225472 ADAS_CMD_AlvCnt40Val "ADAS_CMD_AliveCounter40Value ##2G##BCW - BCA11 - AliveCounter";
CM_ SG_ 3221225472 BCW_Sta "BCW_Status ##2G##BCW - BCW11 - CF_BCW_Stat";
CM_ SG_ 3221225472 BCW_OnOffEquipSta "BCW_OnOffEquipmentStatus ##2G##BCW - BCW12 - CF_BCW_USM";
CM_ SG_ 3221225472 BCW_LftIndSta "BCW_LeftIndicatorStatus ##2G##BCW - BCW11 - CF_BCW_IndLeft";
CM_ SG_ 3221225472 BCW_RtIndSta "BCW_RightIndicatorStatus ##2G##BCW - BCW11 - CF_BCW_IndRight";
CM_ SG_ 3221225472 BCW_LftSndWrngSta "BCW_LeftSoundWarningStatus ##2G##BCW - BCW11 - CF_FL_SndWan";
CM_ SG_ 3221225472 BCW_RtSndWrngSta "BCW_RightSoundWarningStatus ##2G##BCW - BCW11 - CF_FR_SndWan";
CM_ SG_ 3221225472 BCW_LftIndBriLvlVal "BCW_LeftIndicatorBrightnessLevelValue ##2G##BCW - BCW11 - CF_BCW_IndBriLeft";
CM_ SG_ 3221225472 BCW_RtIndBriLvlVal "BCW_RightIndicatorBrightnessLevelValue ##2G##BCW - BCW11 - CF_BCW_IndBriRight";
CM_ SG_ 3221225472 BCW_SnstvtyModRetVal "BCW_SensitivityModeReturnValue ##2G##BCW - BCW12 - CF_BCW_DrvSetState";
CM_ SG_ 3221225472 BCA_Sta "BCA_Status ##2G##BCW - BCA11 - CF_BCA_State";
CM_ SG_ 3221225472 BCA_OnOffEquipSta "BCA_OnOffEquipmentStatus ##2G##BCW - BCW12 - CF_BCA_USM";
CM_ SG_ 3221225472 BCA_LftWrngSta "BCA_LeftWarningStatus ##2G##BCW - BCA11 - CF_BCA_Warning";
CM_ SG_ 3221225472 BCA_RtWrngSta "BCA_RightWarningStatus ##2G##BCW - BCA11 - CF_BCA_Warning";
CM_ SG_ 3221225472 BCA_Plus_Deccel_Req "BCA_Plus_Deccel_Requirement";
CM_ SG_ 3221225472 BCA_Plus_BrkCmdSta "BCA_Plus_BrakeCommandStatus";
CM_ SG_ 3221225472 BCA_Plus_LftWrngSta "BCA_Plus_LeftWarningStatus";
CM_ SG_ 3221225472 BCA_Plus_RtWrngSta "BCA_Plus_RightWarningStatus";
CM_ SG_ 3221225472 BCA_Plus_OnOffEquipSta "BCA_Plus_OnOffEquipmentStatus";
CM_ SG_ 3221225472 BCA_Plus_FuncStat "BCA_Plus_FunctionStatus";
CM_ SG_ 3221225472 BCA_Plus_Sta "BCA_Plus_Status";
CM_ SG_ 3221225472 CLU_Crc1Val "CLU_CyclicRedundancyCheck1Value";
CM_ SG_ 3221225472 CLU_AlvCnt1Val "CLU_AliveCounter1Value";
CM_ SG_ 3221225472 CLU_PrtyBitSta "CLU_ParityBitValue";
CM_ SG_ 3221225472 CLU_PdwDisTyp "CLU_PdwDisplayType";
CM_ SG_ 3221225472 CLU_DtntOutSta "CLU_DetentOutStatus";
CM_ SG_ 3221225472 CLU_SpdUnitTyp "CLU_SpeedUnitType";
CM_ SG_ 3221225472 CLU_DisSpdDcmlVal "CLU_DisplaySpeedDecimalValue";
CM_ SG_ 3221225472 CLU_RhstaLvlSta "CLU_RheostatLevelStatus";
CM_ SG_ 3221225472 CLU_DisSpdVal "CLU_DisplaySpeedValue";
CM_ SG_ 3221225472 VCRM_CluSrvRmndrDaySta "VCRM_ClusterServiceReminderDayStatus";
CM_ SG_ 3221225472 VCRM_CluSrvRmndrDstSta "VCRM_ClusterServiceReminderDistanceStatus";
CM_ SG_ 3221225472 VCRM_CluVcAlrmVolSta "VCRM_ClusterVoiceAlarmVolumeStatus";
CM_ SG_ 3221225472 CLU_Crc3Val "CLU_CyclicRedundancyCheck3Value";
CM_ SG_ 3221225472 CLU_AlvCnt3Val "CLU_AliveCounter3Value";
CM_ SG_ 3221225472 VCRM_CluDISWrngSta "VCRM_ClusterDISWarningStatus";
CM_ SG_ 3221225472 VCRM_CluFuelConsmptnUnitSta "VCRM_ClusterFuelConsumptionUnitStatus";
CM_ SG_ 3221225472 VCRM_CluGearPosPopupSta "VCRM_ClusterGearPositionPopupStatus";
CM_ SG_ 3221225472 VCRM_CluMFSWPopupSta "VCRM_ClusterMFSWPopupStatus";
CM_ SG_ 3221225472 VCRM_CluSrvRmndrSta "VCRM_ClusterServiceReminderStatus";
CM_ SG_ 3221225472 VCRM_CluSpdmtrSta "VCRM_ClusterSpeedometerStatus";
CM_ SG_ 3221225472 VCRM_CluStrWhlAlignSta "VCRM_ClusterSteeringWheelAlignmentStatus";
CM_ SG_ 3221225472 VCRM_CluWlcmSndSta "VCRM_ClusterWelcomeSoundStatus";
CM_ SG_ 3221225472 VCRM_CluDisGrpSta "VCRM_ClusterDisplayGroupStatus";
CM_ SG_ 3221225472 VCRM_CluDisModSta "VCRM_ClusterDisplayModeStatus";
CM_ SG_ 3221225472 VCRM_CluAvgFuelCnsmptnAutoRstSta "VCRM_ClusterAverageFuelConsumptionAutoResetStatus";
CM_ SG_ 3221225472 VCRM_CluTxtSizeSta "VCRM_ClusterTextSizeStatus";
CM_ SG_ 3221225472 VCRM_CluLngSetSta "VCRM_ClusterLanguageSettingStatus";
CM_ SG_ 3221225472 CLU_DisSpdVal_KPH "CLU_DisplaySpeedValue_KPH";
CM_ SG_ 3221225472 PSM_DrvStReclnePosVal "PSM_DriverSeatReclinePositionValue";
CM_ SG_ 3221225472 PSM_DrvStSldPosVal "PSM_DriverSeatSlidePositionValue";
CM_ SG_ 3221225472 PSM_EsyAcsGetOnSta "Easy Access Get On Information";
CM_ SG_ 3221225472 PSM_EsyAcsGetOffSta "Easy Access Get Off Information";
CM_ SG_ 3221225472 PSM_EsyAcsStpSta "Easy Access Stop Information";
CM_ SG_ 3221225472 ADAS_CMD_Crc20Val "ADAS_CMD_CyclicRedundancyCheck20Value ##2G##SCC - SCC12 - CR_VSM_ChkSum";
CM_ SG_ 3221225472 ADAS_CMD_AlvCnt20Val "ADAS_CMD_AliveCounter20Value ##2G##SCC - SCC12 - CR_VSM_Alive";
CM_ SG_ 3221225472 SCC_ObjDstVal "SCC_ObjectDistanceValue ##2G##SCC - SCC11 - SCC_ObjDist";
CM_ SG_ 3221225472 SCC_ObjRelSpdVal "SCC_ObjectRelativeSpeedValue ##2G##SCC - SCC11 - SCC_ObjRelSpd";
CM_ SG_ 3221225472 SCC_ObjLatPosVal "SCC_ObjectLateralPositionValue ##2G##SCC - SCC11 - SCC_ObjLatPos";
CM_ SG_ 3221225472 PSM_DrvStSldFwdDis "PSM_DriverSlideForwardDisplay";
CM_ SG_ 3221225472 PSM_DrvStSldBckwdDis "PSM_DriverSlideBackwardSwitchDisplay";
CM_ SG_ 3221225472 PSM_DrvStReclneFwdDis "PSM_DriverSeatReclineForwardSwitchDisplay";
CM_ SG_ 3221225472 PSM_DrvStReclneBckwdDis "PSM_DriverSeatReclineBackwardSwitchDisplay";
CM_ SG_ 3221225472 PSM_DrvStTiltUpDis "PSM_DriverTiltUpSwitchDisplay";
CM_ SG_ 3221225472 PSM_DrvStTiltDnDis "PSM_DriverTiltDownSwitchDisplay";
CM_ SG_ 3221225472 PSM_DrvStHghtUpDis "PSM_DriverHeightUpSwitchDisplay";
CM_ SG_ 3221225472 PSM_DrvStHghtDnDis "PSM_DriverHeightDownSwitchDisplay";
CM_ SG_ 3221225472 PSM_DrvStCushExtBckwdDis "PSM_DriverCushionExtendedBackwardSwitchDisplay";
CM_ SG_ 3221225472 PSM_DrvStCushExtFwdDis "PSM_DriverCushionExtendedForwardSwitchDisplay";
CM_ SG_ 3221225472 PSM_DrvStLmbrDefDis "PSM_DriverLumbarDeFlateSwitchDisplay";
CM_ SG_ 3221225472 PSM_DrvStLmbrLoDis "PSM_DriverLumbarLowSwitchDisplay";
CM_ SG_ 3221225472 PSM_DrvStLmbrMdlDis "PSM_DriverLumbarMiddleSwitchDisplay";
CM_ SG_ 3221225472 PSM_DrvStLmbrUpDis "PSM_DriverLumbarUpSwitchDisplay";
CM_ SG_ 3221225472 PSM_LmbrSigSrcTyp "Lumbar Switch Signal Source(TX)";
CM_ SG_ 3221225472 PSM_DrvStEsyAcsUSMSta "USM_MovingValue";
CM_ SG_ 3221225472 PSM_AutoHtrCtrlUSMSta "Auto Down Seat Heater (USM Setting)";
CM_ SG_ 3221225472 PSM_IMSOptTyp "Option flag for IMS system";
CM_ SG_ 3221225472 Profile_IMSIDSelUSMSta "This signal indicates IMS ID that is paired with Currently detected ProfileID by IAU";
CM_ SG_ 3221225472 Profile_IMSIDSelErrSta "This signal indicates IMS ID selection Error if User tries to select the IMS ID that is already occupied by Other Profile ID.";
CM_ SG_ 3221225472 PSM_DrvStHtrVntTyp "Seat heat/vent option information for remote seat heat/vent control(drive seat)";
CM_ SG_ 3221225472 PSM_DrvStHtrVntSta "Current seat operation state information for remote seat heat/vent control (drive seat)";
CM_ SG_ 3221225472 SmrtIMS_StatureRspVal "HCIMS_HeightRsponseValue";
CM_ SG_ 3221225472 SmrtIMS_SeatedHghtRspVal "HCIMS_SitHeightRsponseValue";
CM_ SG_ 3221225472 SmrtIMS_WghtRspVal "HCIMS_WeightRsponseValue";
CM_ SG_ 3221225472 SmartIMS_DisReq "PSM_MoveStatusDisplay";
CM_ SG_ 3221225472 SmrtIMS_ExitSta "Smart IMS exit condition";
CM_ SG_ 3221225472 SCC_AccelReqVal "SCC_AccelerationRequestValue ##2G##SCC - SCC12 - aReqValue";
CM_ SG_ 3221225472 SCC_AccelReqRawVal "SCC_AccelerationRequestRawValue ##2G##SCC - SCC12 - aReqRaw";
CM_ SG_ 3221225472 SCC_JrkUppLimVal "SCC_JerkUpperLimitValue ##2G##SCC - SCC14 - JerkUpperLimit";
CM_ SG_ 3221225472 SCC_JrkLwrLimVal "SCC_JerkLowerLimitValue ##2G##SCC - SCC14 - JerkLowerLimit";
CM_ SG_ 3221225472 SCC_AccelLimBandUppVal "SCC_AccelerationLimitBandUpperValue ##2G##SCC - SCC14 - ComfortBandUpper";
CM_ SG_ 3221225472 SCC_AccelLimBandLwrVal "SCC_AccelerationLimitBandLowerValue ##2G##SCC - SCC14 - ComfortBandLower";
CM_ SG_ 3221225472 SCC_VehStpReq "SCC_VehicleStopRequest ##2G##SCC - SCC12 - StopReq";
CM_ SG_ 3221225472 SCC_DclModReq "SCC_DecelerationModeRequest";
CM_ SG_ 3221225472 SCC_SysFlrSta "SCC_SystemFailureStatus ##2G##SCC - SCC12 - SCCFailInfo";
CM_ SG_ 3221225472 SCC_MainOnOffSta "SCC_MainOnOffStatus ##2G##SCC - SCC11 - MainMode_SCC";
CM_ SG_ 3221225472 SCC_OpSta "SCC_OperatingStatus ##2G##SCC - SCC14 - SCCMode2";
CM_ SG_ 3221225472 SCC_TakeoverReq "SCC_TakeoverRequest ##2G##SCC - SCC12 - TakeOverReq";
CM_ SG_ 3221225472 SCC_InfoDis "SCC_InformationDisplay ##2G##SCC - SCC11 - SCCInfoDisplay";
CM_ SG_ 3221225472 SCC_DrvAlrtDis "SCC_DriverAlertDisplay ##2G##SCC - SCC11 - DriverAlertDisplay";
CM_ SG_ 3221225472 SCC_ObjDstLvlVal "SCC_ObjectDistanceLevelValue ##2G##SCC - SCC14 - ObjGap";
CM_ SG_ 3221225472 SCC_HeadwayDstSetVal "SCC_HeadwayDistanceSettingValue ##2G##SCC - SCC11 - TauGapSet";
CM_ SG_ 3221225472 SCC_EquipSta "SCC_EquipmentStatus ##2G##SCC - SCC13 - SCC_Equip";
CM_ SG_ 3221225472 SCC_TrgtSpdSetVal "SCC_TargetSpeedSettingValue ##2G##SCC - SCC11 - VSetDis";
CM_ SG_ 3221225472 SCC_NSCCOpSta "SCC_NSCCOperatingStatus ##2G##SCC - SCC11 - NSCC_Camera_Act";
BA_DEF_ BO_  "UsrMsgIDSforwardDeviation" INT 0 100;
BA_DEF_ BO_  "UsrMsgIDSbackwardDeviation" INT 50 1000;
BA_DEF_ BO_  "GenMsgCycleTime" INT 0 2000;
BA_DEF_ BO_  "GenMsgStartDelayTime" INT 0 2000;
BA_DEF_ BO_  "GenMsgSendType" ENUM  "Cyclic ","NotUsed ","NotUsed ","NotUsed ","NotUsed ","NotUsed ","NotUsed ","IfActive ","NoMsgSendType ","NotUsed","vector_leerstring";
BA_DEF_ BO_  "GenMsgCycleTimeFast" INT 0 500;
BA_DEF_ BO_  "GenMsgILSupport" ENUM  "No","Yes";
BA_DEF_ BO_  "GenMsgNrOfRepetition" INT 0 3;
BA_DEF_ BO_  "VFrameFormat" ENUM  "StandardCAN","ExtendedCAN","reserved","reserved","reserved","reserved","reserved","reserved","reserved","reserved","reserved","reserved","reserved","reserved","StandardCAN_FD","ExtendedCAN_FD";
BA_DEF_ SG_  "UserSigValidity" ENUM  "B+","ACC","IG","IG1","IG2","IG3","IG1 or IG2","IG1 or IG3","Undef";
BA_DEF_ SG_  "GenSigTimeoutTime" INT 0 7000;
BA_DEF_ SG_  "UsrSigTimeoutValue" STRING ;
BA_DEF_ SG_  "UsrSigPurpose" ENUM  "Undef","FN","DIAG","DEV","NM";
BA_DEF_ SG_  "GenSigStartValue" INT 0 1215752192;
BA_DEF_ SG_  "NetworkRequest" ENUM  "Yes","No";
BA_DEF_ SG_  "NetworkRequestHoldingTime" INT 0 65535;
BA_DEF_ SG_  "Description" STRING ;
BA_DEF_ SG_  "Version" STRING ;
BA_DEF_ SG_  "GenSigEnvVarType" ENUM  "Int","Float","Undef";
BA_DEF_ SG_  "GenSigSendType" ENUM  "Cyclic			","OnWrite			","OnWriteWithRepetition			","OnChange			","OnChangeWithRepetition			","IfActive			","IfActiveWithRepetition			","NoSigSendType			","OnChangeAndIfActive			","OnChangeAndIfActiveWithRepetition";
BA_DEF_ SG_  "GwSigLatencyTime" INT 0 65536;
BA_DEF_ SG_  "GwSigMissingSourceType" ENUM  "Undef","OldValue","DefaultValue","InitialValue";
BA_DEF_ SG_  "NWM-WakeupAllowed" ENUM  "<n.a.>";
BA_DEF_ SG_  "RoutingFactor" INT 1 1215752192;
BA_DEF_DEF_  "UsrMsgIDSforwardDeviation" 10;
BA_DEF_DEF_  "UsrMsgIDSbackwardDeviation" 100;
BA_DEF_DEF_  "GenMsgCycleTime" 200;
BA_DEF_DEF_  "GenMsgStartDelayTime" 0;
BA_DEF_DEF_  "GenMsgSendType" "NoMsgSendType ";
BA_DEF_DEF_  "GenMsgCycleTimeFast" 40;
BA_DEF_DEF_  "GenMsgILSupport" "Yes";
BA_DEF_DEF_  "GenMsgNrOfRepetition" 3;
BA_DEF_DEF_  "VFrameFormat" "StandardCAN";
BA_DEF_DEF_  "UserSigValidity" "IG";
BA_DEF_DEF_  "GenSigTimeoutTime" 500;
BA_DEF_DEF_  "UsrSigTimeoutValue" "Undef";
BA_DEF_DEF_  "UsrSigPurpose" "FN";
BA_DEF_DEF_  "GenSigStartValue" 0;
BA_DEF_DEF_  "NetworkRequest" "No";
BA_DEF_DEF_  "NetworkRequestHoldingTime" 0;
BA_DEF_DEF_  "Description" "";
BA_DEF_DEF_  "Version" "";
BA_DEF_DEF_  "GenSigEnvVarType" "Undef";
BA_DEF_DEF_  "GenSigSendType" "NoSigSendType			";
BA_DEF_DEF_  "GwSigLatencyTime" 40;
BA_DEF_DEF_  "GwSigMissingSourceType" "Undef";
BA_DEF_DEF_  "NWM-WakeupAllowed" "<n.a.>";
BA_DEF_DEF_  "RoutingFactor" 1;
BA_ "Description" SG_ 3221225472 FCA_FullActvReq "A control requeset flag for FCA third warning. (Full braking)

- FCA 3차 제동상황 요청신호";
BA_ "UserSigValidity" SG_ 3221225472 FCA_FullActvReq 3;
BA_ "GenSigTimeoutTime" SG_ 3221225472 FCA_FullActvReq 1500;
BA_ "RoutingFactor" SG_ 3221225472 FCA_FullActvReq 5;
BA_ "Version" SG_ 3221225472 FCA_FullActvReq "17.11.00";
BA_ "Description" SG_ 3221225472 FCA_SnstvtyModRetVal "This signal is FCA sensitive set mode switch(USM) info return value to cluster.

- FCA 민감도 설정 관련 USM 설정 스위치 정보의 리턴 값";
BA_ "UserSigValidity" SG_ 3221225472 FCA_SnstvtyModRetVal 3;
BA_ "GenSigTimeoutTime" SG_ 3221225472 FCA_SnstvtyModRetVal 1500;
BA_ "RoutingFactor" SG_ 3221225472 FCA_SnstvtyModRetVal 5;
BA_ "Version" SG_ 3221225472 FCA_SnstvtyModRetVal "17.12.00";
BA_ "Description" SG_ 3221225472 FCA_RelVel "This signal indicates the relative velocity between the host vehicle and a forward vehicle.







(PH) = ((HEX)-0FFH)*0.1 [m/s/digit]



       = (HEX)*0.1 [m/s/digit] - 25.5 [m/s]



CAN Message Physical range : Max. Relative velocity : 0x1FE(25.5m/s),";
BA_ "UserSigValidity" SG_ 3221225472 FCA_RelVel 3;
BA_ "GenSigTimeoutTime" SG_ 3221225472 FCA_RelVel 1500;
BA_ "RoutingFactor" SG_ 3221225472 FCA_RelVel 5;
BA_ "Version" SG_ 3221225472 FCA_RelVel "17.12.00";
BA_ "Description" SG_ 3221225472 FCA_TimetoCllsn "This signal indicates predictive time to Collision between the host vehicle and a forward vehicle.







(PH) = 10*(HEX) [ms]



CAN Message Physical range : 0 ~ 2540 [ms], Resolution : 10ms";
BA_ "UserSigValidity" SG_ 3221225472 FCA_TimetoCllsn 3;
BA_ "GenSigTimeoutTime" SG_ 3221225472 FCA_TimetoCllsn 1500;
BA_ "RoutingFactor" SG_ 3221225472 FCA_TimetoCllsn 5;
BA_ "Version" SG_ 3221225472 FCA_TimetoCllsn "17.12.00";
BA_ "Description" SG_ 3221225472 Nmode_FCAOff_Sta "This signal describes status of FCA off when Nmode on";
BA_ "UserSigValidity" SG_ 3221225472 Nmode_FCAOff_Sta 3;
BA_ "GenSigTimeoutTime" SG_ 3221225472 Nmode_FCAOff_Sta 1500;
BA_ "RoutingFactor" SG_ 3221225472 Nmode_FCAOff_Sta 5;
BA_ "Version" SG_ 3221225472 Nmode_FCAOff_Sta "17.12.00";
BA_ "Description" SG_ 3221225472 FCA_Jnctn_OnOffEquipSta "This signal describes the FCA-JC Function.

- 시스템 장착 여부 및 시스템 on/off 정보";
BA_ "UserSigValidity" SG_ 3221225472 FCA_Jnctn_OnOffEquipSta 3;
BA_ "GenSigTimeoutTime" SG_ 3221225472 FCA_Jnctn_OnOffEquipSta 1500;
BA_ "RoutingFactor" SG_ 3221225472 FCA_Jnctn_OnOffEquipSta 5;
BA_ "Version" SG_ 3221225472 FCA_Jnctn_OnOffEquipSta "17.11.00";
BA_ "Description" SG_ 3221225472 FCA_WrngTrgtDis "Request CLU to activate the corresponding warning device(s) according to the type of FCA warning target.

- FCA 경고 대상 종류별 표시 정보신호";
BA_ "UserSigValidity" SG_ 3221225472 FCA_WrngTrgtDis 3;
BA_ "GenSigTimeoutTime" SG_ 3221225472 FCA_WrngTrgtDis 1500;
BA_ "RoutingFactor" SG_ 3221225472 FCA_WrngTrgtDis 5;
BA_ "Version" SG_ 3221225472 FCA_WrngTrgtDis "17.12.03";
BA_ "UsrSigPurpose" SG_ 3221225472 IAU_GST_Byte0 2;
BA_ "GenSigSendType" SG_ 3221225472 IAU_GST_Byte0 2;
BA_ "UserSigValidity" SG_ 3221225472 IAU_GST_Byte0 0;
BA_ "GenSigTimeoutTime" SG_ 3221225472 IAU_GST_Byte0 0;
BA_ "NetworkRequest" SG_ 3221225472 IAU_GST_Byte0 0;
BA_ "NetworkRequestHoldingTime" SG_ 3221225472 IAU_GST_Byte0 5000;
BA_ "Version" SG_ 3221225472 IAU_GST_Byte0 "18.01.09";
BA_ "UsrSigPurpose" SG_ 3221225472 IAU_GST_Byte1 2;
BA_ "GenSigSendType" SG_ 3221225472 IAU_GST_Byte1 2;
BA_ "UserSigValidity" SG_ 3221225472 IAU_GST_Byte1 0;
BA_ "GenSigTimeoutTime" SG_ 3221225472 IAU_GST_Byte1 0;
BA_ "NetworkRequest" SG_ 3221225472 IAU_GST_Byte1 0;
BA_ "NetworkRequestHoldingTime" SG_ 3221225472 IAU_GST_Byte1 5000;
BA_ "Version" SG_ 3221225472 IAU_GST_Byte1 "18.01.09";
BA_ "UsrSigPurpose" SG_ 3221225472 IAU_GST_Byte2 2;
BA_ "GenSigSendType" SG_ 3221225472 IAU_GST_Byte2 2;
BA_ "UserSigValidity" SG_ 3221225472 IAU_GST_Byte2 0;
BA_ "GenSigTimeoutTime" SG_ 3221225472 IAU_GST_Byte2 0;
BA_ "NetworkRequest" SG_ 3221225472 IAU_GST_Byte2 0;
BA_ "NetworkRequestHoldingTime" SG_ 3221225472 IAU_GST_Byte2 5000;
BA_ "Version" SG_ 3221225472 IAU_GST_Byte2 "18.01.09";
BA_ "UsrSigPurpose" SG_ 3221225472 IAU_GST_Byte3 2;
BA_ "GenSigSendType" SG_ 3221225472 IAU_GST_Byte3 2;
BA_ "UserSigValidity" SG_ 3221225472 IAU_GST_Byte3 0;
BA_ "GenSigTimeoutTime" SG_ 3221225472 IAU_GST_Byte3 0;
BA_ "NetworkRequest" SG_ 3221225472 IAU_GST_Byte3 0;
BA_ "NetworkRequestHoldingTime" SG_ 3221225472 IAU_GST_Byte3 5000;
BA_ "Version" SG_ 3221225472 IAU_GST_Byte3 "18.01.09";
BA_ "UsrSigPurpose" SG_ 3221225472 IAU_GST_Byte4 2;
BA_ "GenSigSendType" SG_ 3221225472 IAU_GST_Byte4 2;
BA_ "UserSigValidity" SG_ 3221225472 IAU_GST_Byte4 0;
BA_ "GenSigTimeoutTime" SG_ 3221225472 IAU_GST_Byte4 0;
BA_ "NetworkRequest" SG_ 3221225472 IAU_GST_Byte4 0;
BA_ "NetworkRequestHoldingTime" SG_ 3221225472 IAU_GST_Byte4 5000;
BA_ "Version" SG_ 3221225472 IAU_GST_Byte4 "18.01.09";
BA_ "UsrSigPurpose" SG_ 3221225472 IAU_GST_Byte5 2;
BA_ "GenSigSendType" SG_ 3221225472 IAU_GST_Byte5 2;
BA_ "UserSigValidity" SG_ 3221225472 IAU_GST_Byte5 0;
BA_ "GenSigTimeoutTime" SG_ 3221225472 IAU_GST_Byte5 0;
BA_ "NetworkRequest" SG_ 3221225472 IAU_GST_Byte5 0;
BA_ "NetworkRequestHoldingTime" SG_ 3221225472 IAU_GST_Byte5 5000;
BA_ "Version" SG_ 3221225472 IAU_GST_Byte5 "18.01.09";
BA_ "UsrSigPurpose" SG_ 3221225472 IAU_GST_Byte6 2;
BA_ "GenSigSendType" SG_ 3221225472 IAU_GST_Byte6 2;
BA_ "UserSigValidity" SG_ 3221225472 IAU_GST_Byte6 0;
BA_ "GenSigTimeoutTime" SG_ 3221225472 IAU_GST_Byte6 0;
BA_ "NetworkRequest" SG_ 3221225472 IAU_GST_Byte6 0;
BA_ "NetworkRequestHoldingTime" SG_ 3221225472 IAU_GST_Byte6 5000;
BA_ "Version" SG_ 3221225472 IAU_GST_Byte6 "18.01.09";
BA_ "UsrSigPurpose" SG_ 3221225472 IAU_GST_Byte7 2;
BA_ "GenSigSendType" SG_ 3221225472 IAU_GST_Byte7 2;
BA_ "UserSigValidity" SG_ 3221225472 IAU_GST_Byte7 0;
BA_ "GenSigTimeoutTime" SG_ 3221225472 IAU_GST_Byte7 0;
BA_ "NetworkRequest" SG_ 3221225472 IAU_GST_Byte7 0;
BA_ "NetworkRequestHoldingTime" SG_ 3221225472 IAU_GST_Byte7 5000;
BA_ "Version" SG_ 3221225472 IAU_GST_Byte7 "18.01.09";
BA_ "Description" SG_ 3221225472 RSPA_BxHght "AVM 표시 목표주차공간 높이";
BA_ "UserSigValidity" SG_ 3221225472 RSPA_BxHght 3;
BA_ "GenSigTimeoutTime" SG_ 3221225472 RSPA_BxHght 1500;
BA_ "RoutingFactor" SG_ 3221225472 RSPA_BxHght 5;
BA_ "Version" SG_ 3221225472 RSPA_BxHght "17.11.00";
BA_ "Description" SG_ 3221225472 RSPA_BxWidth "AVM 표시 목표주차공간 너비";
BA_ "UserSigValidity" SG_ 3221225472 RSPA_BxWidth 3;
BA_ "GenSigTimeoutTime" SG_ 3221225472 RSPA_BxWidth 1500;
BA_ "RoutingFactor" SG_ 3221225472 RSPA_BxWidth 5;
BA_ "Version" SG_ 3221225472 RSPA_BxWidth "17.11.00";
BA_ "Description" SG_ 3221225472 RSPA_RtTrgtPosX "AVM 표시 오른쪽 주차공간 위치 X 좌표";
BA_ "UserSigValidity" SG_ 3221225472 RSPA_RtTrgtPosX 3;
BA_ "GenSigTimeoutTime" SG_ 3221225472 RSPA_RtTrgtPosX 1500;
BA_ "RoutingFactor" SG_ 3221225472 RSPA_RtTrgtPosX 5;
BA_ "Version" SG_ 3221225472 RSPA_RtTrgtPosX "17.12.03";
BA_ "Description" SG_ 3221225472 RSPA_RtTrgtPosY "AVM 표시 오른쪽 주차공간 위치 Y 좌표";
BA_ "UserSigValidity" SG_ 3221225472 RSPA_RtTrgtPosY 3;
BA_ "GenSigTimeoutTime" SG_ 3221225472 RSPA_RtTrgtPosY 1500;
BA_ "RoutingFactor" SG_ 3221225472 RSPA_RtTrgtPosY 5;
BA_ "Version" SG_ 3221225472 RSPA_RtTrgtPosY "17.12.03";
BA_ "Description" SG_ 3221225472 RSPA_LftTrgtPosX "AVM 표시 왼쪽 주차공간 위치 X 좌표";
BA_ "UserSigValidity" SG_ 3221225472 RSPA_LftTrgtPosX 3;
BA_ "GenSigTimeoutTime" SG_ 3221225472 RSPA_LftTrgtPosX 1500;
BA_ "RoutingFactor" SG_ 3221225472 RSPA_LftTrgtPosX 5;
BA_ "Version" SG_ 3221225472 RSPA_LftTrgtPosX "17.12.03";
BA_ "Description" SG_ 3221225472 RSPA_LftTrgtPosY "AVM 표시 왼쪽 주차공간 위치 Y 좌표";
BA_ "UserSigValidity" SG_ 3221225472 RSPA_LftTrgtPosY 3;
BA_ "GenSigTimeoutTime" SG_ 3221225472 RSPA_LftTrgtPosY 1500;
BA_ "RoutingFactor" SG_ 3221225472 RSPA_LftTrgtPosY 5;
BA_ "Version" SG_ 3221225472 RSPA_LftTrgtPosY "17.12.03";
BA_ "Description" SG_ 3221225472 RSPA_Sta "현재 RSPA의 상태";
BA_ "GenSigStartValue" SG_ 3221225472 RSPA_Sta 1;
BA_ "UserSigValidity" SG_ 3221225472 RSPA_Sta 3;
BA_ "GenSigTimeoutTime" SG_ 3221225472 RSPA_Sta 1500;
BA_ "RoutingFactor" SG_ 3221225472 RSPA_Sta 5;
BA_ "Version" SG_ 3221225472 RSPA_Sta "17.11.00";
BA_ "Description" SG_ 3221225472 RSPA_Actv "RSPA's activation information";
BA_ "UserSigValidity" SG_ 3221225472 RSPA_Actv 3;
BA_ "GenSigTimeoutTime" SG_ 3221225472 RSPA_Actv 1500;
BA_ "RoutingFactor" SG_ 3221225472 RSPA_Actv 5;
BA_ "Version" SG_ 3221225472 RSPA_Actv "17.11.00";
BA_ "UsrSigPurpose" SG_ 3221225472 GST_RRHVU_Byte0 2;
BA_ "GenSigSendType" SG_ 3221225472 GST_RRHVU_Byte0 2;
BA_ "UserSigValidity" SG_ 3221225472 GST_RRHVU_Byte0 0;
BA_ "GenSigTimeoutTime" SG_ 3221225472 GST_RRHVU_Byte0 0;
BA_ "NetworkRequest" SG_ 3221225472 GST_RRHVU_Byte0 0;
BA_ "NetworkRequestHoldingTime" SG_ 3221225472 GST_RRHVU_Byte0 5000;
BA_ "Version" SG_ 3221225472 GST_RRHVU_Byte0 "18.03.03";
BA_ "UsrSigPurpose" SG_ 3221225472 GST_RRHVU_Byte1 2;
BA_ "GenSigSendType" SG_ 3221225472 GST_RRHVU_Byte1 2;
BA_ "UserSigValidity" SG_ 3221225472 GST_RRHVU_Byte1 0;
BA_ "GenSigTimeoutTime" SG_ 3221225472 GST_RRHVU_Byte1 0;
BA_ "NetworkRequest" SG_ 3221225472 GST_RRHVU_Byte1 0;
BA_ "NetworkRequestHoldingTime" SG_ 3221225472 GST_RRHVU_Byte1 5000;
BA_ "Version" SG_ 3221225472 GST_RRHVU_Byte1 "18.03.03";
BA_ "UsrSigPurpose" SG_ 3221225472 GST_RRHVU_Byte2 2;
BA_ "GenSigSendType" SG_ 3221225472 GST_RRHVU_Byte2 2;
BA_ "UserSigValidity" SG_ 3221225472 GST_RRHVU_Byte2 0;
BA_ "GenSigTimeoutTime" SG_ 3221225472 GST_RRHVU_Byte2 0;
BA_ "NetworkRequest" SG_ 3221225472 GST_RRHVU_Byte2 0;
BA_ "NetworkRequestHoldingTime" SG_ 3221225472 GST_RRHVU_Byte2 5000;
BA_ "Version" SG_ 3221225472 GST_RRHVU_Byte2 "18.03.03";
BA_ "UsrSigPurpose" SG_ 3221225472 GST_RRHVU_Byte3 2;
BA_ "GenSigSendType" SG_ 3221225472 GST_RRHVU_Byte3 2;
BA_ "UserSigValidity" SG_ 3221225472 GST_RRHVU_Byte3 0;
BA_ "GenSigTimeoutTime" SG_ 3221225472 GST_RRHVU_Byte3 0;
BA_ "NetworkRequest" SG_ 3221225472 GST_RRHVU_Byte3 0;
BA_ "NetworkRequestHoldingTime" SG_ 3221225472 GST_RRHVU_Byte3 5000;
BA_ "Version" SG_ 3221225472 GST_RRHVU_Byte3 "18.03.03";
BA_ "UsrSigPurpose" SG_ 3221225472 GST_RRHVU_Byte4 2;
BA_ "GenSigSendType" SG_ 3221225472 GST_RRHVU_Byte4 2;
BA_ "UserSigValidity" SG_ 3221225472 GST_RRHVU_Byte4 0;
BA_ "GenSigTimeoutTime" SG_ 3221225472 GST_RRHVU_Byte4 0;
BA_ "NetworkRequest" SG_ 3221225472 GST_RRHVU_Byte4 0;
BA_ "NetworkRequestHoldingTime" SG_ 3221225472 GST_RRHVU_Byte4 5000;
BA_ "Version" SG_ 3221225472 GST_RRHVU_Byte4 "18.03.03";
BA_ "UsrSigPurpose" SG_ 3221225472 GST_RRHVU_Byte5 2;
BA_ "GenSigSendType" SG_ 3221225472 GST_RRHVU_Byte5 2;
BA_ "UserSigValidity" SG_ 3221225472 GST_RRHVU_Byte5 0;
BA_ "GenSigTimeoutTime" SG_ 3221225472 GST_RRHVU_Byte5 0;
BA_ "NetworkRequest" SG_ 3221225472 GST_RRHVU_Byte5 0;
BA_ "NetworkRequestHoldingTime" SG_ 3221225472 GST_RRHVU_Byte5 5000;
BA_ "Version" SG_ 3221225472 GST_RRHVU_Byte5 "18.03.03";
BA_ "UsrSigPurpose" SG_ 3221225472 GST_RRHVU_Byte6 2;
BA_ "GenSigSendType" SG_ 3221225472 GST_RRHVU_Byte6 2;
BA_ "UserSigValidity" SG_ 3221225472 GST_RRHVU_Byte6 0;
BA_ "GenSigTimeoutTime" SG_ 3221225472 GST_RRHVU_Byte6 0;
BA_ "NetworkRequest" SG_ 3221225472 GST_RRHVU_Byte6 0;
BA_ "NetworkRequestHoldingTime" SG_ 3221225472 GST_RRHVU_Byte6 5000;
BA_ "Version" SG_ 3221225472 GST_RRHVU_Byte6 "18.03.03";
BA_ "UsrSigPurpose" SG_ 3221225472 GST_RRHVU_Byte7 2;
BA_ "GenSigSendType" SG_ 3221225472 GST_RRHVU_Byte7 2;
BA_ "UserSigValidity" SG_ 3221225472 GST_RRHVU_Byte7 0;
BA_ "GenSigTimeoutTime" SG_ 3221225472 GST_RRHVU_Byte7 0;
BA_ "NetworkRequest" SG_ 3221225472 GST_RRHVU_Byte7 0;
BA_ "NetworkRequestHoldingTime" SG_ 3221225472 GST_RRHVU_Byte7 5000;
BA_ "Version" SG_ 3221225472 GST_RRHVU_Byte7 "18.03.03";
BA_ "Description" SG_ 3221225472 RSPA_TrgtGearSta "목표 변속단 

(목표 변속단 100ms 유지후 Idle 값 송출, 목표값 rising 이후 500ms 대기)";
BA_ "UserSigValidity" SG_ 3221225472 RSPA_TrgtGearSta 3;
BA_ "GenSigTimeoutTime" SG_ 3221225472 RSPA_TrgtGearSta 1500;
BA_ "RoutingFactor" SG_ 3221225472 RSPA_TrgtGearSta 5;
BA_ "Version" SG_ 3221225472 RSPA_TrgtGearSta "17.11.00";
BA_ "Description" SG_ 3221225472 RSPA_EpbReq "EPB 체결/해제 요청 (AHB 우회)";
BA_ "UserSigValidity" SG_ 3221225472 RSPA_EpbReq 3;
BA_ "GenSigTimeoutTime" SG_ 3221225472 RSPA_EpbReq 1500;
BA_ "RoutingFactor" SG_ 3221225472 RSPA_EpbReq 5;
BA_ "Version" SG_ 3221225472 RSPA_EpbReq "17.11.00";
BA_ "Description" SG_ 3221225472 RSPA_ExtLampReq "전조등, 방향지시등 동작 요청 (RSPA 용)

Type1:비상등 1회 Normal Blinking

Type2:비상등 2회 Normal Blinking

Type3:비상등 3회 Normal Blinking

Type4:비상등 지속적으로 Normal Blinking";
BA_ "UserSigValidity" SG_ 3221225472 RSPA_ExtLampReq 3;
BA_ "GenSigTimeoutTime" SG_ 3221225472 RSPA_ExtLampReq 1500;
BA_ "RoutingFactor" SG_ 3221225472 RSPA_ExtLampReq 5;
BA_ "Version" SG_ 3221225472 RSPA_ExtLampReq "17.11.00";
BA_ "Description" SG_ 3221225472 RSPA_CrankingReq "시동모드 천이 요청 (RSPA 용)";
BA_ "UserSigValidity" SG_ 3221225472 RSPA_CrankingReq 3;
BA_ "GenSigTimeoutTime" SG_ 3221225472 RSPA_CrankingReq 1500;
BA_ "RoutingFactor" SG_ 3221225472 RSPA_CrankingReq 5;
BA_ "Version" SG_ 3221225472 RSPA_CrankingReq "17.11.00";
BA_ "Description" SG_ 3221225472 RSPA_IdOutWarnReq "ID out 패턴 변경 요청 (RSPA 용)";
BA_ "UserSigValidity" SG_ 3221225472 RSPA_IdOutWarnReq 3;
BA_ "GenSigTimeoutTime" SG_ 3221225472 RSPA_IdOutWarnReq 1500;
BA_ "RoutingFactor" SG_ 3221225472 RSPA_IdOutWarnReq 5;
BA_ "Version" SG_ 3221225472 RSPA_IdOutWarnReq "17.11.00";
BA_ "Description" SG_ 3221225472 RSPA_IndBlnkReq "FOB blinking request during RSPA mode";
BA_ "UserSigValidity" SG_ 3221225472 RSPA_IndBlnkReq 3;
BA_ "GenSigTimeoutTime" SG_ 3221225472 RSPA_IndBlnkReq 1500;
BA_ "RoutingFactor" SG_ 3221225472 RSPA_IndBlnkReq 5;
BA_ "Version" SG_ 3221225472 RSPA_IndBlnkReq "17.11.00";
BA_ "Description" SG_ 3221225472 RSPA_DccCmd "목표 감속도, 차량 정차 시에만(when RSPA_VS=0) 감속도 제어목적";
BA_ "UserSigValidity" SG_ 3221225472 RSPA_DccCmd 3;
BA_ "GenSigTimeoutTime" SG_ 3221225472 RSPA_DccCmd 1500;
BA_ "RoutingFactor" SG_ 3221225472 RSPA_DccCmd 5;
BA_ "Version" SG_ 3221225472 RSPA_DccCmd "17.11.00";
BA_ "Description" SG_ 3221225472 RSPA_StopReq "A control request flag for vehicle stop. RSPA expects vehicle to be controlled to a complete stop and hold its state.";
BA_ "UserSigValidity" SG_ 3221225472 RSPA_StopReq 3;
BA_ "GenSigTimeoutTime" SG_ 3221225472 RSPA_StopReq 1500;
BA_ "RoutingFactor" SG_ 3221225472 RSPA_StopReq 5;
BA_ "Version" SG_ 3221225472 RSPA_StopReq "17.11.00";
BA_ "Description" SG_ 3221225472 RSPA_TrgtVehSpdVal "차속 요청값, 차속 프로파일 전송 (0 … 10.23)";
BA_ "UserSigValidity" SG_ 3221225472 RSPA_TrgtVehSpdVal 3;
BA_ "GenSigTimeoutTime" SG_ 3221225472 RSPA_TrgtVehSpdVal 1500;
BA_ "RoutingFactor" SG_ 3221225472 RSPA_TrgtVehSpdVal 5;
BA_ "Version" SG_ 3221225472 RSPA_TrgtVehSpdVal "17.11.00";
BA_ "Description" SG_ 3221225472 RSPA_AddtnlAccelActv "RSPA additional acceleration control ON";
BA_ "UserSigValidity" SG_ 3221225472 RSPA_AddtnlAccelActv 3;
BA_ "GenSigTimeoutTime" SG_ 3221225472 RSPA_AddtnlAccelActv 1500;
BA_ "RoutingFactor" SG_ 3221225472 RSPA_AddtnlAccelActv 5;
BA_ "Version" SG_ 3221225472 RSPA_AddtnlAccelActv "17.11.00";
BA_ "Description" SG_ 3221225472 RSPA_Opt "RSPA Option applied information";
BA_ "UserSigValidity" SG_ 3221225472 RSPA_Opt 3;
BA_ "GenSigTimeoutTime" SG_ 3221225472 RSPA_Opt 1500;
BA_ "RoutingFactor" SG_ 3221225472 RSPA_Opt 5;
BA_ "Version" SG_ 3221225472 RSPA_Opt "17.12.03";
BA_ "Description" SG_ 3221225472 RSPA_TrgtTqVal "RSAP request torque value (Nm)

Init value : 00h

If MSB is 1, this signal is - value.

else, this signal is +value.

0~10bit is used for absolute value.";
BA_ "UserSigValidity" SG_ 3221225472 RSPA_TrgtTqVal 3;
BA_ "GenSigTimeoutTime" SG_ 3221225472 RSPA_TrgtTqVal 1500;
BA_ "RoutingFactor" SG_ 3221225472 RSPA_TrgtTqVal 5;
BA_ "Version" SG_ 3221225472 RSPA_TrgtTqVal "18.01.03";
BA_ "Description" SG_ 3221225472 RSPA_DCTTrgtTqVal "Init value : 00h

Value : 0 … 99.6094 [%]

Physical range : 00h … FFh  

Conversion : (PH) = 0.390625 * (HEX) [%]";
BA_ "UserSigValidity" SG_ 3221225472 RSPA_DCTTrgtTqVal 3;
BA_ "GenSigTimeoutTime" SG_ 3221225472 RSPA_DCTTrgtTqVal 1500;
BA_ "RoutingFactor" SG_ 3221225472 RSPA_DCTTrgtTqVal 5;
BA_ "Version" SG_ 3221225472 RSPA_DCTTrgtTqVal "17.11.00";
BA_ "UsrSigPurpose" SG_ 3221225472 GST_MLM_Byte0 2;
BA_ "GenSigSendType" SG_ 3221225472 GST_MLM_Byte0 2;
BA_ "UserSigValidity" SG_ 3221225472 GST_MLM_Byte0 0;
BA_ "GenSigTimeoutTime" SG_ 3221225472 GST_MLM_Byte0 0;
BA_ "NetworkRequest" SG_ 3221225472 GST_MLM_Byte0 0;
BA_ "NetworkRequestHoldingTime" SG_ 3221225472 GST_MLM_Byte0 5000;
BA_ "Version" SG_ 3221225472 GST_MLM_Byte0 "18.01.09";
BA_ "UsrSigPurpose" SG_ 3221225472 GST_MLM_Byte1 2;
BA_ "GenSigSendType" SG_ 3221225472 GST_MLM_Byte1 2;
BA_ "UserSigValidity" SG_ 3221225472 GST_MLM_Byte1 0;
BA_ "GenSigTimeoutTime" SG_ 3221225472 GST_MLM_Byte1 0;
BA_ "NetworkRequest" SG_ 3221225472 GST_MLM_Byte1 0;
BA_ "NetworkRequestHoldingTime" SG_ 3221225472 GST_MLM_Byte1 5000;
BA_ "Version" SG_ 3221225472 GST_MLM_Byte1 "18.01.09";
BA_ "UsrSigPurpose" SG_ 3221225472 GST_MLM_Byte2 2;
BA_ "GenSigSendType" SG_ 3221225472 GST_MLM_Byte2 2;
BA_ "UserSigValidity" SG_ 3221225472 GST_MLM_Byte2 0;
BA_ "GenSigTimeoutTime" SG_ 3221225472 GST_MLM_Byte2 0;
BA_ "NetworkRequest" SG_ 3221225472 GST_MLM_Byte2 0;
BA_ "NetworkRequestHoldingTime" SG_ 3221225472 GST_MLM_Byte2 5000;
BA_ "Version" SG_ 3221225472 GST_MLM_Byte2 "18.01.09";
BA_ "UsrSigPurpose" SG_ 3221225472 GST_MLM_Byte3 2;
BA_ "GenSigSendType" SG_ 3221225472 GST_MLM_Byte3 2;
BA_ "UserSigValidity" SG_ 3221225472 GST_MLM_Byte3 0;
BA_ "GenSigTimeoutTime" SG_ 3221225472 GST_MLM_Byte3 0;
BA_ "NetworkRequest" SG_ 3221225472 GST_MLM_Byte3 0;
BA_ "NetworkRequestHoldingTime" SG_ 3221225472 GST_MLM_Byte3 5000;
BA_ "Version" SG_ 3221225472 GST_MLM_Byte3 "18.01.09";
BA_ "UsrSigPurpose" SG_ 3221225472 GST_MLM_Byte4 2;
BA_ "GenSigSendType" SG_ 3221225472 GST_MLM_Byte4 2;
BA_ "UserSigValidity" SG_ 3221225472 GST_MLM_Byte4 0;
BA_ "GenSigTimeoutTime" SG_ 3221225472 GST_MLM_Byte4 0;
BA_ "NetworkRequest" SG_ 3221225472 GST_MLM_Byte4 0;
BA_ "NetworkRequestHoldingTime" SG_ 3221225472 GST_MLM_Byte4 5000;
BA_ "Version" SG_ 3221225472 GST_MLM_Byte4 "18.01.09";
BA_ "UsrSigPurpose" SG_ 3221225472 GST_MLM_Byte5 2;
BA_ "GenSigSendType" SG_ 3221225472 GST_MLM_Byte5 2;
BA_ "UserSigValidity" SG_ 3221225472 GST_MLM_Byte5 0;
BA_ "GenSigTimeoutTime" SG_ 3221225472 GST_MLM_Byte5 0;
BA_ "NetworkRequest" SG_ 3221225472 GST_MLM_Byte5 0;
BA_ "NetworkRequestHoldingTime" SG_ 3221225472 GST_MLM_Byte5 5000;
BA_ "Version" SG_ 3221225472 GST_MLM_Byte5 "18.01.09";
BA_ "UsrSigPurpose" SG_ 3221225472 GST_MLM_Byte6 2;
BA_ "GenSigSendType" SG_ 3221225472 GST_MLM_Byte6 2;
BA_ "UserSigValidity" SG_ 3221225472 GST_MLM_Byte6 0;
BA_ "GenSigTimeoutTime" SG_ 3221225472 GST_MLM_Byte6 0;
BA_ "NetworkRequest" SG_ 3221225472 GST_MLM_Byte6 0;
BA_ "NetworkRequestHoldingTime" SG_ 3221225472 GST_MLM_Byte6 5000;
BA_ "Version" SG_ 3221225472 GST_MLM_Byte6 "18.01.09";
BA_ "UsrSigPurpose" SG_ 3221225472 GST_MLM_Byte7 2;
BA_ "GenSigSendType" SG_ 3221225472 GST_MLM_Byte7 2;
BA_ "UserSigValidity" SG_ 3221225472 GST_MLM_Byte7 0;
BA_ "GenSigTimeoutTime" SG_ 3221225472 GST_MLM_Byte7 0;
BA_ "NetworkRequest" SG_ 3221225472 GST_MLM_Byte7 0;
BA_ "NetworkRequestHoldingTime" SG_ 3221225472 GST_MLM_Byte7 5000;
BA_ "Version" SG_ 3221225472 GST_MLM_Byte7 "18.01.09";
BA_ "UsrSigPurpose" SG_ 3221225472 GST_IAU_Byte0 2;
BA_ "GenSigSendType" SG_ 3221225472 GST_IAU_Byte0 2;
BA_ "UserSigValidity" SG_ 3221225472 GST_IAU_Byte0 0;
BA_ "GenSigTimeoutTime" SG_ 3221225472 GST_IAU_Byte0 0;
BA_ "NetworkRequest" SG_ 3221225472 GST_IAU_Byte0 0;
BA_ "NetworkRequestHoldingTime" SG_ 3221225472 GST_IAU_Byte0 5000;
BA_ "Version" SG_ 3221225472 GST_IAU_Byte0 "18.01.09";
BA_ "UsrSigPurpose" SG_ 3221225472 GST_IAU_Byte1 2;
BA_ "GenSigSendType" SG_ 3221225472 GST_IAU_Byte1 2;
BA_ "UserSigValidity" SG_ 3221225472 GST_IAU_Byte1 0;
BA_ "GenSigTimeoutTime" SG_ 3221225472 GST_IAU_Byte1 0;
BA_ "NetworkRequest" SG_ 3221225472 GST_IAU_Byte1 0;
BA_ "NetworkRequestHoldingTime" SG_ 3221225472 GST_IAU_Byte1 5000;
BA_ "Version" SG_ 3221225472 GST_IAU_Byte1 "18.01.09";
BA_ "UsrSigPurpose" SG_ 3221225472 GST_IAU_Byte2 2;
BA_ "GenSigSendType" SG_ 3221225472 GST_IAU_Byte2 2;
BA_ "UserSigValidity" SG_ 3221225472 GST_IAU_Byte2 0;
BA_ "GenSigTimeoutTime" SG_ 3221225472 GST_IAU_Byte2 0;
BA_ "NetworkRequest" SG_ 3221225472 GST_IAU_Byte2 0;
BA_ "NetworkRequestHoldingTime" SG_ 3221225472 GST_IAU_Byte2 5000;
BA_ "Version" SG_ 3221225472 GST_IAU_Byte2 "18.01.09";
BA_ "UsrSigPurpose" SG_ 3221225472 GST_IAU_Byte3 2;
BA_ "GenSigSendType" SG_ 3221225472 GST_IAU_Byte3 2;
BA_ "UserSigValidity" SG_ 3221225472 GST_IAU_Byte3 0;
BA_ "GenSigTimeoutTime" SG_ 3221225472 GST_IAU_Byte3 0;
BA_ "NetworkRequest" SG_ 3221225472 GST_IAU_Byte3 0;
BA_ "NetworkRequestHoldingTime" SG_ 3221225472 GST_IAU_Byte3 5000;
BA_ "Version" SG_ 3221225472 GST_IAU_Byte3 "18.01.09";
BA_ "UsrSigPurpose" SG_ 3221225472 GST_IAU_Byte4 2;
BA_ "GenSigSendType" SG_ 3221225472 GST_IAU_Byte4 2;
BA_ "UserSigValidity" SG_ 3221225472 GST_IAU_Byte4 0;
BA_ "GenSigTimeoutTime" SG_ 3221225472 GST_IAU_Byte4 0;
BA_ "NetworkRequest" SG_ 3221225472 GST_IAU_Byte4 0;
BA_ "NetworkRequestHoldingTime" SG_ 3221225472 GST_IAU_Byte4 5000;
BA_ "Version" SG_ 3221225472 GST_IAU_Byte4 "18.01.09";
BA_ "UsrSigPurpose" SG_ 3221225472 GST_IAU_Byte5 2;
BA_ "GenSigSendType" SG_ 3221225472 GST_IAU_Byte5 2;
BA_ "UserSigValidity" SG_ 3221225472 GST_IAU_Byte5 0;
BA_ "GenSigTimeoutTime" SG_ 3221225472 GST_IAU_Byte5 0;
BA_ "NetworkRequest" SG_ 3221225472 GST_IAU_Byte5 0;
BA_ "NetworkRequestHoldingTime" SG_ 3221225472 GST_IAU_Byte5 5000;
BA_ "Version" SG_ 3221225472 GST_IAU_Byte5 "18.01.09";
BA_ "UsrSigPurpose" SG_ 3221225472 GST_IAU_Byte6 2;
BA_ "GenSigSendType" SG_ 3221225472 GST_IAU_Byte6 2;
BA_ "UserSigValidity" SG_ 3221225472 GST_IAU_Byte6 0;
BA_ "GenSigTimeoutTime" SG_ 3221225472 GST_IAU_Byte6 0;
BA_ "NetworkRequest" SG_ 3221225472 GST_IAU_Byte6 0;
BA_ "NetworkRequestHoldingTime" SG_ 3221225472 GST_IAU_Byte6 5000;
BA_ "Version" SG_ 3221225472 GST_IAU_Byte6 "18.01.09";
BA_ "UsrSigPurpose" SG_ 3221225472 GST_IAU_Byte7 2;
BA_ "GenSigSendType" SG_ 3221225472 GST_IAU_Byte7 2;
BA_ "UserSigValidity" SG_ 3221225472 GST_IAU_Byte7 0;
BA_ "GenSigTimeoutTime" SG_ 3221225472 GST_IAU_Byte7 0;
BA_ "NetworkRequest" SG_ 3221225472 GST_IAU_Byte7 0;
BA_ "NetworkRequestHoldingTime" SG_ 3221225472 GST_IAU_Byte7 5000;
BA_ "Version" SG_ 3221225472 GST_IAU_Byte7 "18.01.09";
BA_ "Description" SG_ 3221225472 ADAS_PRK_Crc3Val "The CRC checking process calculates the CRC over the entire data block, including the CRC result.

- CRC Polynomial (0x1021) , Initial Value : 0xFFFF, XOR value : 0x0000

- The mathematical expression to 16 bit CRC polynomial is given here. G(x) = x16 + ";
BA_ "GenSigStartValue" SG_ 3221225472 ADAS_PRK_Crc3Val 65535;
BA_ "UserSigValidity" SG_ 3221225472 ADAS_PRK_Crc3Val 3;
BA_ "GenSigTimeoutTime" SG_ 3221225472 ADAS_PRK_Crc3Val 1500;
BA_ "RoutingFactor" SG_ 3221225472 ADAS_PRK_Crc3Val 5;
BA_ "Version" SG_ 3221225472 ADAS_PRK_Crc3Val "17.11.00";
BA_ "Description" SG_ 3221225472 ADAS_PRK_AlvCnt3Val "For the first transmission request for a data element the counter shall be initialized with 0 and shall be incremented by 1

for every subsequent send request. When the counter reaches the maximum value(0xFF), then it shall restart with ? for the next se";
BA_ "UserSigValidity" SG_ 3221225472 ADAS_PRK_AlvCnt3Val 3;
BA_ "GenSigTimeoutTime" SG_ 3221225472 ADAS_PRK_AlvCnt3Val 1500;
BA_ "RoutingFactor" SG_ 3221225472 ADAS_PRK_AlvCnt3Val 5;
BA_ "Version" SG_ 3221225472 ADAS_PRK_AlvCnt3Val "17.11.00";
BA_ "Description" SG_ 3221225472 RSPA_AvnDis "AVN 화면 출력 요청 (RSPA 용)

'-CGW routing 필요 (CCAN to MMCAN)";
BA_ "UserSigValidity" SG_ 3221225472 RSPA_AvnDis 3;
BA_ "GenSigTimeoutTime" SG_ 3221225472 RSPA_AvnDis 1500;
BA_ "RoutingFactor" SG_ 3221225472 RSPA_AvnDis 5;
BA_ "Version" SG_ 3221225472 RSPA_AvnDis "17.11.00";
BA_ "Description" SG_ 3221225472 RSPA_AvnModDis "AVN상의 모드선택 메뉴 표출을 위한 주차/출차 구분 정보

'-CGW routing 필요 (CCAN to MMCAN)";
BA_ "UserSigValidity" SG_ 3221225472 RSPA_AvnModDis 3;
BA_ "GenSigTimeoutTime" SG_ 3221225472 RSPA_AvnModDis 1500;
BA_ "RoutingFactor" SG_ 3221225472 RSPA_AvnModDis 5;
BA_ "Version" SG_ 3221225472 RSPA_AvnModDis "17.11.00";
BA_ "Description" SG_ 3221225472 RSPA_AvnModNumDis "AVN에서 표출해야할 모드 선택 메뉴의 개수 설정 정보

'-CGW routing 필요 (CCAN to MMCAN)";
BA_ "UserSigValidity" SG_ 3221225472 RSPA_AvnModNumDis 3;
BA_ "GenSigTimeoutTime" SG_ 3221225472 RSPA_AvnModNumDis 1500;
BA_ "RoutingFactor" SG_ 3221225472 RSPA_AvnModNumDis 5;
BA_ "Version" SG_ 3221225472 RSPA_AvnModNumDis "17.11.00";
BA_ "Description" SG_ 3221225472 RSPA_AvnSubViewDis "AVN에서 표출해야할 Topview영역 대체이미지 출력요청

'-CGW routing 필요 (CCAN to MMCAN)";
BA_ "UserSigValidity" SG_ 3221225472 RSPA_AvnSubViewDis 3;
BA_ "GenSigTimeoutTime" SG_ 3221225472 RSPA_AvnSubViewDis 1500;
BA_ "RoutingFactor" SG_ 3221225472 RSPA_AvnSubViewDis 5;
BA_ "Version" SG_ 3221225472 RSPA_AvnSubViewDis "17.11.00";
BA_ "Description" SG_ 3221225472 RSPA_AvnModADLDis "AVN에서 표출하는 사선후방좌측 (주차/출차) 모드선택 메뉴의 제어가능여부 표시 정보

'-CGW routing 필요 (CCAN to MMCAN)";
BA_ "UserSigValidity" SG_ 3221225472 RSPA_AvnModADLDis 3;
BA_ "GenSigTimeoutTime" SG_ 3221225472 RSPA_AvnModADLDis 1500;
BA_ "RoutingFactor" SG_ 3221225472 RSPA_AvnModADLDis 5;
BA_ "Version" SG_ 3221225472 RSPA_AvnModADLDis "17.11.00";
BA_ "Description" SG_ 3221225472 RSPA_AvnModPDFLDis "AVN에서 표출하는 직각전진좌측 (주차/출차) 모드선택 메뉴의 제어가능여부 표시 정보

'-CGW routing 필요 (CCAN to MMCAN)";
BA_ "UserSigValidity" SG_ 3221225472 RSPA_AvnModPDFLDis 3;
BA_ "GenSigTimeoutTime" SG_ 3221225472 RSPA_AvnModPDFLDis 1500;
BA_ "RoutingFactor" SG_ 3221225472 RSPA_AvnModPDFLDis 5;
BA_ "Version" SG_ 3221225472 RSPA_AvnModPDFLDis "17.11.00";
BA_ "Description" SG_ 3221225472 RSPA_AvnModPLDis "AVN에서 표출하는 평행후방좌측 (주차/출차) 모드선택 메뉴의 제어가능여부 표시 정보

'-CGW routing 필요 (CCAN to MMCAN)";
BA_ "UserSigValidity" SG_ 3221225472 RSPA_AvnModPLDis 3;
BA_ "GenSigTimeoutTime" SG_ 3221225472 RSPA_AvnModPLDis 1500;
BA_ "RoutingFactor" SG_ 3221225472 RSPA_AvnModPLDis 5;
BA_ "Version" SG_ 3221225472 RSPA_AvnModPLDis "17.11.00";
BA_ "Description" SG_ 3221225472 RSPA_AvnModPDRLDis "AVN에서 표출하는 직각후방좌측 (주차/출차) 모드선택 메뉴의 제어가능여부 표시 정보

'-CGW routing 필요 (CCAN to MMCAN)";
BA_ "UserSigValidity" SG_ 3221225472 RSPA_AvnModPDRLDis 3;
BA_ "GenSigTimeoutTime" SG_ 3221225472 RSPA_AvnModPDRLDis 1500;
BA_ "RoutingFactor" SG_ 3221225472 RSPA_AvnModPDRLDis 5;
BA_ "Version" SG_ 3221225472 RSPA_AvnModPDRLDis "17.11.00";
BA_ "Description" SG_ 3221225472 RSPA_AvnModPDRRDis "AVN에서 표출하는 직각후방우측 (주차/출차) 모드선택 메뉴의 제어가능여부 표시 정보

'-CGW routing 필요 (CCAN to MMCAN)";
BA_ "UserSigValidity" SG_ 3221225472 RSPA_AvnModPDRRDis 3;
BA_ "GenSigTimeoutTime" SG_ 3221225472 RSPA_AvnModPDRRDis 1500;
BA_ "RoutingFactor" SG_ 3221225472 RSPA_AvnModPDRRDis 5;
BA_ "Version" SG_ 3221225472 RSPA_AvnModPDRRDis "17.11.00";
BA_ "Description" SG_ 3221225472 RSPA_AvnModPRDis "AVN에서 표출하는 평행후방우측 (주차/출차) 모드선택 메뉴의 제어가능여부 표시 정보

'-CGW routing 필요 (CCAN to MMCAN)";
BA_ "UserSigValidity" SG_ 3221225472 RSPA_AvnModPRDis 3;
BA_ "GenSigTimeoutTime" SG_ 3221225472 RSPA_AvnModPRDis 1500;
BA_ "RoutingFactor" SG_ 3221225472 RSPA_AvnModPRDis 5;
BA_ "Version" SG_ 3221225472 RSPA_AvnModPRDis "17.11.00";
BA_ "Description" SG_ 3221225472 RSPA_AvnModPDFRDis "AVN에서 표출하는 직각전방우측 (주차/출차) 모드선택 메뉴의 제어가능여부 표시 정보

'-CGW routing 필요 (CCAN to MMCAN)";
BA_ "UserSigValidity" SG_ 3221225472 RSPA_AvnModPDFRDis 3;
BA_ "GenSigTimeoutTime" SG_ 3221225472 RSPA_AvnModPDFRDis 1500;
BA_ "RoutingFactor" SG_ 3221225472 RSPA_AvnModPDFRDis 5;
BA_ "Version" SG_ 3221225472 RSPA_AvnModPDFRDis "17.11.00";
BA_ "Description" SG_ 3221225472 RSPA_AvnModADRDis "AVN에서 표출하는 사선후방우측 (주차/출차) 모드선택 메뉴의 제어가능여부 표시 정보

'-CGW routing 필요 (CCAN to MMCAN)";
BA_ "UserSigValidity" SG_ 3221225472 RSPA_AvnModADRDis 3;
BA_ "GenSigTimeoutTime" SG_ 3221225472 RSPA_AvnModADRDis 1500;
BA_ "RoutingFactor" SG_ 3221225472 RSPA_AvnModADRDis 5;
BA_ "Version" SG_ 3221225472 RSPA_AvnModADRDis "17.11.00";
BA_ "Description" SG_ 3221225472 RSPA_CamDis "RSPA 작동 시 AVM/RVM에 AVN에 출력할 영상 뷰 모드 요청";
BA_ "UserSigValidity" SG_ 3221225472 RSPA_CamDis 3;
BA_ "GenSigTimeoutTime" SG_ 3221225472 RSPA_CamDis 1500;
BA_ "RoutingFactor" SG_ 3221225472 RSPA_CamDis 5;
BA_ "Version" SG_ 3221225472 RSPA_CamDis "17.11.00";
BA_ "Description" SG_ 3221225472 RSPA_AvnHmiDis "AVN에서 표출하는 안내 표시 정보

'-CGW routing 필요 (CCAN to MMCAN)";
BA_ "UserSigValidity" SG_ 3221225472 RSPA_AvnHmiDis 3;
BA_ "GenSigTimeoutTime" SG_ 3221225472 RSPA_AvnHmiDis 1500;
BA_ "RoutingFactor" SG_ 3221225472 RSPA_AvnHmiDis 5;
BA_ "Version" SG_ 3221225472 RSPA_AvnHmiDis "17.12.03";
BA_ "Description" SG_ 3221225472 PSB_Crc1Val "The CRC checking process calculates the CRC over the entire data block, including the CRC result CRC Polynomial (0x1D) ,

Initial Value : 0x00, XOR value : 0x00

The mathematical expression to 8 bit CRC polynomial is given here. G(x) = x8 + x4 + x3 + x2 ";
BA_ "UserSigValidity" SG_ 3221225472 PSB_Crc1Val 0;
BA_ "GenSigTimeoutTime" SG_ 3221225472 PSB_Crc1Val 1500;
BA_ "Version" SG_ 3221225472 PSB_Crc1Val "18.02.03";
BA_ "Description" SG_ 3221225472 PSB_AlvCnt1Val "For the first transmission request for a data element the counter shall be initialized with 0 and shall be incremented by 1

for every subsequent send request. When the counter reaches the maximum value(0xE), then it shall restart with ? for the next sen";
BA_ "UserSigValidity" SG_ 3221225472 PSB_AlvCnt1Val 0;
BA_ "GenSigTimeoutTime" SG_ 3221225472 PSB_AlvCnt1Val 1500;
BA_ "Version" SG_ 3221225472 PSB_AlvCnt1Val "18.02.03";
BA_ "Description" SG_ 3221225472 PSB_LHFlrSta "Information about availability of PSB_LH (LH Pre-Safe S/Belt).";
BA_ "UserSigValidity" SG_ 3221225472 PSB_LHFlrSta 0;
BA_ "GenSigTimeoutTime" SG_ 3221225472 PSB_LHFlrSta 1500;
BA_ "Version" SG_ 3221225472 PSB_LHFlrSta "18.02.03";
BA_ "Description" SG_ 3221225472 PSB_LHActvSta "Seat belt active state. This signal is for the monitoring of Pre-Safe S/Belt.

If there is a request, but no realization by the Pre-Safe S/Belt -> failure entry in the SCC(Radar).";
BA_ "UserSigValidity" SG_ 3221225472 PSB_LHActvSta 0;
BA_ "GenSigTimeoutTime" SG_ 3221225472 PSB_LHActvSta 1500;
BA_ "Version" SG_ 3221225472 PSB_LHActvSta "18.02.03";
BA_ "Description" SG_ 3221225472 PSB_RHFlrSta "Information about availability of PSB_RH (LH Pre-Safe S/Belt).";
BA_ "UserSigValidity" SG_ 3221225472 PSB_RHFlrSta 0;
BA_ "GenSigTimeoutTime" SG_ 3221225472 PSB_RHFlrSta 1500;
BA_ "Version" SG_ 3221225472 PSB_RHFlrSta "18.02.03";
BA_ "Description" SG_ 3221225472 PSB_RHActvSta "Seat belt active state. This signal is for the monitoring of Pre-Safe S/Belt.

If there is a request, but no realization by the Pre-Safe S/Belt -> failure entry in the SCC(Radar).";
BA_ "UserSigValidity" SG_ 3221225472 PSB_RHActvSta 0;
BA_ "GenSigTimeoutTime" SG_ 3221225472 PSB_RHActvSta 1500;
BA_ "Version" SG_ 3221225472 PSB_RHActvSta "18.02.03";
BA_ "Description" SG_ 3221225472 PSB_ActForAcu "This signal indicates status of Pre-Safe S/Belt activation by ACU commends.";
BA_ "UserSigValidity" SG_ 3221225472 PSB_ActForAcu 0;
BA_ "GenSigTimeoutTime" SG_ 3221225472 PSB_ActForAcu 1500;
BA_ "Version" SG_ 3221225472 PSB_ActForAcu "18.02.03";
BA_ "Description" SG_ 3221225472 PTGM_Crc1Val "The CRC checking process calculates the CRC over the entire data block, including the CRC result CRC Polynomial (0x1D) ,

Initial Value : 0x00, XOR value : 0x00

The mathematical expression to 8 bit CRC polynomial is given here. G(x) = x8 + x4 + x3 + x2 ";
BA_ "GenSigSendType" SG_ 3221225472 PTGM_Crc1Val 4;
BA_ "GenSigStartValue" SG_ 3221225472 PTGM_Crc1Val 255;
BA_ "UserSigValidity" SG_ 3221225472 PTGM_Crc1Val 0;
BA_ "GenSigTimeoutTime" SG_ 3221225472 PTGM_Crc1Val 1500;
BA_ "Version" SG_ 3221225472 PTGM_Crc1Val "17.11.00";
BA_ "Description" SG_ 3221225472 PTGM_AlvCnt1Val "For the first transmission request for a data element the counter shall be initialized with 0 and shall be incremented by 1

for every subsequent send request. When the counter reaches the maximum value(0xE), then it shall restart with ? for the next sen";
BA_ "GenSigSendType" SG_ 3221225472 PTGM_AlvCnt1Val 4;
BA_ "UserSigValidity" SG_ 3221225472 PTGM_AlvCnt1Val 0;
BA_ "GenSigTimeoutTime" SG_ 3221225472 PTGM_AlvCnt1Val 1500;
BA_ "Version" SG_ 3221225472 PTGM_AlvCnt1Val "17.11.00";
BA_ "Description" SG_ 3221225472 PTGM_HazardSta "-(Old)C_PTHazard";
BA_ "GenSigSendType" SG_ 3221225472 PTGM_HazardSta 4;
BA_ "UserSigValidity" SG_ 3221225472 PTGM_HazardSta 0;
BA_ "GenSigTimeoutTime" SG_ 3221225472 PTGM_HazardSta 1500;
BA_ "NetworkRequest" SG_ 3221225472 PTGM_HazardSta 0;
BA_ "NetworkRequestHoldingTime" SG_ 3221225472 PTGM_HazardSta 5000;
BA_ "Version" SG_ 3221225472 PTGM_HazardSta "17.11.00";
BA_ "Description" SG_ 3221225472 PTGM_ModSta "PTGM Moudule Status";
BA_ "GenSigSendType" SG_ 3221225472 PTGM_ModSta 4;
BA_ "UserSigValidity" SG_ 3221225472 PTGM_ModSta 0;
BA_ "GenSigTimeoutTime" SG_ 3221225472 PTGM_ModSta 1500;
BA_ "NetworkRequest" SG_ 3221225472 PTGM_ModSta 0;
BA_ "NetworkRequestHoldingTime" SG_ 3221225472 PTGM_ModSta 5000;
BA_ "Version" SG_ 3221225472 PTGM_ModSta "17.11.00";
BA_ "Description" SG_ 3221225472 PTGM_MovSta "PTGM Status (stop or moving)";
BA_ "GenSigSendType" SG_ 3221225472 PTGM_MovSta 4;
BA_ "UserSigValidity" SG_ 3221225472 PTGM_MovSta 0;
BA_ "GenSigTimeoutTime" SG_ 3221225472 PTGM_MovSta 1500;
BA_ "NetworkRequest" SG_ 3221225472 PTGM_MovSta 0;
BA_ "NetworkRequestHoldingTime" SG_ 3221225472 PTGM_MovSta 5000;
BA_ "Version" SG_ 3221225472 PTGM_MovSta "17.11.00";
BA_ "GenSigSendType" SG_ 3221225472 PTGM_OptTyp 4;
BA_ "UserSigValidity" SG_ 3221225472 PTGM_OptTyp 0;
BA_ "GenSigTimeoutTime" SG_ 3221225472 PTGM_OptTyp 1500;
BA_ "NetworkRequest" SG_ 3221225472 PTGM_OptTyp 0;
BA_ "NetworkRequestHoldingTime" SG_ 3221225472 PTGM_OptTyp 5000;
BA_ "Version" SG_ 3221225472 PTGM_OptTyp "17.11.00";
BA_ "GenSigSendType" SG_ 3221225472 PTGM_ReleaseRlySta 4;
BA_ "UserSigValidity" SG_ 3221225472 PTGM_ReleaseRlySta 0;
BA_ "GenSigTimeoutTime" SG_ 3221225472 PTGM_ReleaseRlySta 1500;
BA_ "NetworkRequest" SG_ 3221225472 PTGM_ReleaseRlySta 0;
BA_ "NetworkRequestHoldingTime" SG_ 3221225472 PTGM_ReleaseRlySta 5000;
BA_ "Version" SG_ 3221225472 PTGM_ReleaseRlySta "17.11.00";
BA_ "Description" SG_ 3221225472 PTGM_TrnkLkSwSta "-(Old)C_Trunk_Lock_Sw";
BA_ "GenSigSendType" SG_ 3221225472 PTGM_TrnkLkSwSta 4;
BA_ "UserSigValidity" SG_ 3221225472 PTGM_TrnkLkSwSta 0;
BA_ "GenSigTimeoutTime" SG_ 3221225472 PTGM_TrnkLkSwSta 1500;
BA_ "NetworkRequest" SG_ 3221225472 PTGM_TrnkLkSwSta 0;
BA_ "NetworkRequestHoldingTime" SG_ 3221225472 PTGM_TrnkLkSwSta 5000;
BA_ "Version" SG_ 3221225472 PTGM_TrnkLkSwSta "17.11.00";
BA_ "Description" SG_ 3221225472 PTGM_UsmSetSta "PTGM USM Setting Signal";
BA_ "GenSigSendType" SG_ 3221225472 PTGM_UsmSetSta 4;
BA_ "UserSigValidity" SG_ 3221225472 PTGM_UsmSetSta 3;
BA_ "GenSigTimeoutTime" SG_ 3221225472 PTGM_UsmSetSta 1500;
BA_ "NetworkRequest" SG_ 3221225472 PTGM_UsmSetSta 0;
BA_ "NetworkRequestHoldingTime" SG_ 3221225472 PTGM_UsmSetSta 5000;
BA_ "Version" SG_ 3221225472 PTGM_UsmSetSta "17.11.00";
BA_ "UsrSigPurpose" SG_ 3221225472 GST_RLHVU_Byte0 2;
BA_ "GenSigSendType" SG_ 3221225472 GST_RLHVU_Byte0 2;
BA_ "UserSigValidity" SG_ 3221225472 GST_RLHVU_Byte0 0;
BA_ "GenSigTimeoutTime" SG_ 3221225472 GST_RLHVU_Byte0 0;
BA_ "NetworkRequest" SG_ 3221225472 GST_RLHVU_Byte0 0;
BA_ "NetworkRequestHoldingTime" SG_ 3221225472 GST_RLHVU_Byte0 5000;
BA_ "Version" SG_ 3221225472 GST_RLHVU_Byte0 "18.03.03";
BA_ "UsrSigPurpose" SG_ 3221225472 GST_RLHVU_Byte1 2;
BA_ "GenSigSendType" SG_ 3221225472 GST_RLHVU_Byte1 2;
BA_ "UserSigValidity" SG_ 3221225472 GST_RLHVU_Byte1 0;
BA_ "GenSigTimeoutTime" SG_ 3221225472 GST_RLHVU_Byte1 0;
BA_ "NetworkRequest" SG_ 3221225472 GST_RLHVU_Byte1 0;
BA_ "NetworkRequestHoldingTime" SG_ 3221225472 GST_RLHVU_Byte1 5000;
BA_ "Version" SG_ 3221225472 GST_RLHVU_Byte1 "18.03.03";
BA_ "UsrSigPurpose" SG_ 3221225472 GST_RLHVU_Byte2 2;
BA_ "GenSigSendType" SG_ 3221225472 GST_RLHVU_Byte2 2;
BA_ "UserSigValidity" SG_ 3221225472 GST_RLHVU_Byte2 0;
BA_ "GenSigTimeoutTime" SG_ 3221225472 GST_RLHVU_Byte2 0;
BA_ "NetworkRequest" SG_ 3221225472 GST_RLHVU_Byte2 0;
BA_ "NetworkRequestHoldingTime" SG_ 3221225472 GST_RLHVU_Byte2 5000;
BA_ "Version" SG_ 3221225472 GST_RLHVU_Byte2 "18.03.03";
BA_ "UsrSigPurpose" SG_ 3221225472 GST_RLHVU_Byte3 2;
BA_ "GenSigSendType" SG_ 3221225472 GST_RLHVU_Byte3 2;
BA_ "UserSigValidity" SG_ 3221225472 GST_RLHVU_Byte3 0;
BA_ "GenSigTimeoutTime" SG_ 3221225472 GST_RLHVU_Byte3 0;
BA_ "NetworkRequest" SG_ 3221225472 GST_RLHVU_Byte3 0;
BA_ "NetworkRequestHoldingTime" SG_ 3221225472 GST_RLHVU_Byte3 5000;
BA_ "Version" SG_ 3221225472 GST_RLHVU_Byte3 "18.03.03";
BA_ "UsrSigPurpose" SG_ 3221225472 GST_RLHVU_Byte4 2;
BA_ "GenSigSendType" SG_ 3221225472 GST_RLHVU_Byte4 2;
BA_ "UserSigValidity" SG_ 3221225472 GST_RLHVU_Byte4 0;
BA_ "GenSigTimeoutTime" SG_ 3221225472 GST_RLHVU_Byte4 0;
BA_ "NetworkRequest" SG_ 3221225472 GST_RLHVU_Byte4 0;
BA_ "NetworkRequestHoldingTime" SG_ 3221225472 GST_RLHVU_Byte4 5000;
BA_ "Version" SG_ 3221225472 GST_RLHVU_Byte4 "18.03.03";
BA_ "UsrSigPurpose" SG_ 3221225472 GST_RLHVU_Byte5 2;
BA_ "GenSigSendType" SG_ 3221225472 GST_RLHVU_Byte5 2;
BA_ "UserSigValidity" SG_ 3221225472 GST_RLHVU_Byte5 0;
BA_ "GenSigTimeoutTime" SG_ 3221225472 GST_RLHVU_Byte5 0;
BA_ "NetworkRequest" SG_ 3221225472 GST_RLHVU_Byte5 0;
BA_ "NetworkRequestHoldingTime" SG_ 3221225472 GST_RLHVU_Byte5 5000;
BA_ "Version" SG_ 3221225472 GST_RLHVU_Byte5 "18.03.03";
BA_ "UsrSigPurpose" SG_ 3221225472 GST_RLHVU_Byte6 2;
BA_ "GenSigSendType" SG_ 3221225472 GST_RLHVU_Byte6 2;
BA_ "UserSigValidity" SG_ 3221225472 GST_RLHVU_Byte6 0;
BA_ "GenSigTimeoutTime" SG_ 3221225472 GST_RLHVU_Byte6 0;
BA_ "NetworkRequest" SG_ 3221225472 GST_RLHVU_Byte6 0;
BA_ "NetworkRequestHoldingTime" SG_ 3221225472 GST_RLHVU_Byte6 5000;
BA_ "Version" SG_ 3221225472 GST_RLHVU_Byte6 "18.03.03";
BA_ "UsrSigPurpose" SG_ 3221225472 GST_RLHVU_Byte7 2;
BA_ "GenSigSendType" SG_ 3221225472 GST_RLHVU_Byte7 2;
BA_ "UserSigValidity" SG_ 3221225472 GST_RLHVU_Byte7 0;
BA_ "GenSigTimeoutTime" SG_ 3221225472 GST_RLHVU_Byte7 0;
BA_ "NetworkRequest" SG_ 3221225472 GST_RLHVU_Byte7 0;
BA_ "NetworkRequestHoldingTime" SG_ 3221225472 GST_RLHVU_Byte7 5000;
BA_ "Version" SG_ 3221225472 GST_RLHVU_Byte7 "18.03.03";
BA_ "Description" SG_ 3221225472 ADAS_CMD_Crc40Val "The CRC checking process calculates the CRC over the entire data block, including the CRC result.

- CRC Polynomial (0x1021) , Initial Value : 0xFFFF, XOR value : 0x0000

- The mathematical expression to 16 bit CRC polynomial is given here. G(x) = x16 + ";
BA_ "GenSigStartValue" SG_ 3221225472 ADAS_CMD_Crc40Val 65535;
BA_ "UserSigValidity" SG_ 3221225472 ADAS_CMD_Crc40Val 3;
BA_ "GenSigTimeoutTime" SG_ 3221225472 ADAS_CMD_Crc40Val 1500;
BA_ "RoutingFactor" SG_ 3221225472 ADAS_CMD_Crc40Val 3;
BA_ "Version" SG_ 3221225472 ADAS_CMD_Crc40Val "17.12.00";
BA_ "Description" SG_ 3221225472 ADAS_CMD_AlvCnt40Val "For the first transmission request for a data element the counter shall be initialized with 0 and shall be incremented by 1

for every subsequent send request. When the counter reaches the maximum value(0xFF), then it shall restart with ? for the next se";
BA_ "UserSigValidity" SG_ 3221225472 ADAS_CMD_AlvCnt40Val 3;
BA_ "GenSigTimeoutTime" SG_ 3221225472 ADAS_CMD_AlvCnt40Val 1500;
BA_ "RoutingFactor" SG_ 3221225472 ADAS_CMD_AlvCnt40Val 3;
BA_ "Version" SG_ 3221225472 ADAS_CMD_AlvCnt40Val "17.12.00";
BA_ "Description" SG_ 3221225472 BCW_Sta "This signal indicates the status of BCW";
BA_ "UserSigValidity" SG_ 3221225472 BCW_Sta 3;
BA_ "GenSigTimeoutTime" SG_ 3221225472 BCW_Sta 1500;
BA_ "RoutingFactor" SG_ 3221225472 BCW_Sta 3;
BA_ "Version" SG_ 3221225472 BCW_Sta "17.12.00";
BA_ "Description" SG_ 3221225472 BCW_OnOffEquipSta "This signal indicates the on/off status of BCW";
BA_ "UserSigValidity" SG_ 3221225472 BCW_OnOffEquipSta 3;
BA_ "GenSigTimeoutTime" SG_ 3221225472 BCW_OnOffEquipSta 1500;
BA_ "RoutingFactor" SG_ 3221225472 BCW_OnOffEquipSta 3;
BA_ "Version" SG_ 3221225472 BCW_OnOffEquipSta "17.12.00";
BA_ "Description" SG_ 3221225472 BCW_LftIndSta "This signal Indicates BCW Warning Indicator mode for Left side";
BA_ "UserSigValidity" SG_ 3221225472 BCW_LftIndSta 3;
BA_ "GenSigTimeoutTime" SG_ 3221225472 BCW_LftIndSta 1500;
BA_ "RoutingFactor" SG_ 3221225472 BCW_LftIndSta 3;
BA_ "Version" SG_ 3221225472 BCW_LftIndSta "17.12.00";
BA_ "Description" SG_ 3221225472 BCW_RtIndSta "This signal Indicates BCW Warning Indicator mode for Right side";
BA_ "UserSigValidity" SG_ 3221225472 BCW_RtIndSta 3;
BA_ "GenSigTimeoutTime" SG_ 3221225472 BCW_RtIndSta 1500;
BA_ "RoutingFactor" SG_ 3221225472 BCW_RtIndSta 3;
BA_ "Version" SG_ 3221225472 BCW_RtIndSta "17.12.00";
BA_ "Description" SG_ 3221225472 BCW_LftSndWrngSta "This signal indicates BCW Sound Warning for Front Left Speaker";
BA_ "UserSigValidity" SG_ 3221225472 BCW_LftSndWrngSta 3;
BA_ "GenSigTimeoutTime" SG_ 3221225472 BCW_LftSndWrngSta 1500;
BA_ "RoutingFactor" SG_ 3221225472 BCW_LftSndWrngSta 3;
BA_ "Version" SG_ 3221225472 BCW_LftSndWrngSta "17.12.00";
BA_ "Description" SG_ 3221225472 BCW_RtSndWrngSta "This signal indicates BCW Sound Warning for Front Right Speaker";
BA_ "UserSigValidity" SG_ 3221225472 BCW_RtSndWrngSta 3;
BA_ "GenSigTimeoutTime" SG_ 3221225472 BCW_RtSndWrngSta 1500;
BA_ "RoutingFactor" SG_ 3221225472 BCW_RtSndWrngSta 3;
BA_ "Version" SG_ 3221225472 BCW_RtSndWrngSta "17.12.00";
BA_ "Description" SG_ 3221225472 BCW_LftIndBriLvlVal "0x00~FF : Indicator Brightness level of BCW";
BA_ "UserSigValidity" SG_ 3221225472 BCW_LftIndBriLvlVal 3;
BA_ "GenSigTimeoutTime" SG_ 3221225472 BCW_LftIndBriLvlVal 1500;
BA_ "RoutingFactor" SG_ 3221225472 BCW_LftIndBriLvlVal 3;
BA_ "Version" SG_ 3221225472 BCW_LftIndBriLvlVal "17.12.00";
BA_ "Description" SG_ 3221225472 BCW_RtIndBriLvlVal "0x00~FF : Indicator Brightness level of BCW";
BA_ "UserSigValidity" SG_ 3221225472 BCW_RtIndBriLvlVal 3;
BA_ "GenSigTimeoutTime" SG_ 3221225472 BCW_RtIndBriLvlVal 1500;
BA_ "RoutingFactor" SG_ 3221225472 BCW_RtIndBriLvlVal 3;
BA_ "Version" SG_ 3221225472 BCW_RtIndBriLvlVal "17.12.00";
BA_ "Description" SG_ 3221225472 BCW_SnstvtyModRetVal "This signal indicates the selected sensitive mode of BCW warning";
BA_ "UserSigValidity" SG_ 3221225472 BCW_SnstvtyModRetVal 3;
BA_ "GenSigTimeoutTime" SG_ 3221225472 BCW_SnstvtyModRetVal 1500;
BA_ "RoutingFactor" SG_ 3221225472 BCW_SnstvtyModRetVal 3;
BA_ "Version" SG_ 3221225472 BCW_SnstvtyModRetVal "17.12.00";
BA_ "Description" SG_ 3221225472 BCA_Sta "This signal indicates the status of BCA";
BA_ "UserSigValidity" SG_ 3221225472 BCA_Sta 3;
BA_ "GenSigTimeoutTime" SG_ 3221225472 BCA_Sta 1500;
BA_ "RoutingFactor" SG_ 3221225472 BCA_Sta 3;
BA_ "Version" SG_ 3221225472 BCA_Sta "17.12.00";
BA_ "Description" SG_ 3221225472 BCA_OnOffEquipSta "This signal indicates the on/off status of BCA";
BA_ "UserSigValidity" SG_ 3221225472 BCA_OnOffEquipSta 3;
BA_ "GenSigTimeoutTime" SG_ 3221225472 BCA_OnOffEquipSta 1500;
BA_ "RoutingFactor" SG_ 3221225472 BCA_OnOffEquipSta 3;
BA_ "Version" SG_ 3221225472 BCA_OnOffEquipSta "17.12.00";
BA_ "Description" SG_ 3221225472 BCA_LftWrngSta "This signal indicates the left warning of BCA";
BA_ "UserSigValidity" SG_ 3221225472 BCA_LftWrngSta 3;
BA_ "GenSigTimeoutTime" SG_ 3221225472 BCA_LftWrngSta 1500;
BA_ "RoutingFactor" SG_ 3221225472 BCA_LftWrngSta 3;
BA_ "Version" SG_ 3221225472 BCA_LftWrngSta "17.12.03";
BA_ "Description" SG_ 3221225472 BCA_RtWrngSta "This signal indicates the Right warning of BCA";
BA_ "UserSigValidity" SG_ 3221225472 BCA_RtWrngSta 3;
BA_ "GenSigTimeoutTime" SG_ 3221225472 BCA_RtWrngSta 1500;
BA_ "RoutingFactor" SG_ 3221225472 BCA_RtWrngSta 3;
BA_ "Version" SG_ 3221225472 BCA_RtWrngSta "17.12.03";
BA_ "Description" SG_ 3221225472 BCA_Plus_Deccel_Req "This value is defined the time to stop the vehicle.





(PH) = 0.04 * (Hex)s";
BA_ "UserSigValidity" SG_ 3221225472 BCA_Plus_Deccel_Req 3;
BA_ "GenSigTimeoutTime" SG_ 3221225472 BCA_Plus_Deccel_Req 1500;
BA_ "RoutingFactor" SG_ 3221225472 BCA_Plus_Deccel_Req 3;
BA_ "Version" SG_ 3221225472 BCA_Plus_Deccel_Req "18.01.10";
BA_ "Description" SG_ 3221225472 BCA_Plus_BrkCmdSta "BCA_Plus Function Brake Command";
BA_ "UserSigValidity" SG_ 3221225472 BCA_Plus_BrkCmdSta 3;
BA_ "GenSigTimeoutTime" SG_ 3221225472 BCA_Plus_BrkCmdSta 1500;
BA_ "RoutingFactor" SG_ 3221225472 BCA_Plus_BrkCmdSta 3;
BA_ "Version" SG_ 3221225472 BCA_Plus_BrkCmdSta "17.11.00";
BA_ "Description" SG_ 3221225472 BCA_Plus_LftWrngSta "This signal Indicates BCA_Plus Warning state for HMI(Cluster)";
BA_ "UserSigValidity" SG_ 3221225472 BCA_Plus_LftWrngSta 3;
BA_ "GenSigTimeoutTime" SG_ 3221225472 BCA_Plus_LftWrngSta 1500;
BA_ "RoutingFactor" SG_ 3221225472 BCA_Plus_LftWrngSta 3;
BA_ "Version" SG_ 3221225472 BCA_Plus_LftWrngSta "17.11.00";
BA_ "Description" SG_ 3221225472 BCA_Plus_RtWrngSta "This signal Indicates BCA_Plus Warning state for HMI";
BA_ "UserSigValidity" SG_ 3221225472 BCA_Plus_RtWrngSta 3;
BA_ "GenSigTimeoutTime" SG_ 3221225472 BCA_Plus_RtWrngSta 1500;
BA_ "RoutingFactor" SG_ 3221225472 BCA_Plus_RtWrngSta 3;
BA_ "Version" SG_ 3221225472 BCA_Plus_RtWrngSta "17.11.00";
BA_ "Description" SG_ 3221225472 BCA_Plus_OnOffEquipSta "BCA_Plus state";
BA_ "UserSigValidity" SG_ 3221225472 BCA_Plus_OnOffEquipSta 3;
BA_ "GenSigTimeoutTime" SG_ 3221225472 BCA_Plus_OnOffEquipSta 1500;
BA_ "RoutingFactor" SG_ 3221225472 BCA_Plus_OnOffEquipSta 3;
BA_ "Version" SG_ 3221225472 BCA_Plus_OnOffEquipSta "17.11.00";
BA_ "Description" SG_ 3221225472 BCA_Plus_FuncStat "ESC state";
BA_ "UserSigValidity" SG_ 3221225472 BCA_Plus_FuncStat 3;
BA_ "GenSigTimeoutTime" SG_ 3221225472 BCA_Plus_FuncStat 1500;
BA_ "RoutingFactor" SG_ 3221225472 BCA_Plus_FuncStat 3;
BA_ "Version" SG_ 3221225472 BCA_Plus_FuncStat "17.11.00";
BA_ "Description" SG_ 3221225472 BCA_Plus_Sta "This signal indicates the status of BCA Plus";
BA_ "UserSigValidity" SG_ 3221225472 BCA_Plus_Sta 3;
BA_ "GenSigTimeoutTime" SG_ 3221225472 BCA_Plus_Sta 1500;
BA_ "RoutingFactor" SG_ 3221225472 BCA_Plus_Sta 3;
BA_ "Version" SG_ 3221225472 BCA_Plus_Sta "17.12.03";
BA_ "UsrSigPurpose" SG_ 3221225472 RLHVU_GST_Byte0 2;
BA_ "GenSigSendType" SG_ 3221225472 RLHVU_GST_Byte0 2;
BA_ "UserSigValidity" SG_ 3221225472 RLHVU_GST_Byte0 0;
BA_ "GenSigTimeoutTime" SG_ 3221225472 RLHVU_GST_Byte0 0;
BA_ "NetworkRequest" SG_ 3221225472 RLHVU_GST_Byte0 0;
BA_ "NetworkRequestHoldingTime" SG_ 3221225472 RLHVU_GST_Byte0 5000;
BA_ "Version" SG_ 3221225472 RLHVU_GST_Byte0 "18.03.03";
BA_ "UsrSigPurpose" SG_ 3221225472 RLHVU_GST_Byte1 2;
BA_ "GenSigSendType" SG_ 3221225472 RLHVU_GST_Byte1 2;
BA_ "UserSigValidity" SG_ 3221225472 RLHVU_GST_Byte1 0;
BA_ "GenSigTimeoutTime" SG_ 3221225472 RLHVU_GST_Byte1 0;
BA_ "NetworkRequest" SG_ 3221225472 RLHVU_GST_Byte1 0;
BA_ "NetworkRequestHoldingTime" SG_ 3221225472 RLHVU_GST_Byte1 5000;
BA_ "Version" SG_ 3221225472 RLHVU_GST_Byte1 "18.03.03";
BA_ "UsrSigPurpose" SG_ 3221225472 RLHVU_GST_Byte2 2;
BA_ "GenSigSendType" SG_ 3221225472 RLHVU_GST_Byte2 2;
BA_ "UserSigValidity" SG_ 3221225472 RLHVU_GST_Byte2 0;
BA_ "GenSigTimeoutTime" SG_ 3221225472 RLHVU_GST_Byte2 0;
BA_ "NetworkRequest" SG_ 3221225472 RLHVU_GST_Byte2 0;
BA_ "NetworkRequestHoldingTime" SG_ 3221225472 RLHVU_GST_Byte2 5000;
BA_ "Version" SG_ 3221225472 RLHVU_GST_Byte2 "18.03.03";
BA_ "UsrSigPurpose" SG_ 3221225472 RLHVU_GST_Byte3 2;
BA_ "GenSigSendType" SG_ 3221225472 RLHVU_GST_Byte3 2;
BA_ "UserSigValidity" SG_ 3221225472 RLHVU_GST_Byte3 0;
BA_ "GenSigTimeoutTime" SG_ 3221225472 RLHVU_GST_Byte3 0;
BA_ "NetworkRequest" SG_ 3221225472 RLHVU_GST_Byte3 0;
BA_ "NetworkRequestHoldingTime" SG_ 3221225472 RLHVU_GST_Byte3 5000;
BA_ "Version" SG_ 3221225472 RLHVU_GST_Byte3 "18.03.03";
BA_ "UsrSigPurpose" SG_ 3221225472 RLHVU_GST_Byte4 2;
BA_ "GenSigSendType" SG_ 3221225472 RLHVU_GST_Byte4 2;
BA_ "UserSigValidity" SG_ 3221225472 RLHVU_GST_Byte4 0;
BA_ "GenSigTimeoutTime" SG_ 3221225472 RLHVU_GST_Byte4 0;
BA_ "NetworkRequest" SG_ 3221225472 RLHVU_GST_Byte4 0;
BA_ "NetworkRequestHoldingTime" SG_ 3221225472 RLHVU_GST_Byte4 5000;
BA_ "Version" SG_ 3221225472 RLHVU_GST_Byte4 "18.03.03";
BA_ "UsrSigPurpose" SG_ 3221225472 RLHVU_GST_Byte5 2;
BA_ "GenSigSendType" SG_ 3221225472 RLHVU_GST_Byte5 2;
BA_ "UserSigValidity" SG_ 3221225472 RLHVU_GST_Byte5 0;
BA_ "GenSigTimeoutTime" SG_ 3221225472 RLHVU_GST_Byte5 0;
BA_ "NetworkRequest" SG_ 3221225472 RLHVU_GST_Byte5 0;
BA_ "NetworkRequestHoldingTime" SG_ 3221225472 RLHVU_GST_Byte5 5000;
BA_ "Version" SG_ 3221225472 RLHVU_GST_Byte5 "18.03.03";
BA_ "UsrSigPurpose" SG_ 3221225472 RLHVU_GST_Byte6 2;
BA_ "GenSigSendType" SG_ 3221225472 RLHVU_GST_Byte6 2;
BA_ "UserSigValidity" SG_ 3221225472 RLHVU_GST_Byte6 0;
BA_ "GenSigTimeoutTime" SG_ 3221225472 RLHVU_GST_Byte6 0;
BA_ "NetworkRequest" SG_ 3221225472 RLHVU_GST_Byte6 0;
BA_ "NetworkRequestHoldingTime" SG_ 3221225472 RLHVU_GST_Byte6 5000;
BA_ "Version" SG_ 3221225472 RLHVU_GST_Byte6 "18.03.03";
BA_ "UsrSigPurpose" SG_ 3221225472 RLHVU_GST_Byte7 2;
BA_ "GenSigSendType" SG_ 3221225472 RLHVU_GST_Byte7 2;
BA_ "UserSigValidity" SG_ 3221225472 RLHVU_GST_Byte7 0;
BA_ "GenSigTimeoutTime" SG_ 3221225472 RLHVU_GST_Byte7 0;
BA_ "NetworkRequest" SG_ 3221225472 RLHVU_GST_Byte7 0;
BA_ "NetworkRequestHoldingTime" SG_ 3221225472 RLHVU_GST_Byte7 5000;
BA_ "Version" SG_ 3221225472 RLHVU_GST_Byte7 "18.03.03";
BA_ "UsrSigPurpose" SG_ 3221225472 GST_ALL_Byte0 2;
BA_ "GenSigSendType" SG_ 3221225472 GST_ALL_Byte0 2;
BA_ "UserSigValidity" SG_ 3221225472 GST_ALL_Byte0 0;
BA_ "GenSigTimeoutTime" SG_ 3221225472 GST_ALL_Byte0 0;
BA_ "NetworkRequest" SG_ 3221225472 GST_ALL_Byte0 0;
BA_ "NetworkRequestHoldingTime" SG_ 3221225472 GST_ALL_Byte0 5000;
BA_ "Version" SG_ 3221225472 GST_ALL_Byte0 "18.02.01";
BA_ "UsrSigPurpose" SG_ 3221225472 GST_ALL_Byte1 2;
BA_ "GenSigSendType" SG_ 3221225472 GST_ALL_Byte1 2;
BA_ "UserSigValidity" SG_ 3221225472 GST_ALL_Byte1 0;
BA_ "GenSigTimeoutTime" SG_ 3221225472 GST_ALL_Byte1 0;
BA_ "NetworkRequest" SG_ 3221225472 GST_ALL_Byte1 0;
BA_ "NetworkRequestHoldingTime" SG_ 3221225472 GST_ALL_Byte1 5000;
BA_ "Version" SG_ 3221225472 GST_ALL_Byte1 "18.02.01";
BA_ "UsrSigPurpose" SG_ 3221225472 GST_ALL_Byte2 2;
BA_ "GenSigSendType" SG_ 3221225472 GST_ALL_Byte2 2;
BA_ "UserSigValidity" SG_ 3221225472 GST_ALL_Byte2 0;
BA_ "GenSigTimeoutTime" SG_ 3221225472 GST_ALL_Byte2 0;
BA_ "NetworkRequest" SG_ 3221225472 GST_ALL_Byte2 0;
BA_ "NetworkRequestHoldingTime" SG_ 3221225472 GST_ALL_Byte2 5000;
BA_ "Version" SG_ 3221225472 GST_ALL_Byte2 "18.02.01";
BA_ "UsrSigPurpose" SG_ 3221225472 GST_ALL_Byte3 2;
BA_ "GenSigSendType" SG_ 3221225472 GST_ALL_Byte3 2;
BA_ "UserSigValidity" SG_ 3221225472 GST_ALL_Byte3 0;
BA_ "GenSigTimeoutTime" SG_ 3221225472 GST_ALL_Byte3 0;
BA_ "NetworkRequest" SG_ 3221225472 GST_ALL_Byte3 0;
BA_ "NetworkRequestHoldingTime" SG_ 3221225472 GST_ALL_Byte3 5000;
BA_ "Version" SG_ 3221225472 GST_ALL_Byte3 "18.02.01";
BA_ "UsrSigPurpose" SG_ 3221225472 GST_ALL_Byte4 2;
BA_ "GenSigSendType" SG_ 3221225472 GST_ALL_Byte4 2;
BA_ "UserSigValidity" SG_ 3221225472 GST_ALL_Byte4 0;
BA_ "GenSigTimeoutTime" SG_ 3221225472 GST_ALL_Byte4 0;
BA_ "NetworkRequest" SG_ 3221225472 GST_ALL_Byte4 0;
BA_ "NetworkRequestHoldingTime" SG_ 3221225472 GST_ALL_Byte4 5000;
BA_ "Version" SG_ 3221225472 GST_ALL_Byte4 "18.02.01";
BA_ "UsrSigPurpose" SG_ 3221225472 GST_ALL_Byte5 2;
BA_ "GenSigSendType" SG_ 3221225472 GST_ALL_Byte5 2;
BA_ "UserSigValidity" SG_ 3221225472 GST_ALL_Byte5 0;
BA_ "GenSigTimeoutTime" SG_ 3221225472 GST_ALL_Byte5 0;
BA_ "NetworkRequest" SG_ 3221225472 GST_ALL_Byte5 0;
BA_ "NetworkRequestHoldingTime" SG_ 3221225472 GST_ALL_Byte5 5000;
BA_ "Version" SG_ 3221225472 GST_ALL_Byte5 "18.02.01";
BA_ "UsrSigPurpose" SG_ 3221225472 GST_ALL_Byte6 2;
BA_ "GenSigSendType" SG_ 3221225472 GST_ALL_Byte6 2;
BA_ "UserSigValidity" SG_ 3221225472 GST_ALL_Byte6 0;
BA_ "GenSigTimeoutTime" SG_ 3221225472 GST_ALL_Byte6 0;
BA_ "NetworkRequest" SG_ 3221225472 GST_ALL_Byte6 0;
BA_ "NetworkRequestHoldingTime" SG_ 3221225472 GST_ALL_Byte6 5000;
BA_ "Version" SG_ 3221225472 GST_ALL_Byte6 "18.02.01";
BA_ "UsrSigPurpose" SG_ 3221225472 GST_ALL_Byte7 2;
BA_ "GenSigSendType" SG_ 3221225472 GST_ALL_Byte7 2;
BA_ "UserSigValidity" SG_ 3221225472 GST_ALL_Byte7 0;
BA_ "GenSigTimeoutTime" SG_ 3221225472 GST_ALL_Byte7 0;
BA_ "NetworkRequest" SG_ 3221225472 GST_ALL_Byte7 0;
BA_ "NetworkRequestHoldingTime" SG_ 3221225472 GST_ALL_Byte7 5000;
BA_ "Version" SG_ 3221225472 GST_ALL_Byte7 "18.02.01";
BA_ "UsrSigPurpose" SG_ 3221225472 ILCU_LH_GST_Byte0 2;
BA_ "GenSigSendType" SG_ 3221225472 ILCU_LH_GST_Byte0 2;
BA_ "UserSigValidity" SG_ 3221225472 ILCU_LH_GST_Byte0 0;
BA_ "GenSigTimeoutTime" SG_ 3221225472 ILCU_LH_GST_Byte0 0;
BA_ "NetworkRequest" SG_ 3221225472 ILCU_LH_GST_Byte0 0;
BA_ "NetworkRequestHoldingTime" SG_ 3221225472 ILCU_LH_GST_Byte0 5000;
BA_ "Version" SG_ 3221225472 ILCU_LH_GST_Byte0 "18.02.02";
BA_ "UsrSigPurpose" SG_ 3221225472 ILCU_LH_GST_Byte1 2;
BA_ "GenSigSendType" SG_ 3221225472 ILCU_LH_GST_Byte1 2;
BA_ "UserSigValidity" SG_ 3221225472 ILCU_LH_GST_Byte1 0;
BA_ "GenSigTimeoutTime" SG_ 3221225472 ILCU_LH_GST_Byte1 0;
BA_ "NetworkRequest" SG_ 3221225472 ILCU_LH_GST_Byte1 0;
BA_ "NetworkRequestHoldingTime" SG_ 3221225472 ILCU_LH_GST_Byte1 5000;
BA_ "Version" SG_ 3221225472 ILCU_LH_GST_Byte1 "18.02.02";
BA_ "UsrSigPurpose" SG_ 3221225472 ILCU_LH_GST_Byte2 2;
BA_ "GenSigSendType" SG_ 3221225472 ILCU_LH_GST_Byte2 2;
BA_ "UserSigValidity" SG_ 3221225472 ILCU_LH_GST_Byte2 0;
BA_ "GenSigTimeoutTime" SG_ 3221225472 ILCU_LH_GST_Byte2 0;
BA_ "NetworkRequest" SG_ 3221225472 ILCU_LH_GST_Byte2 0;
BA_ "NetworkRequestHoldingTime" SG_ 3221225472 ILCU_LH_GST_Byte2 5000;
BA_ "Version" SG_ 3221225472 ILCU_LH_GST_Byte2 "18.02.02";
BA_ "UsrSigPurpose" SG_ 3221225472 ILCU_LH_GST_Byte3 2;
BA_ "GenSigSendType" SG_ 3221225472 ILCU_LH_GST_Byte3 2;
BA_ "UserSigValidity" SG_ 3221225472 ILCU_LH_GST_Byte3 0;
BA_ "GenSigTimeoutTime" SG_ 3221225472 ILCU_LH_GST_Byte3 0;
BA_ "NetworkRequest" SG_ 3221225472 ILCU_LH_GST_Byte3 0;
BA_ "NetworkRequestHoldingTime" SG_ 3221225472 ILCU_LH_GST_Byte3 5000;
BA_ "Version" SG_ 3221225472 ILCU_LH_GST_Byte3 "18.02.02";
BA_ "UsrSigPurpose" SG_ 3221225472 ILCU_LH_GST_Byte4 2;
BA_ "GenSigSendType" SG_ 3221225472 ILCU_LH_GST_Byte4 2;
BA_ "UserSigValidity" SG_ 3221225472 ILCU_LH_GST_Byte4 0;
BA_ "GenSigTimeoutTime" SG_ 3221225472 ILCU_LH_GST_Byte4 0;
BA_ "NetworkRequest" SG_ 3221225472 ILCU_LH_GST_Byte4 0;
BA_ "NetworkRequestHoldingTime" SG_ 3221225472 ILCU_LH_GST_Byte4 5000;
BA_ "Version" SG_ 3221225472 ILCU_LH_GST_Byte4 "18.02.02";
BA_ "UsrSigPurpose" SG_ 3221225472 ILCU_LH_GST_Byte5 2;
BA_ "GenSigSendType" SG_ 3221225472 ILCU_LH_GST_Byte5 2;
BA_ "UserSigValidity" SG_ 3221225472 ILCU_LH_GST_Byte5 0;
BA_ "GenSigTimeoutTime" SG_ 3221225472 ILCU_LH_GST_Byte5 0;
BA_ "NetworkRequest" SG_ 3221225472 ILCU_LH_GST_Byte5 0;
BA_ "NetworkRequestHoldingTime" SG_ 3221225472 ILCU_LH_GST_Byte5 5000;
BA_ "Version" SG_ 3221225472 ILCU_LH_GST_Byte5 "18.02.02";
BA_ "UsrSigPurpose" SG_ 3221225472 ILCU_LH_GST_Byte6 2;
BA_ "GenSigSendType" SG_ 3221225472 ILCU_LH_GST_Byte6 2;
BA_ "UserSigValidity" SG_ 3221225472 ILCU_LH_GST_Byte6 0;
BA_ "GenSigTimeoutTime" SG_ 3221225472 ILCU_LH_GST_Byte6 0;
BA_ "NetworkRequest" SG_ 3221225472 ILCU_LH_GST_Byte6 0;
BA_ "NetworkRequestHoldingTime" SG_ 3221225472 ILCU_LH_GST_Byte6 5000;
BA_ "Version" SG_ 3221225472 ILCU_LH_GST_Byte6 "18.02.02";
BA_ "UsrSigPurpose" SG_ 3221225472 ILCU_LH_GST_Byte7 2;
BA_ "GenSigSendType" SG_ 3221225472 ILCU_LH_GST_Byte7 2;
BA_ "UserSigValidity" SG_ 3221225472 ILCU_LH_GST_Byte7 0;
BA_ "GenSigTimeoutTime" SG_ 3221225472 ILCU_LH_GST_Byte7 0;
BA_ "NetworkRequest" SG_ 3221225472 ILCU_LH_GST_Byte7 0;
BA_ "NetworkRequestHoldingTime" SG_ 3221225472 ILCU_LH_GST_Byte7 5000;
BA_ "Version" SG_ 3221225472 ILCU_LH_GST_Byte7 "18.02.02";
BA_ "UsrSigPurpose" SG_ 3221225472 ILCU_RH_GST_Byte0 2;
BA_ "GenSigSendType" SG_ 3221225472 ILCU_RH_GST_Byte0 2;
BA_ "UserSigValidity" SG_ 3221225472 ILCU_RH_GST_Byte0 0;
BA_ "GenSigTimeoutTime" SG_ 3221225472 ILCU_RH_GST_Byte0 0;
BA_ "NetworkRequest" SG_ 3221225472 ILCU_RH_GST_Byte0 0;
BA_ "NetworkRequestHoldingTime" SG_ 3221225472 ILCU_RH_GST_Byte0 5000;
BA_ "Version" SG_ 3221225472 ILCU_RH_GST_Byte0 "18.02.02";
BA_ "UsrSigPurpose" SG_ 3221225472 ILCU_RH_GST_Byte1 2;
BA_ "GenSigSendType" SG_ 3221225472 ILCU_RH_GST_Byte1 2;
BA_ "UserSigValidity" SG_ 3221225472 ILCU_RH_GST_Byte1 0;
BA_ "GenSigTimeoutTime" SG_ 3221225472 ILCU_RH_GST_Byte1 0;
BA_ "NetworkRequest" SG_ 3221225472 ILCU_RH_GST_Byte1 0;
BA_ "NetworkRequestHoldingTime" SG_ 3221225472 ILCU_RH_GST_Byte1 5000;
BA_ "Version" SG_ 3221225472 ILCU_RH_GST_Byte1 "18.02.02";
BA_ "UsrSigPurpose" SG_ 3221225472 ILCU_RH_GST_Byte2 2;
BA_ "GenSigSendType" SG_ 3221225472 ILCU_RH_GST_Byte2 2;
BA_ "UserSigValidity" SG_ 3221225472 ILCU_RH_GST_Byte2 0;
BA_ "GenSigTimeoutTime" SG_ 3221225472 ILCU_RH_GST_Byte2 0;
BA_ "NetworkRequest" SG_ 3221225472 ILCU_RH_GST_Byte2 0;
BA_ "NetworkRequestHoldingTime" SG_ 3221225472 ILCU_RH_GST_Byte2 5000;
BA_ "Version" SG_ 3221225472 ILCU_RH_GST_Byte2 "18.02.02";
BA_ "UsrSigPurpose" SG_ 3221225472 ILCU_RH_GST_Byte3 2;
BA_ "GenSigSendType" SG_ 3221225472 ILCU_RH_GST_Byte3 2;
BA_ "UserSigValidity" SG_ 3221225472 ILCU_RH_GST_Byte3 0;
BA_ "GenSigTimeoutTime" SG_ 3221225472 ILCU_RH_GST_Byte3 0;
BA_ "NetworkRequest" SG_ 3221225472 ILCU_RH_GST_Byte3 0;
BA_ "NetworkRequestHoldingTime" SG_ 3221225472 ILCU_RH_GST_Byte3 5000;
BA_ "Version" SG_ 3221225472 ILCU_RH_GST_Byte3 "18.02.02";
BA_ "UsrSigPurpose" SG_ 3221225472 ILCU_RH_GST_Byte4 2;
BA_ "GenSigSendType" SG_ 3221225472 ILCU_RH_GST_Byte4 2;
BA_ "UserSigValidity" SG_ 3221225472 ILCU_RH_GST_Byte4 0;
BA_ "GenSigTimeoutTime" SG_ 3221225472 ILCU_RH_GST_Byte4 0;
BA_ "NetworkRequest" SG_ 3221225472 ILCU_RH_GST_Byte4 0;
BA_ "NetworkRequestHoldingTime" SG_ 3221225472 ILCU_RH_GST_Byte4 5000;
BA_ "Version" SG_ 3221225472 ILCU_RH_GST_Byte4 "18.02.02";
BA_ "UsrSigPurpose" SG_ 3221225472 ILCU_RH_GST_Byte5 2;
BA_ "GenSigSendType" SG_ 3221225472 ILCU_RH_GST_Byte5 2;
BA_ "UserSigValidity" SG_ 3221225472 ILCU_RH_GST_Byte5 0;
BA_ "GenSigTimeoutTime" SG_ 3221225472 ILCU_RH_GST_Byte5 0;
BA_ "NetworkRequest" SG_ 3221225472 ILCU_RH_GST_Byte5 0;
BA_ "NetworkRequestHoldingTime" SG_ 3221225472 ILCU_RH_GST_Byte5 5000;
BA_ "Version" SG_ 3221225472 ILCU_RH_GST_Byte5 "18.02.02";
BA_ "UsrSigPurpose" SG_ 3221225472 ILCU_RH_GST_Byte6 2;
BA_ "GenSigSendType" SG_ 3221225472 ILCU_RH_GST_Byte6 2;
BA_ "UserSigValidity" SG_ 3221225472 ILCU_RH_GST_Byte6 0;
BA_ "GenSigTimeoutTime" SG_ 3221225472 ILCU_RH_GST_Byte6 0;
BA_ "NetworkRequest" SG_ 3221225472 ILCU_RH_GST_Byte6 0;
BA_ "NetworkRequestHoldingTime" SG_ 3221225472 ILCU_RH_GST_Byte6 5000;
BA_ "Version" SG_ 3221225472 ILCU_RH_GST_Byte6 "18.02.02";
BA_ "UsrSigPurpose" SG_ 3221225472 ILCU_RH_GST_Byte7 2;
BA_ "GenSigSendType" SG_ 3221225472 ILCU_RH_GST_Byte7 2;
BA_ "UserSigValidity" SG_ 3221225472 ILCU_RH_GST_Byte7 0;
BA_ "GenSigTimeoutTime" SG_ 3221225472 ILCU_RH_GST_Byte7 0;
BA_ "NetworkRequest" SG_ 3221225472 ILCU_RH_GST_Byte7 0;
BA_ "NetworkRequestHoldingTime" SG_ 3221225472 ILCU_RH_GST_Byte7 5000;
BA_ "Version" SG_ 3221225472 ILCU_RH_GST_Byte7 "18.02.02";
BA_ "UsrSigPurpose" SG_ 3221225472 GST_ALU_Byte0 2;
BA_ "GenSigSendType" SG_ 3221225472 GST_ALU_Byte0 2;
BA_ "UserSigValidity" SG_ 3221225472 GST_ALU_Byte0 0;
BA_ "GenSigTimeoutTime" SG_ 3221225472 GST_ALU_Byte0 0;
BA_ "NetworkRequest" SG_ 3221225472 GST_ALU_Byte0 0;
BA_ "NetworkRequestHoldingTime" SG_ 3221225472 GST_ALU_Byte0 5000;
BA_ "Version" SG_ 3221225472 GST_ALU_Byte0 "18.03.03";
BA_ "UsrSigPurpose" SG_ 3221225472 GST_ALU_Byte1 2;
BA_ "GenSigSendType" SG_ 3221225472 GST_ALU_Byte1 2;
BA_ "UserSigValidity" SG_ 3221225472 GST_ALU_Byte1 0;
BA_ "GenSigTimeoutTime" SG_ 3221225472 GST_ALU_Byte1 0;
BA_ "NetworkRequest" SG_ 3221225472 GST_ALU_Byte1 0;
BA_ "NetworkRequestHoldingTime" SG_ 3221225472 GST_ALU_Byte1 5000;
BA_ "Version" SG_ 3221225472 GST_ALU_Byte1 "18.03.03";
BA_ "UsrSigPurpose" SG_ 3221225472 GST_ALU_Byte2 2;
BA_ "GenSigSendType" SG_ 3221225472 GST_ALU_Byte2 2;
BA_ "UserSigValidity" SG_ 3221225472 GST_ALU_Byte2 0;
BA_ "GenSigTimeoutTime" SG_ 3221225472 GST_ALU_Byte2 0;
BA_ "NetworkRequest" SG_ 3221225472 GST_ALU_Byte2 0;
BA_ "NetworkRequestHoldingTime" SG_ 3221225472 GST_ALU_Byte2 5000;
BA_ "Version" SG_ 3221225472 GST_ALU_Byte2 "18.03.03";
BA_ "UsrSigPurpose" SG_ 3221225472 GST_ALU_Byte3 2;
BA_ "GenSigSendType" SG_ 3221225472 GST_ALU_Byte3 2;
BA_ "UserSigValidity" SG_ 3221225472 GST_ALU_Byte3 0;
BA_ "GenSigTimeoutTime" SG_ 3221225472 GST_ALU_Byte3 0;
BA_ "NetworkRequest" SG_ 3221225472 GST_ALU_Byte3 0;
BA_ "NetworkRequestHoldingTime" SG_ 3221225472 GST_ALU_Byte3 5000;
BA_ "Version" SG_ 3221225472 GST_ALU_Byte3 "18.03.03";
BA_ "UsrSigPurpose" SG_ 3221225472 GST_ALU_Byte4 2;
BA_ "GenSigSendType" SG_ 3221225472 GST_ALU_Byte4 2;
BA_ "UserSigValidity" SG_ 3221225472 GST_ALU_Byte4 0;
BA_ "GenSigTimeoutTime" SG_ 3221225472 GST_ALU_Byte4 0;
BA_ "NetworkRequest" SG_ 3221225472 GST_ALU_Byte4 0;
BA_ "NetworkRequestHoldingTime" SG_ 3221225472 GST_ALU_Byte4 5000;
BA_ "Version" SG_ 3221225472 GST_ALU_Byte4 "18.03.03";
BA_ "UsrSigPurpose" SG_ 3221225472 GST_ALU_Byte5 2;
BA_ "GenSigSendType" SG_ 3221225472 GST_ALU_Byte5 2;
BA_ "UserSigValidity" SG_ 3221225472 GST_ALU_Byte5 0;
BA_ "GenSigTimeoutTime" SG_ 3221225472 GST_ALU_Byte5 0;
BA_ "NetworkRequest" SG_ 3221225472 GST_ALU_Byte5 0;
BA_ "NetworkRequestHoldingTime" SG_ 3221225472 GST_ALU_Byte5 5000;
BA_ "Version" SG_ 3221225472 GST_ALU_Byte5 "18.03.03";
BA_ "UsrSigPurpose" SG_ 3221225472 GST_ALU_Byte6 2;
BA_ "GenSigSendType" SG_ 3221225472 GST_ALU_Byte6 2;
BA_ "UserSigValidity" SG_ 3221225472 GST_ALU_Byte6 0;
BA_ "GenSigTimeoutTime" SG_ 3221225472 GST_ALU_Byte6 0;
BA_ "NetworkRequest" SG_ 3221225472 GST_ALU_Byte6 0;
BA_ "NetworkRequestHoldingTime" SG_ 3221225472 GST_ALU_Byte6 5000;
BA_ "Version" SG_ 3221225472 GST_ALU_Byte6 "18.03.03";
BA_ "UsrSigPurpose" SG_ 3221225472 GST_ALU_Byte7 2;
BA_ "GenSigSendType" SG_ 3221225472 GST_ALU_Byte7 2;
BA_ "UserSigValidity" SG_ 3221225472 GST_ALU_Byte7 0;
BA_ "GenSigTimeoutTime" SG_ 3221225472 GST_ALU_Byte7 0;
BA_ "NetworkRequest" SG_ 3221225472 GST_ALU_Byte7 0;
BA_ "NetworkRequestHoldingTime" SG_ 3221225472 GST_ALU_Byte7 5000;
BA_ "Version" SG_ 3221225472 GST_ALU_Byte7 "18.03.03";
BA_ "UsrSigPurpose" SG_ 3221225472 GST_PFSU_Byte0 2;
BA_ "GenSigSendType" SG_ 3221225472 GST_PFSU_Byte0 2;
BA_ "UserSigValidity" SG_ 3221225472 GST_PFSU_Byte0 0;
BA_ "GenSigTimeoutTime" SG_ 3221225472 GST_PFSU_Byte0 0;
BA_ "NetworkRequest" SG_ 3221225472 GST_PFSU_Byte0 0;
BA_ "NetworkRequestHoldingTime" SG_ 3221225472 GST_PFSU_Byte0 5000;
BA_ "Version" SG_ 3221225472 GST_PFSU_Byte0 "18.03.03";
BA_ "UsrSigPurpose" SG_ 3221225472 GST_PFSU_Byte1 2;
BA_ "GenSigSendType" SG_ 3221225472 GST_PFSU_Byte1 2;
BA_ "UserSigValidity" SG_ 3221225472 GST_PFSU_Byte1 0;
BA_ "GenSigTimeoutTime" SG_ 3221225472 GST_PFSU_Byte1 0;
BA_ "NetworkRequest" SG_ 3221225472 GST_PFSU_Byte1 0;
BA_ "NetworkRequestHoldingTime" SG_ 3221225472 GST_PFSU_Byte1 5000;
BA_ "Version" SG_ 3221225472 GST_PFSU_Byte1 "18.03.03";
BA_ "UsrSigPurpose" SG_ 3221225472 GST_PFSU_Byte2 2;
BA_ "GenSigSendType" SG_ 3221225472 GST_PFSU_Byte2 2;
BA_ "UserSigValidity" SG_ 3221225472 GST_PFSU_Byte2 0;
BA_ "GenSigTimeoutTime" SG_ 3221225472 GST_PFSU_Byte2 0;
BA_ "NetworkRequest" SG_ 3221225472 GST_PFSU_Byte2 0;
BA_ "NetworkRequestHoldingTime" SG_ 3221225472 GST_PFSU_Byte2 5000;
BA_ "Version" SG_ 3221225472 GST_PFSU_Byte2 "18.03.03";
BA_ "UsrSigPurpose" SG_ 3221225472 GST_PFSU_Byte3 2;
BA_ "GenSigSendType" SG_ 3221225472 GST_PFSU_Byte3 2;
BA_ "UserSigValidity" SG_ 3221225472 GST_PFSU_Byte3 0;
BA_ "GenSigTimeoutTime" SG_ 3221225472 GST_PFSU_Byte3 0;
BA_ "NetworkRequest" SG_ 3221225472 GST_PFSU_Byte3 0;
BA_ "NetworkRequestHoldingTime" SG_ 3221225472 GST_PFSU_Byte3 5000;
BA_ "Version" SG_ 3221225472 GST_PFSU_Byte3 "18.03.03";
BA_ "UsrSigPurpose" SG_ 3221225472 GST_PFSU_Byte4 2;
BA_ "GenSigSendType" SG_ 3221225472 GST_PFSU_Byte4 2;
BA_ "UserSigValidity" SG_ 3221225472 GST_PFSU_Byte4 0;
BA_ "GenSigTimeoutTime" SG_ 3221225472 GST_PFSU_Byte4 0;
BA_ "NetworkRequest" SG_ 3221225472 GST_PFSU_Byte4 0;
BA_ "NetworkRequestHoldingTime" SG_ 3221225472 GST_PFSU_Byte4 5000;
BA_ "Version" SG_ 3221225472 GST_PFSU_Byte4 "18.03.03";
BA_ "UsrSigPurpose" SG_ 3221225472 GST_PFSU_Byte5 2;
BA_ "GenSigSendType" SG_ 3221225472 GST_PFSU_Byte5 2;
BA_ "UserSigValidity" SG_ 3221225472 GST_PFSU_Byte5 0;
BA_ "GenSigTimeoutTime" SG_ 3221225472 GST_PFSU_Byte5 0;
BA_ "NetworkRequest" SG_ 3221225472 GST_PFSU_Byte5 0;
BA_ "NetworkRequestHoldingTime" SG_ 3221225472 GST_PFSU_Byte5 5000;
BA_ "Version" SG_ 3221225472 GST_PFSU_Byte5 "18.03.03";
BA_ "UsrSigPurpose" SG_ 3221225472 GST_PFSU_Byte6 2;
BA_ "GenSigSendType" SG_ 3221225472 GST_PFSU_Byte6 2;
BA_ "UserSigValidity" SG_ 3221225472 GST_PFSU_Byte6 0;
BA_ "GenSigTimeoutTime" SG_ 3221225472 GST_PFSU_Byte6 0;
BA_ "NetworkRequest" SG_ 3221225472 GST_PFSU_Byte6 0;
BA_ "NetworkRequestHoldingTime" SG_ 3221225472 GST_PFSU_Byte6 5000;
BA_ "Version" SG_ 3221225472 GST_PFSU_Byte6 "18.03.03";
BA_ "UsrSigPurpose" SG_ 3221225472 GST_PFSU_Byte7 2;
BA_ "GenSigSendType" SG_ 3221225472 GST_PFSU_Byte7 2;
BA_ "UserSigValidity" SG_ 3221225472 GST_PFSU_Byte7 0;
BA_ "GenSigTimeoutTime" SG_ 3221225472 GST_PFSU_Byte7 0;
BA_ "NetworkRequest" SG_ 3221225472 GST_PFSU_Byte7 0;
BA_ "NetworkRequestHoldingTime" SG_ 3221225472 GST_PFSU_Byte7 5000;
BA_ "Version" SG_ 3221225472 GST_PFSU_Byte7 "18.03.03";
BA_ "UsrSigPurpose" SG_ 3221225472 GST_PSB_Byte0 2;
BA_ "GenSigSendType" SG_ 3221225472 GST_PSB_Byte0 2;
BA_ "UserSigValidity" SG_ 3221225472 GST_PSB_Byte0 0;
BA_ "GenSigTimeoutTime" SG_ 3221225472 GST_PSB_Byte0 0;
BA_ "NetworkRequest" SG_ 3221225472 GST_PSB_Byte0 0;
BA_ "NetworkRequestHoldingTime" SG_ 3221225472 GST_PSB_Byte0 5000;
BA_ "Version" SG_ 3221225472 GST_PSB_Byte0 "18.01.09";
BA_ "UsrSigPurpose" SG_ 3221225472 GST_PSB_Byte1 2;
BA_ "GenSigSendType" SG_ 3221225472 GST_PSB_Byte1 2;
BA_ "UserSigValidity" SG_ 3221225472 GST_PSB_Byte1 0;
BA_ "GenSigTimeoutTime" SG_ 3221225472 GST_PSB_Byte1 0;
BA_ "NetworkRequest" SG_ 3221225472 GST_PSB_Byte1 0;
BA_ "NetworkRequestHoldingTime" SG_ 3221225472 GST_PSB_Byte1 5000;
BA_ "Version" SG_ 3221225472 GST_PSB_Byte1 "18.01.09";
BA_ "UsrSigPurpose" SG_ 3221225472 GST_PSB_Byte2 2;
BA_ "GenSigSendType" SG_ 3221225472 GST_PSB_Byte2 2;
BA_ "UserSigValidity" SG_ 3221225472 GST_PSB_Byte2 0;
BA_ "GenSigTimeoutTime" SG_ 3221225472 GST_PSB_Byte2 0;
BA_ "NetworkRequest" SG_ 3221225472 GST_PSB_Byte2 0;
BA_ "NetworkRequestHoldingTime" SG_ 3221225472 GST_PSB_Byte2 5000;
BA_ "Version" SG_ 3221225472 GST_PSB_Byte2 "18.01.09";
BA_ "UsrSigPurpose" SG_ 3221225472 GST_PSB_Byte3 2;
BA_ "GenSigSendType" SG_ 3221225472 GST_PSB_Byte3 2;
BA_ "UserSigValidity" SG_ 3221225472 GST_PSB_Byte3 0;
BA_ "GenSigTimeoutTime" SG_ 3221225472 GST_PSB_Byte3 0;
BA_ "NetworkRequest" SG_ 3221225472 GST_PSB_Byte3 0;
BA_ "NetworkRequestHoldingTime" SG_ 3221225472 GST_PSB_Byte3 5000;
BA_ "Version" SG_ 3221225472 GST_PSB_Byte3 "18.01.09";
BA_ "UsrSigPurpose" SG_ 3221225472 GST_PSB_Byte4 2;
BA_ "GenSigSendType" SG_ 3221225472 GST_PSB_Byte4 2;
BA_ "UserSigValidity" SG_ 3221225472 GST_PSB_Byte4 0;
BA_ "GenSigTimeoutTime" SG_ 3221225472 GST_PSB_Byte4 0;
BA_ "NetworkRequest" SG_ 3221225472 GST_PSB_Byte4 0;
BA_ "NetworkRequestHoldingTime" SG_ 3221225472 GST_PSB_Byte4 5000;
BA_ "Version" SG_ 3221225472 GST_PSB_Byte4 "18.01.09";
BA_ "UsrSigPurpose" SG_ 3221225472 GST_PSB_Byte5 2;
BA_ "GenSigSendType" SG_ 3221225472 GST_PSB_Byte5 2;
BA_ "UserSigValidity" SG_ 3221225472 GST_PSB_Byte5 0;
BA_ "GenSigTimeoutTime" SG_ 3221225472 GST_PSB_Byte5 0;
BA_ "NetworkRequest" SG_ 3221225472 GST_PSB_Byte5 0;
BA_ "NetworkRequestHoldingTime" SG_ 3221225472 GST_PSB_Byte5 5000;
BA_ "Version" SG_ 3221225472 GST_PSB_Byte5 "18.01.09";
BA_ "UsrSigPurpose" SG_ 3221225472 GST_PSB_Byte6 2;
BA_ "GenSigSendType" SG_ 3221225472 GST_PSB_Byte6 2;
BA_ "UserSigValidity" SG_ 3221225472 GST_PSB_Byte6 0;
BA_ "GenSigTimeoutTime" SG_ 3221225472 GST_PSB_Byte6 0;
BA_ "NetworkRequest" SG_ 3221225472 GST_PSB_Byte6 0;
BA_ "NetworkRequestHoldingTime" SG_ 3221225472 GST_PSB_Byte6 5000;
BA_ "Version" SG_ 3221225472 GST_PSB_Byte6 "18.01.09";
BA_ "UsrSigPurpose" SG_ 3221225472 GST_PSB_Byte7 2;
BA_ "GenSigSendType" SG_ 3221225472 GST_PSB_Byte7 2;
BA_ "UserSigValidity" SG_ 3221225472 GST_PSB_Byte7 0;
BA_ "GenSigTimeoutTime" SG_ 3221225472 GST_PSB_Byte7 0;
BA_ "NetworkRequest" SG_ 3221225472 GST_PSB_Byte7 0;
BA_ "NetworkRequestHoldingTime" SG_ 3221225472 GST_PSB_Byte7 5000;
BA_ "Version" SG_ 3221225472 GST_PSB_Byte7 "18.01.09";
BA_ "Description" SG_ 3221225472 CLU_Crc1Val "The CRC checking process calculates the CRC over the entire data block, including the CRC result.

- CRC Polynomial (0x1021) , Initial Value : 0xFFFF, XOR value : 0x0000

- The mathematical expression to 16 bit CRC polynomial is given here. G(x) = x16 + ";
BA_ "GenSigStartValue" SG_ 3221225472 CLU_Crc1Val 65535;
BA_ "UserSigValidity" SG_ 3221225472 CLU_Crc1Val 3;
BA_ "GenSigTimeoutTime" SG_ 3221225472 CLU_Crc1Val 1500;
BA_ "RoutingFactor" SG_ 3221225472 CLU_Crc1Val 5;
BA_ "Version" SG_ 3221225472 CLU_Crc1Val "17.11.00";
BA_ "Description" SG_ 3221225472 CLU_AlvCnt1Val "For the first transmission request for a data element the counter shall be initialized with 0 and shall be incremented by 1

for every subsequent send request. When the counter reaches the maximum value(0xFF), then it shall restart with ? for the next se";
BA_ "UserSigValidity" SG_ 3221225472 CLU_AlvCnt1Val 3;
BA_ "GenSigTimeoutTime" SG_ 3221225472 CLU_AlvCnt1Val 1500;
BA_ "RoutingFactor" SG_ 3221225472 CLU_AlvCnt1Val 5;
BA_ "Version" SG_ 3221225472 CLU_AlvCnt1Val "17.11.00";
BA_ "Description" SG_ 3221225472 CLU_PrtyBitSta "TBD (레이아웃 결정 후 로직 수정)";
BA_ "UserSigValidity" SG_ 3221225472 CLU_PrtyBitSta 3;
BA_ "GenSigTimeoutTime" SG_ 3221225472 CLU_PrtyBitSta 1500;
BA_ "RoutingFactor" SG_ 3221225472 CLU_PrtyBitSta 5;
BA_ "Version" SG_ 3221225472 CLU_PrtyBitSta "17.11.00";
BA_ "Description" SG_ 3221225472 CLU_PdwDisTyp "Cluster Display information";
BA_ "UserSigValidity" SG_ 3221225472 CLU_PdwDisTyp 3;
BA_ "GenSigTimeoutTime" SG_ 3221225472 CLU_PdwDisTyp 1500;
BA_ "RoutingFactor" SG_ 3221225472 CLU_PdwDisTyp 5;
BA_ "Version" SG_ 3221225472 CLU_PdwDisTyp "17.11.00";
BA_ "Description" SG_ 3221225472 CLU_DtntOutSta "This signal indicates the status of detent illumination. Cluster sends the detent information for a Unified Illumination system.";
BA_ "UserSigValidity" SG_ 3221225472 CLU_DtntOutSta 0;
BA_ "GenSigTimeoutTime" SG_ 3221225472 CLU_DtntOutSta 1500;
BA_ "RoutingFactor" SG_ 3221225472 CLU_DtntOutSta 5;
BA_ "Version" SG_ 3221225472 CLU_DtntOutSta "17.11.00";
BA_ "Description" SG_ 3221225472 CLU_SpdUnitTyp "This signal indicates the unit of the speed displayed in the speedometer.";
BA_ "UserSigValidity" SG_ 3221225472 CLU_SpdUnitTyp 3;
BA_ "GenSigTimeoutTime" SG_ 3221225472 CLU_SpdUnitTyp 1500;
BA_ "RoutingFactor" SG_ 3221225472 CLU_SpdUnitTyp 5;
BA_ "Version" SG_ 3221225472 CLU_SpdUnitTyp "17.11.00";
BA_ "Description" SG_ 3221225472 CLU_DisSpdDcmlVal "The signal 'CF_Clu_VanzDecimal' means the extra value of the signal 'CF_Clu_Vanz' (vehicle speed which is indicated in the speedometer)

Also, This signal should be sent in km/h or MPH according to the 'CF_Clu_SPEED_UNIT' signal.

CF_Clu_SPEED_UNIT = 0 :";
BA_ "UserSigValidity" SG_ 3221225472 CLU_DisSpdDcmlVal 3;
BA_ "GenSigTimeoutTime" SG_ 3221225472 CLU_DisSpdDcmlVal 1500;
BA_ "RoutingFactor" SG_ 3221225472 CLU_DisSpdDcmlVal 5;
BA_ "Version" SG_ 3221225472 CLU_DisSpdDcmlVal "17.11.00";
BA_ "Description" SG_ 3221225472 CLU_RhstaLvlSta "This signal is used for a rheostat level of CLUSTER from 1 to 21 level (21 level : Detent) for a Unified Illumination system.



※ Start Value : Current value";
BA_ "UserSigValidity" SG_ 3221225472 CLU_RhstaLvlSta 0;
BA_ "GenSigTimeoutTime" SG_ 3221225472 CLU_RhstaLvlSta 1500;
BA_ "RoutingFactor" SG_ 3221225472 CLU_RhstaLvlSta 5;
BA_ "Version" SG_ 3221225472 CLU_RhstaLvlSta "17.11.00";
BA_ "Description" SG_ 3221225472 CLU_DisSpdVal "The vehicle speed which is indicated in the speedmeter has to be sent to SCC. This value is used for evalution of SCC command values instead of the vehicle velocity in order to avoid significant difference between the speedmeter indicator and the set spe";
BA_ "UserSigValidity" SG_ 3221225472 CLU_DisSpdVal 3;
BA_ "GenSigTimeoutTime" SG_ 3221225472 CLU_DisSpdVal 1500;
BA_ "RoutingFactor" SG_ 3221225472 CLU_DisSpdVal 5;
BA_ "Version" SG_ 3221225472 CLU_DisSpdVal "17.12.03";
BA_ "UsrSigPurpose" SG_ 3221225472 GST_APSS_Byte0 2;
BA_ "GenSigSendType" SG_ 3221225472 GST_APSS_Byte0 2;
BA_ "UserSigValidity" SG_ 3221225472 GST_APSS_Byte0 0;
BA_ "GenSigTimeoutTime" SG_ 3221225472 GST_APSS_Byte0 0;
BA_ "NetworkRequest" SG_ 3221225472 GST_APSS_Byte0 0;
BA_ "NetworkRequestHoldingTime" SG_ 3221225472 GST_APSS_Byte0 5000;
BA_ "Version" SG_ 3221225472 GST_APSS_Byte0 "18.03.03";
BA_ "UsrSigPurpose" SG_ 3221225472 GST_APSS_Byte1 2;
BA_ "GenSigSendType" SG_ 3221225472 GST_APSS_Byte1 2;
BA_ "UserSigValidity" SG_ 3221225472 GST_APSS_Byte1 0;
BA_ "GenSigTimeoutTime" SG_ 3221225472 GST_APSS_Byte1 0;
BA_ "NetworkRequest" SG_ 3221225472 GST_APSS_Byte1 0;
BA_ "NetworkRequestHoldingTime" SG_ 3221225472 GST_APSS_Byte1 5000;
BA_ "Version" SG_ 3221225472 GST_APSS_Byte1 "18.03.03";
BA_ "UsrSigPurpose" SG_ 3221225472 GST_APSS_Byte2 2;
BA_ "GenSigSendType" SG_ 3221225472 GST_APSS_Byte2 2;
BA_ "UserSigValidity" SG_ 3221225472 GST_APSS_Byte2 0;
BA_ "GenSigTimeoutTime" SG_ 3221225472 GST_APSS_Byte2 0;
BA_ "NetworkRequest" SG_ 3221225472 GST_APSS_Byte2 0;
BA_ "NetworkRequestHoldingTime" SG_ 3221225472 GST_APSS_Byte2 5000;
BA_ "Version" SG_ 3221225472 GST_APSS_Byte2 "18.03.03";
BA_ "UsrSigPurpose" SG_ 3221225472 GST_APSS_Byte3 2;
BA_ "GenSigSendType" SG_ 3221225472 GST_APSS_Byte3 2;
BA_ "UserSigValidity" SG_ 3221225472 GST_APSS_Byte3 0;
BA_ "GenSigTimeoutTime" SG_ 3221225472 GST_APSS_Byte3 0;
BA_ "NetworkRequest" SG_ 3221225472 GST_APSS_Byte3 0;
BA_ "NetworkRequestHoldingTime" SG_ 3221225472 GST_APSS_Byte3 5000;
BA_ "Version" SG_ 3221225472 GST_APSS_Byte3 "18.03.03";
BA_ "UsrSigPurpose" SG_ 3221225472 GST_APSS_Byte4 2;
BA_ "GenSigSendType" SG_ 3221225472 GST_APSS_Byte4 2;
BA_ "UserSigValidity" SG_ 3221225472 GST_APSS_Byte4 0;
BA_ "GenSigTimeoutTime" SG_ 3221225472 GST_APSS_Byte4 0;
BA_ "NetworkRequest" SG_ 3221225472 GST_APSS_Byte4 0;
BA_ "NetworkRequestHoldingTime" SG_ 3221225472 GST_APSS_Byte4 5000;
BA_ "Version" SG_ 3221225472 GST_APSS_Byte4 "18.03.03";
BA_ "UsrSigPurpose" SG_ 3221225472 GST_APSS_Byte5 2;
BA_ "GenSigSendType" SG_ 3221225472 GST_APSS_Byte5 2;
BA_ "UserSigValidity" SG_ 3221225472 GST_APSS_Byte5 0;
BA_ "GenSigTimeoutTime" SG_ 3221225472 GST_APSS_Byte5 0;
BA_ "NetworkRequest" SG_ 3221225472 GST_APSS_Byte5 0;
BA_ "NetworkRequestHoldingTime" SG_ 3221225472 GST_APSS_Byte5 5000;
BA_ "Version" SG_ 3221225472 GST_APSS_Byte5 "18.03.03";
BA_ "UsrSigPurpose" SG_ 3221225472 GST_APSS_Byte6 2;
BA_ "GenSigSendType" SG_ 3221225472 GST_APSS_Byte6 2;
BA_ "UserSigValidity" SG_ 3221225472 GST_APSS_Byte6 0;
BA_ "GenSigTimeoutTime" SG_ 3221225472 GST_APSS_Byte6 0;
BA_ "NetworkRequest" SG_ 3221225472 GST_APSS_Byte6 0;
BA_ "NetworkRequestHoldingTime" SG_ 3221225472 GST_APSS_Byte6 5000;
BA_ "Version" SG_ 3221225472 GST_APSS_Byte6 "18.03.03";
BA_ "UsrSigPurpose" SG_ 3221225472 GST_APSS_Byte7 2;
BA_ "GenSigSendType" SG_ 3221225472 GST_APSS_Byte7 2;
BA_ "UserSigValidity" SG_ 3221225472 GST_APSS_Byte7 0;
BA_ "GenSigTimeoutTime" SG_ 3221225472 GST_APSS_Byte7 0;
BA_ "NetworkRequest" SG_ 3221225472 GST_APSS_Byte7 0;
BA_ "NetworkRequestHoldingTime" SG_ 3221225472 GST_APSS_Byte7 5000;
BA_ "Version" SG_ 3221225472 GST_APSS_Byte7 "18.03.03";
BA_ "Description" SG_ 3221225472 VCRM_CluSrvRmndrDaySta "Cluster Service Reminder Day(__months)";
BA_ "UserSigValidity" SG_ 3221225472 VCRM_CluSrvRmndrDaySta 3;
BA_ "GenSigTimeoutTime" SG_ 3221225472 VCRM_CluSrvRmndrDaySta 1500;
BA_ "Version" SG_ 3221225472 VCRM_CluSrvRmndrDaySta "17.11.00";
BA_ "Description" SG_ 3221225472 VCRM_CluSrvRmndrDstSta "Cluster Service Reminder Distance(___00km)";
BA_ "UserSigValidity" SG_ 3221225472 VCRM_CluSrvRmndrDstSta 3;
BA_ "GenSigTimeoutTime" SG_ 3221225472 VCRM_CluSrvRmndrDstSta 1500;
BA_ "Version" SG_ 3221225472 VCRM_CluSrvRmndrDstSta "17.11.00";
BA_ "Description" SG_ 3221225472 VCRM_CluVcAlrmVolSta "cluster volume ( mute, volume1, volume2, volume3 )";
BA_ "UserSigValidity" SG_ 3221225472 VCRM_CluVcAlrmVolSta 3;
BA_ "GenSigTimeoutTime" SG_ 3221225472 VCRM_CluVcAlrmVolSta 1500;
BA_ "Version" SG_ 3221225472 VCRM_CluVcAlrmVolSta "17.11.00";
BA_ "UsrSigPurpose" SG_ 3221225472 GST_eCall_Byte0 2;
BA_ "GenSigSendType" SG_ 3221225472 GST_eCall_Byte0 2;
BA_ "UserSigValidity" SG_ 3221225472 GST_eCall_Byte0 0;
BA_ "GenSigTimeoutTime" SG_ 3221225472 GST_eCall_Byte0 0;
BA_ "NetworkRequest" SG_ 3221225472 GST_eCall_Byte0 0;
BA_ "NetworkRequestHoldingTime" SG_ 3221225472 GST_eCall_Byte0 5000;
BA_ "Version" SG_ 3221225472 GST_eCall_Byte0 "18.01.09";
BA_ "UsrSigPurpose" SG_ 3221225472 GST_eCall_Byte1 2;
BA_ "GenSigSendType" SG_ 3221225472 GST_eCall_Byte1 2;
BA_ "UserSigValidity" SG_ 3221225472 GST_eCall_Byte1 0;
BA_ "GenSigTimeoutTime" SG_ 3221225472 GST_eCall_Byte1 0;
BA_ "NetworkRequest" SG_ 3221225472 GST_eCall_Byte1 0;
BA_ "NetworkRequestHoldingTime" SG_ 3221225472 GST_eCall_Byte1 5000;
BA_ "Version" SG_ 3221225472 GST_eCall_Byte1 "18.01.09";
BA_ "UsrSigPurpose" SG_ 3221225472 GST_eCall_Byte2 2;
BA_ "GenSigSendType" SG_ 3221225472 GST_eCall_Byte2 2;
BA_ "UserSigValidity" SG_ 3221225472 GST_eCall_Byte2 0;
BA_ "GenSigTimeoutTime" SG_ 3221225472 GST_eCall_Byte2 0;
BA_ "NetworkRequest" SG_ 3221225472 GST_eCall_Byte2 0;
BA_ "NetworkRequestHoldingTime" SG_ 3221225472 GST_eCall_Byte2 5000;
BA_ "Version" SG_ 3221225472 GST_eCall_Byte2 "18.01.09";
BA_ "UsrSigPurpose" SG_ 3221225472 GST_eCall_Byte3 2;
BA_ "GenSigSendType" SG_ 3221225472 GST_eCall_Byte3 2;
BA_ "UserSigValidity" SG_ 3221225472 GST_eCall_Byte3 0;
BA_ "GenSigTimeoutTime" SG_ 3221225472 GST_eCall_Byte3 0;
BA_ "NetworkRequest" SG_ 3221225472 GST_eCall_Byte3 0;
BA_ "NetworkRequestHoldingTime" SG_ 3221225472 GST_eCall_Byte3 5000;
BA_ "Version" SG_ 3221225472 GST_eCall_Byte3 "18.01.09";
BA_ "UsrSigPurpose" SG_ 3221225472 GST_eCall_Byte4 2;
BA_ "GenSigSendType" SG_ 3221225472 GST_eCall_Byte4 2;
BA_ "UserSigValidity" SG_ 3221225472 GST_eCall_Byte4 0;
BA_ "GenSigTimeoutTime" SG_ 3221225472 GST_eCall_Byte4 0;
BA_ "NetworkRequest" SG_ 3221225472 GST_eCall_Byte4 0;
BA_ "NetworkRequestHoldingTime" SG_ 3221225472 GST_eCall_Byte4 5000;
BA_ "Version" SG_ 3221225472 GST_eCall_Byte4 "18.01.09";
BA_ "UsrSigPurpose" SG_ 3221225472 GST_eCall_Byte5 2;
BA_ "GenSigSendType" SG_ 3221225472 GST_eCall_Byte5 2;
BA_ "UserSigValidity" SG_ 3221225472 GST_eCall_Byte5 0;
BA_ "GenSigTimeoutTime" SG_ 3221225472 GST_eCall_Byte5 0;
BA_ "NetworkRequest" SG_ 3221225472 GST_eCall_Byte5 0;
BA_ "NetworkRequestHoldingTime" SG_ 3221225472 GST_eCall_Byte5 5000;
BA_ "Version" SG_ 3221225472 GST_eCall_Byte5 "18.01.09";
BA_ "UsrSigPurpose" SG_ 3221225472 GST_eCall_Byte6 2;
BA_ "GenSigSendType" SG_ 3221225472 GST_eCall_Byte6 2;
BA_ "UserSigValidity" SG_ 3221225472 GST_eCall_Byte6 0;
BA_ "GenSigTimeoutTime" SG_ 3221225472 GST_eCall_Byte6 0;
BA_ "NetworkRequest" SG_ 3221225472 GST_eCall_Byte6 0;
BA_ "NetworkRequestHoldingTime" SG_ 3221225472 GST_eCall_Byte6 5000;
BA_ "Version" SG_ 3221225472 GST_eCall_Byte6 "18.01.09";
BA_ "UsrSigPurpose" SG_ 3221225472 GST_eCall_Byte7 2;
BA_ "GenSigSendType" SG_ 3221225472 GST_eCall_Byte7 2;
BA_ "UserSigValidity" SG_ 3221225472 GST_eCall_Byte7 0;
BA_ "GenSigTimeoutTime" SG_ 3221225472 GST_eCall_Byte7 0;
BA_ "NetworkRequest" SG_ 3221225472 GST_eCall_Byte7 0;
BA_ "NetworkRequestHoldingTime" SG_ 3221225472 GST_eCall_Byte7 5000;
BA_ "Version" SG_ 3221225472 GST_eCall_Byte7 "18.01.09";
BA_ "Description" SG_ 3221225472 CLU_Crc3Val "The CRC checking process calculates the CRC over the entire data block, including the CRC result.

- CRC Polynomial (0x1021) , Initial Value : 0xFFFF, XOR value : 0x0000

- The mathematical expression to 16 bit CRC polynomial is given here. G(x) = x16 + ";
BA_ "GenSigStartValue" SG_ 3221225472 CLU_Crc3Val 65535;
BA_ "UserSigValidity" SG_ 3221225472 CLU_Crc3Val 3;
BA_ "GenSigTimeoutTime" SG_ 3221225472 CLU_Crc3Val 1500;
BA_ "Version" SG_ 3221225472 CLU_Crc3Val "17.11.00";
BA_ "Description" SG_ 3221225472 CLU_AlvCnt3Val "For the first transmission request for a data element the counter shall be initialized with 0 and shall be incremented by 1

for every subsequent send request. When the counter reaches the maximum value(0xFF), then it shall restart with ? for the next se";
BA_ "UserSigValidity" SG_ 3221225472 CLU_AlvCnt3Val 3;
BA_ "GenSigTimeoutTime" SG_ 3221225472 CLU_AlvCnt3Val 1500;
BA_ "Version" SG_ 3221225472 CLU_AlvCnt3Val "17.11.00";
BA_ "Description" SG_ 3221225472 VCRM_CluDISWrngSta "Cluster DIS warning(on/off)";
BA_ "UserSigValidity" SG_ 3221225472 VCRM_CluDISWrngSta 3;
BA_ "GenSigTimeoutTime" SG_ 3221225472 VCRM_CluDISWrngSta 1500;
BA_ "Version" SG_ 3221225472 VCRM_CluDISWrngSta "17.11.00";
BA_ "Description" SG_ 3221225472 VCRM_CluFuelConsmptnUnitSta "Cluster Fuen Consumption Unit (km/l, MPG(US), L/100, MPG(UK))";
BA_ "UserSigValidity" SG_ 3221225472 VCRM_CluFuelConsmptnUnitSta 3;
BA_ "GenSigTimeoutTime" SG_ 3221225472 VCRM_CluFuelConsmptnUnitSta 1500;
BA_ "Version" SG_ 3221225472 VCRM_CluFuelConsmptnUnitSta "17.11.00";
BA_ "Description" SG_ 3221225472 VCRM_CluGearPosPopupSta "Cluster Gear Position Popup(off/on)";
BA_ "UserSigValidity" SG_ 3221225472 VCRM_CluGearPosPopupSta 3;
BA_ "GenSigTimeoutTime" SG_ 3221225472 VCRM_CluGearPosPopupSta 1500;
BA_ "Version" SG_ 3221225472 VCRM_CluGearPosPopupSta "17.11.00";
BA_ "Description" SG_ 3221225472 VCRM_CluMFSWPopupSta "Cluster Multifunction SW popup(on/off)";
BA_ "UserSigValidity" SG_ 3221225472 VCRM_CluMFSWPopupSta 3;
BA_ "GenSigTimeoutTime" SG_ 3221225472 VCRM_CluMFSWPopupSta 1500;
BA_ "Version" SG_ 3221225472 VCRM_CluMFSWPopupSta "17.11.00";
BA_ "Description" SG_ 3221225472 VCRM_CluSrvRmndrSta "Cluster Service Reminder(on/off)";
BA_ "UserSigValidity" SG_ 3221225472 VCRM_CluSrvRmndrSta 3;
BA_ "GenSigTimeoutTime" SG_ 3221225472 VCRM_CluSrvRmndrSta 1500;
BA_ "Version" SG_ 3221225472 VCRM_CluSrvRmndrSta "17.11.00";
BA_ "Description" SG_ 3221225472 VCRM_CluSpdmtrSta "Cluster Speedometer Unit(km/h, MPH)";
BA_ "UserSigValidity" SG_ 3221225472 VCRM_CluSpdmtrSta 3;
BA_ "GenSigTimeoutTime" SG_ 3221225472 VCRM_CluSpdmtrSta 1500;
BA_ "Version" SG_ 3221225472 VCRM_CluSpdmtrSta "17.11.00";
BA_ "Description" SG_ 3221225472 VCRM_CluStrWhlAlignSta "Steering Wheel Alignment(on/off)";
BA_ "UserSigValidity" SG_ 3221225472 VCRM_CluStrWhlAlignSta 3;
BA_ "GenSigTimeoutTime" SG_ 3221225472 VCRM_CluStrWhlAlignSta 1500;
BA_ "Version" SG_ 3221225472 VCRM_CluStrWhlAlignSta "17.11.00";
BA_ "Description" SG_ 3221225472 VCRM_CluWlcmSndSta "Cluster Welcome Sound(on/off)";
BA_ "UserSigValidity" SG_ 3221225472 VCRM_CluWlcmSndSta 3;
BA_ "GenSigTimeoutTime" SG_ 3221225472 VCRM_CluWlcmSndSta 1500;
BA_ "Version" SG_ 3221225472 VCRM_CluWlcmSndSta "17.11.00";
BA_ "Description" SG_ 3221225472 VCRM_CluDisGrpSta "Cluster CGW Display Group(1st tab, 2nd tab, 3rd tab, ...)";
BA_ "UserSigValidity" SG_ 3221225472 VCRM_CluDisGrpSta 3;
BA_ "GenSigTimeoutTime" SG_ 3221225472 VCRM_CluDisGrpSta 1500;
BA_ "Version" SG_ 3221225472 VCRM_CluDisGrpSta "17.11.00";
BA_ "Description" SG_ 3221225472 VCRM_CluDisModSta "Cluster Display Mode(1st page, 2nd page, 3rd page, ...)";
BA_ "UserSigValidity" SG_ 3221225472 VCRM_CluDisModSta 3;
BA_ "GenSigTimeoutTime" SG_ 3221225472 VCRM_CluDisModSta 1500;
BA_ "Version" SG_ 3221225472 VCRM_CluDisModSta "17.11.00";
BA_ "Description" SG_ 3221225472 VCRM_CluAvgFuelCnsmptnAutoRstSta "Cluster Average Fuel Consumption Autoreset(off, after ignition, after refueling)";
BA_ "UserSigValidity" SG_ 3221225472 VCRM_CluAvgFuelCnsmptnAutoRstSta 3;
BA_ "GenSigTimeoutTime" SG_ 3221225472 VCRM_CluAvgFuelCnsmptnAutoRstSta 1500;
BA_ "Version" SG_ 3221225472 VCRM_CluAvgFuelCnsmptnAutoRstSta "17.11.00";
BA_ "Description" SG_ 3221225472 VCRM_CluTxtSizeSta "Cluster Text Size(medium, large)";
BA_ "UserSigValidity" SG_ 3221225472 VCRM_CluTxtSizeSta 3;
BA_ "GenSigTimeoutTime" SG_ 3221225472 VCRM_CluTxtSizeSta 1500;
BA_ "Version" SG_ 3221225472 VCRM_CluTxtSizeSta "17.11.00";
BA_ "Description" SG_ 3221225472 VCRM_CluLngSetSta "Cluster Language Setting(English, French, Spanish, ... )";
BA_ "UserSigValidity" SG_ 3221225472 VCRM_CluLngSetSta 3;
BA_ "GenSigTimeoutTime" SG_ 3221225472 VCRM_CluLngSetSta 1500;
BA_ "Version" SG_ 3221225472 VCRM_CluLngSetSta "17.11.00";
BA_ "Description" SG_ 3221225472 CLU_DisSpdVal_KPH "The vehicle speed which is indicated in the speedmeter.

This signal should be sent in km/h only.";
BA_ "UserSigValidity" SG_ 3221225472 CLU_DisSpdVal_KPH 3;
BA_ "GenSigTimeoutTime" SG_ 3221225472 CLU_DisSpdVal_KPH 1500;
BA_ "RoutingFactor" SG_ 3221225472 CLU_DisSpdVal_KPH 5;
BA_ "Version" SG_ 3221225472 CLU_DisSpdVal_KPH "17.12.09";
BA_ "Description" SG_ 3221225472 PSM_DrvStReclnePosVal "DRIVE SEAT RECLINE POSITION (UNIT: ˚)";
BA_ "GenSigSendType" SG_ 3221225472 PSM_DrvStReclnePosVal 4;
BA_ "UserSigValidity" SG_ 3221225472 PSM_DrvStReclnePosVal 0;
BA_ "GenSigTimeoutTime" SG_ 3221225472 PSM_DrvStReclnePosVal 1500;
BA_ "NetworkRequest" SG_ 3221225472 PSM_DrvStReclnePosVal 0;
BA_ "NetworkRequestHoldingTime" SG_ 3221225472 PSM_DrvStReclnePosVal 5000;
BA_ "Version" SG_ 3221225472 PSM_DrvStReclnePosVal "17.11.00";
BA_ "Description" SG_ 3221225472 PSM_DrvStSldPosVal "DRIVE SEAT SLIDE POSITION (UNIT: mm)";
BA_ "GenSigSendType" SG_ 3221225472 PSM_DrvStSldPosVal 4;
BA_ "UserSigValidity" SG_ 3221225472 PSM_DrvStSldPosVal 0;
BA_ "GenSigTimeoutTime" SG_ 3221225472 PSM_DrvStSldPosVal 1500;
BA_ "NetworkRequest" SG_ 3221225472 PSM_DrvStSldPosVal 0;
BA_ "NetworkRequestHoldingTime" SG_ 3221225472 PSM_DrvStSldPosVal 5000;
BA_ "Version" SG_ 3221225472 PSM_DrvStSldPosVal "17.11.00";
BA_ "Description" SG_ 3221225472 PSM_EsyAcsGetOnSta "-(Old)C_EasyAccessGetOn";
BA_ "GenSigSendType" SG_ 3221225472 PSM_EsyAcsGetOnSta 4;
BA_ "UserSigValidity" SG_ 3221225472 PSM_EsyAcsGetOnSta 0;
BA_ "GenSigTimeoutTime" SG_ 3221225472 PSM_EsyAcsGetOnSta 1500;
BA_ "NetworkRequest" SG_ 3221225472 PSM_EsyAcsGetOnSta 0;
BA_ "NetworkRequestHoldingTime" SG_ 3221225472 PSM_EsyAcsGetOnSta 5000;
BA_ "Version" SG_ 3221225472 PSM_EsyAcsGetOnSta "17.11.00";
BA_ "Description" SG_ 3221225472 PSM_EsyAcsGetOffSta "-(Old)C_EasyAccessGetOff";
BA_ "GenSigSendType" SG_ 3221225472 PSM_EsyAcsGetOffSta 4;
BA_ "UserSigValidity" SG_ 3221225472 PSM_EsyAcsGetOffSta 0;
BA_ "GenSigTimeoutTime" SG_ 3221225472 PSM_EsyAcsGetOffSta 1500;
BA_ "NetworkRequest" SG_ 3221225472 PSM_EsyAcsGetOffSta 0;
BA_ "NetworkRequestHoldingTime" SG_ 3221225472 PSM_EsyAcsGetOffSta 5000;
BA_ "Version" SG_ 3221225472 PSM_EsyAcsGetOffSta "17.11.00";
BA_ "Description" SG_ 3221225472 PSM_EsyAcsStpSta "-(Old)C_EasyAccessStop";
BA_ "GenSigSendType" SG_ 3221225472 PSM_EsyAcsStpSta 4;
BA_ "UserSigValidity" SG_ 3221225472 PSM_EsyAcsStpSta 0;
BA_ "GenSigTimeoutTime" SG_ 3221225472 PSM_EsyAcsStpSta 1500;
BA_ "NetworkRequest" SG_ 3221225472 PSM_EsyAcsStpSta 0;
BA_ "NetworkRequestHoldingTime" SG_ 3221225472 PSM_EsyAcsStpSta 5000;
BA_ "Version" SG_ 3221225472 PSM_EsyAcsStpSta "17.11.00";
BA_ "Description" SG_ 3221225472 ADAS_CMD_Crc20Val "The CRC checking process calculates the CRC over the entire data block, including the CRC result.

- CRC Polynomial (0x1021) , Initial Value : 0xFFFF, XOR value : 0x0000

- The mathematical expression to 16 bit CRC polynomial is given here. G(x) = x16 + ";
BA_ "GenSigStartValue" SG_ 3221225472 ADAS_CMD_Crc20Val 65535;
BA_ "UserSigValidity" SG_ 3221225472 ADAS_CMD_Crc20Val 3;
BA_ "GenSigTimeoutTime" SG_ 3221225472 ADAS_CMD_Crc20Val 1500;
BA_ "RoutingFactor" SG_ 3221225472 ADAS_CMD_Crc20Val 5;
BA_ "Version" SG_ 3221225472 ADAS_CMD_Crc20Val "17.12.00";
BA_ "Description" SG_ 3221225472 ADAS_CMD_AlvCnt20Val "For the first transmission request for a data element the counter shall be initialized with 0 and shall be incremented by 1

for every subsequent send request. When the counter reaches the maximum value(0xFF), then it shall restart with ? for the next se";
BA_ "UserSigValidity" SG_ 3221225472 ADAS_CMD_AlvCnt20Val 3;
BA_ "GenSigTimeoutTime" SG_ 3221225472 ADAS_CMD_AlvCnt20Val 1500;
BA_ "RoutingFactor" SG_ 3221225472 ADAS_CMD_AlvCnt20Val 5;
BA_ "Version" SG_ 3221225472 ADAS_CMD_AlvCnt20Val "17.12.00";
BA_ "Description" SG_ 3221225472 SCC_ObjDstVal "This signal provides the distance to the in lane detected SCC object regarding to the own vehicle.

- 자차선상의 전방 인식된 물체와의 거리";
BA_ "GenSigStartValue" SG_ 3221225472 SCC_ObjDstVal 2047;
BA_ "UserSigValidity" SG_ 3221225472 SCC_ObjDstVal 3;
BA_ "GenSigTimeoutTime" SG_ 3221225472 SCC_ObjDstVal 1500;
BA_ "RoutingFactor" SG_ 3221225472 SCC_ObjDstVal 5;
BA_ "Version" SG_ 3221225472 SCC_ObjDstVal "18.01.07";
BA_ "Description" SG_ 3221225472 SCC_ObjRelSpdVal "This signal provides the relative speed to the in lane detected SCC object regarding to the own vehicle.

- 자차선상의 전방 인식된 물체와 자차간 상대 속도";
BA_ "GenSigStartValue" SG_ 3221225472 SCC_ObjRelSpdVal 4095;
BA_ "UserSigValidity" SG_ 3221225472 SCC_ObjRelSpdVal 3;
BA_ "GenSigTimeoutTime" SG_ 3221225472 SCC_ObjRelSpdVal 1500;
BA_ "RoutingFactor" SG_ 3221225472 SCC_ObjRelSpdVal 5;
BA_ "Version" SG_ 3221225472 SCC_ObjRelSpdVal "18.01.07";
BA_ "Description" SG_ 3221225472 SCC_ObjLatPosVal "This signal provides the lateral position of the detected SCC object regarding to the own vehicle. 

The position of the SCC object on the left side in driving direction of the vehicle longitudinal axis correlates with a negative signal value. 

Thus an ";
BA_ "GenSigStartValue" SG_ 3221225472 SCC_ObjLatPosVal 511;
BA_ "UserSigValidity" SG_ 3221225472 SCC_ObjLatPosVal 3;
BA_ "GenSigTimeoutTime" SG_ 3221225472 SCC_ObjLatPosVal 1500;
BA_ "RoutingFactor" SG_ 3221225472 SCC_ObjLatPosVal 5;
BA_ "Version" SG_ 3221225472 SCC_ObjLatPosVal "18.01.07";
BA_ "Description" SG_ 3221225472 PSM_DrvStSldFwdDis "This signal is used to display the seat movement to AVN";
BA_ "GenSigSendType" SG_ 3221225472 PSM_DrvStSldFwdDis 4;
BA_ "UserSigValidity" SG_ 3221225472 PSM_DrvStSldFwdDis 1;
BA_ "GenSigTimeoutTime" SG_ 3221225472 PSM_DrvStSldFwdDis 1500;
BA_ "NetworkRequest" SG_ 3221225472 PSM_DrvStSldFwdDis 0;
BA_ "NetworkRequestHoldingTime" SG_ 3221225472 PSM_DrvStSldFwdDis 5000;
BA_ "Version" SG_ 3221225472 PSM_DrvStSldFwdDis "17.11.00";
BA_ "Description" SG_ 3221225472 PSM_DrvStSldBckwdDis "This signal is used to display the seat movement to AVN";
BA_ "GenSigSendType" SG_ 3221225472 PSM_DrvStSldBckwdDis 4;
BA_ "UserSigValidity" SG_ 3221225472 PSM_DrvStSldBckwdDis 1;
BA_ "GenSigTimeoutTime" SG_ 3221225472 PSM_DrvStSldBckwdDis 1500;
BA_ "NetworkRequest" SG_ 3221225472 PSM_DrvStSldBckwdDis 0;
BA_ "NetworkRequestHoldingTime" SG_ 3221225472 PSM_DrvStSldBckwdDis 5000;
BA_ "Version" SG_ 3221225472 PSM_DrvStSldBckwdDis "17.11.00";
BA_ "Description" SG_ 3221225472 PSM_DrvStReclneFwdDis "This signal is used to display the seat movement to AVN";
BA_ "GenSigSendType" SG_ 3221225472 PSM_DrvStReclneFwdDis 4;
BA_ "UserSigValidity" SG_ 3221225472 PSM_DrvStReclneFwdDis 1;
BA_ "GenSigTimeoutTime" SG_ 3221225472 PSM_DrvStReclneFwdDis 1500;
BA_ "NetworkRequest" SG_ 3221225472 PSM_DrvStReclneFwdDis 0;
BA_ "NetworkRequestHoldingTime" SG_ 3221225472 PSM_DrvStReclneFwdDis 5000;
BA_ "Version" SG_ 3221225472 PSM_DrvStReclneFwdDis "17.11.00";
BA_ "Description" SG_ 3221225472 PSM_DrvStReclneBckwdDis "This signal is used to display the seat movement to AVN";
BA_ "GenSigSendType" SG_ 3221225472 PSM_DrvStReclneBckwdDis 4;
BA_ "UserSigValidity" SG_ 3221225472 PSM_DrvStReclneBckwdDis 1;
BA_ "GenSigTimeoutTime" SG_ 3221225472 PSM_DrvStReclneBckwdDis 1500;
BA_ "NetworkRequest" SG_ 3221225472 PSM_DrvStReclneBckwdDis 0;
BA_ "NetworkRequestHoldingTime" SG_ 3221225472 PSM_DrvStReclneBckwdDis 5000;
BA_ "Version" SG_ 3221225472 PSM_DrvStReclneBckwdDis "17.11.00";
BA_ "Description" SG_ 3221225472 PSM_DrvStTiltUpDis "This signal is used to display the seat movement to AVN";
BA_ "GenSigSendType" SG_ 3221225472 PSM_DrvStTiltUpDis 4;
BA_ "UserSigValidity" SG_ 3221225472 PSM_DrvStTiltUpDis 1;
BA_ "GenSigTimeoutTime" SG_ 3221225472 PSM_DrvStTiltUpDis 1500;
BA_ "NetworkRequest" SG_ 3221225472 PSM_DrvStTiltUpDis 0;
BA_ "NetworkRequestHoldingTime" SG_ 3221225472 PSM_DrvStTiltUpDis 5000;
BA_ "Version" SG_ 3221225472 PSM_DrvStTiltUpDis "17.11.00";
BA_ "Description" SG_ 3221225472 PSM_DrvStTiltDnDis "This signal is used to display the seat movement to AVN";
BA_ "GenSigSendType" SG_ 3221225472 PSM_DrvStTiltDnDis 4;
BA_ "UserSigValidity" SG_ 3221225472 PSM_DrvStTiltDnDis 1;
BA_ "GenSigTimeoutTime" SG_ 3221225472 PSM_DrvStTiltDnDis 1500;
BA_ "NetworkRequest" SG_ 3221225472 PSM_DrvStTiltDnDis 0;
BA_ "NetworkRequestHoldingTime" SG_ 3221225472 PSM_DrvStTiltDnDis 5000;
BA_ "Version" SG_ 3221225472 PSM_DrvStTiltDnDis "17.11.00";
BA_ "Description" SG_ 3221225472 PSM_DrvStHghtUpDis "This signal is used to display the seat movement to AVN";
BA_ "GenSigSendType" SG_ 3221225472 PSM_DrvStHghtUpDis 4;
BA_ "UserSigValidity" SG_ 3221225472 PSM_DrvStHghtUpDis 1;
BA_ "GenSigTimeoutTime" SG_ 3221225472 PSM_DrvStHghtUpDis 1500;
BA_ "NetworkRequest" SG_ 3221225472 PSM_DrvStHghtUpDis 0;
BA_ "NetworkRequestHoldingTime" SG_ 3221225472 PSM_DrvStHghtUpDis 5000;
BA_ "Version" SG_ 3221225472 PSM_DrvStHghtUpDis "17.11.00";
BA_ "Description" SG_ 3221225472 PSM_DrvStHghtDnDis "This signal is used to display the seat movement to AVN";
BA_ "GenSigSendType" SG_ 3221225472 PSM_DrvStHghtDnDis 4;
BA_ "UserSigValidity" SG_ 3221225472 PSM_DrvStHghtDnDis 1;
BA_ "GenSigTimeoutTime" SG_ 3221225472 PSM_DrvStHghtDnDis 1500;
BA_ "NetworkRequest" SG_ 3221225472 PSM_DrvStHghtDnDis 0;
BA_ "NetworkRequestHoldingTime" SG_ 3221225472 PSM_DrvStHghtDnDis 5000;
BA_ "Version" SG_ 3221225472 PSM_DrvStHghtDnDis "17.11.00";
BA_ "Description" SG_ 3221225472 PSM_DrvStCushExtBckwdDis "This signal is used to display the seat movement to AVN";
BA_ "GenSigSendType" SG_ 3221225472 PSM_DrvStCushExtBckwdDis 4;
BA_ "UserSigValidity" SG_ 3221225472 PSM_DrvStCushExtBckwdDis 1;
BA_ "GenSigTimeoutTime" SG_ 3221225472 PSM_DrvStCushExtBckwdDis 1500;
BA_ "NetworkRequest" SG_ 3221225472 PSM_DrvStCushExtBckwdDis 0;
BA_ "NetworkRequestHoldingTime" SG_ 3221225472 PSM_DrvStCushExtBckwdDis 5000;
BA_ "Version" SG_ 3221225472 PSM_DrvStCushExtBckwdDis "17.11.00";
BA_ "Description" SG_ 3221225472 PSM_DrvStCushExtFwdDis "This signal is used to display the seat movement to AVN";
BA_ "GenSigSendType" SG_ 3221225472 PSM_DrvStCushExtFwdDis 4;
BA_ "UserSigValidity" SG_ 3221225472 PSM_DrvStCushExtFwdDis 1;
BA_ "GenSigTimeoutTime" SG_ 3221225472 PSM_DrvStCushExtFwdDis 1500;
BA_ "NetworkRequest" SG_ 3221225472 PSM_DrvStCushExtFwdDis 0;
BA_ "NetworkRequestHoldingTime" SG_ 3221225472 PSM_DrvStCushExtFwdDis 5000;
BA_ "Version" SG_ 3221225472 PSM_DrvStCushExtFwdDis "17.11.00";
BA_ "Description" SG_ 3221225472 PSM_DrvStLmbrDefDis "This signal is used to display the seat movement to AVN";
BA_ "GenSigSendType" SG_ 3221225472 PSM_DrvStLmbrDefDis 4;
BA_ "UserSigValidity" SG_ 3221225472 PSM_DrvStLmbrDefDis 1;
BA_ "GenSigTimeoutTime" SG_ 3221225472 PSM_DrvStLmbrDefDis 1500;
BA_ "NetworkRequest" SG_ 3221225472 PSM_DrvStLmbrDefDis 0;
BA_ "NetworkRequestHoldingTime" SG_ 3221225472 PSM_DrvStLmbrDefDis 5000;
BA_ "Version" SG_ 3221225472 PSM_DrvStLmbrDefDis "17.11.00";
BA_ "Description" SG_ 3221225472 PSM_DrvStLmbrLoDis "This signal is used to display the seat movement to AVN";
BA_ "GenSigSendType" SG_ 3221225472 PSM_DrvStLmbrLoDis 4;
BA_ "UserSigValidity" SG_ 3221225472 PSM_DrvStLmbrLoDis 1;
BA_ "GenSigTimeoutTime" SG_ 3221225472 PSM_DrvStLmbrLoDis 1500;
BA_ "NetworkRequest" SG_ 3221225472 PSM_DrvStLmbrLoDis 0;
BA_ "NetworkRequestHoldingTime" SG_ 3221225472 PSM_DrvStLmbrLoDis 5000;
BA_ "Version" SG_ 3221225472 PSM_DrvStLmbrLoDis "17.11.00";
BA_ "Description" SG_ 3221225472 PSM_DrvStLmbrMdlDis "This signal is used to display the seat movement to AVN";
BA_ "GenSigSendType" SG_ 3221225472 PSM_DrvStLmbrMdlDis 4;
BA_ "UserSigValidity" SG_ 3221225472 PSM_DrvStLmbrMdlDis 1;
BA_ "GenSigTimeoutTime" SG_ 3221225472 PSM_DrvStLmbrMdlDis 1500;
BA_ "NetworkRequest" SG_ 3221225472 PSM_DrvStLmbrMdlDis 0;
BA_ "NetworkRequestHoldingTime" SG_ 3221225472 PSM_DrvStLmbrMdlDis 5000;
BA_ "Version" SG_ 3221225472 PSM_DrvStLmbrMdlDis "17.11.00";
BA_ "Description" SG_ 3221225472 PSM_DrvStLmbrUpDis "This signal is used to display the seat movement to AVN";
BA_ "GenSigSendType" SG_ 3221225472 PSM_DrvStLmbrUpDis 4;
BA_ "UserSigValidity" SG_ 3221225472 PSM_DrvStLmbrUpDis 1;
BA_ "GenSigTimeoutTime" SG_ 3221225472 PSM_DrvStLmbrUpDis 1500;
BA_ "NetworkRequest" SG_ 3221225472 PSM_DrvStLmbrUpDis 0;
BA_ "NetworkRequestHoldingTime" SG_ 3221225472 PSM_DrvStLmbrUpDis 5000;
BA_ "Version" SG_ 3221225472 PSM_DrvStLmbrUpDis "17.11.00";
BA_ "Description" SG_ 3221225472 PSM_LmbrSigSrcTyp "-(Old)C_PSMLumbarOpt";
BA_ "GenSigSendType" SG_ 3221225472 PSM_LmbrSigSrcTyp 4;
BA_ "UserSigValidity" SG_ 3221225472 PSM_LmbrSigSrcTyp 0;
BA_ "GenSigTimeoutTime" SG_ 3221225472 PSM_LmbrSigSrcTyp 1500;
BA_ "NetworkRequest" SG_ 3221225472 PSM_LmbrSigSrcTyp 0;
BA_ "NetworkRequestHoldingTime" SG_ 3221225472 PSM_LmbrSigSrcTyp 5000;
BA_ "Version" SG_ 3221225472 PSM_LmbrSigSrcTyp "17.11.00";
BA_ "UsrSigPurpose" SG_ 3221225472 ALU_GST_Byte0 2;
BA_ "GenSigSendType" SG_ 3221225472 ALU_GST_Byte0 2;
BA_ "UserSigValidity" SG_ 3221225472 ALU_GST_Byte0 0;
BA_ "GenSigTimeoutTime" SG_ 3221225472 ALU_GST_Byte0 0;
BA_ "NetworkRequest" SG_ 3221225472 ALU_GST_Byte0 0;
BA_ "NetworkRequestHoldingTime" SG_ 3221225472 ALU_GST_Byte0 5000;
BA_ "Version" SG_ 3221225472 ALU_GST_Byte0 "18.03.03";
BA_ "UsrSigPurpose" SG_ 3221225472 ALU_GST_Byte1 2;
BA_ "GenSigSendType" SG_ 3221225472 ALU_GST_Byte1 2;
BA_ "UserSigValidity" SG_ 3221225472 ALU_GST_Byte1 0;
BA_ "GenSigTimeoutTime" SG_ 3221225472 ALU_GST_Byte1 0;
BA_ "NetworkRequest" SG_ 3221225472 ALU_GST_Byte1 0;
BA_ "NetworkRequestHoldingTime" SG_ 3221225472 ALU_GST_Byte1 5000;
BA_ "Version" SG_ 3221225472 ALU_GST_Byte1 "18.03.03";
BA_ "UsrSigPurpose" SG_ 3221225472 ALU_GST_Byte2 2;
BA_ "GenSigSendType" SG_ 3221225472 ALU_GST_Byte2 2;
BA_ "UserSigValidity" SG_ 3221225472 ALU_GST_Byte2 0;
BA_ "GenSigTimeoutTime" SG_ 3221225472 ALU_GST_Byte2 0;
BA_ "NetworkRequest" SG_ 3221225472 ALU_GST_Byte2 0;
BA_ "NetworkRequestHoldingTime" SG_ 3221225472 ALU_GST_Byte2 5000;
BA_ "Version" SG_ 3221225472 ALU_GST_Byte2 "18.03.03";
BA_ "UsrSigPurpose" SG_ 3221225472 ALU_GST_Byte3 2;
BA_ "GenSigSendType" SG_ 3221225472 ALU_GST_Byte3 2;
BA_ "UserSigValidity" SG_ 3221225472 ALU_GST_Byte3 0;
BA_ "GenSigTimeoutTime" SG_ 3221225472 ALU_GST_Byte3 0;
BA_ "NetworkRequest" SG_ 3221225472 ALU_GST_Byte3 0;
BA_ "NetworkRequestHoldingTime" SG_ 3221225472 ALU_GST_Byte3 5000;
BA_ "Version" SG_ 3221225472 ALU_GST_Byte3 "18.03.03";
BA_ "UsrSigPurpose" SG_ 3221225472 ALU_GST_Byte4 2;
BA_ "GenSigSendType" SG_ 3221225472 ALU_GST_Byte4 2;
BA_ "UserSigValidity" SG_ 3221225472 ALU_GST_Byte4 0;
BA_ "GenSigTimeoutTime" SG_ 3221225472 ALU_GST_Byte4 0;
BA_ "NetworkRequest" SG_ 3221225472 ALU_GST_Byte4 0;
BA_ "NetworkRequestHoldingTime" SG_ 3221225472 ALU_GST_Byte4 5000;
BA_ "Version" SG_ 3221225472 ALU_GST_Byte4 "18.03.03";
BA_ "UsrSigPurpose" SG_ 3221225472 ALU_GST_Byte5 2;
BA_ "GenSigSendType" SG_ 3221225472 ALU_GST_Byte5 2;
BA_ "UserSigValidity" SG_ 3221225472 ALU_GST_Byte5 0;
BA_ "GenSigTimeoutTime" SG_ 3221225472 ALU_GST_Byte5 0;
BA_ "NetworkRequest" SG_ 3221225472 ALU_GST_Byte5 0;
BA_ "NetworkRequestHoldingTime" SG_ 3221225472 ALU_GST_Byte5 5000;
BA_ "Version" SG_ 3221225472 ALU_GST_Byte5 "18.03.03";
BA_ "UsrSigPurpose" SG_ 3221225472 ALU_GST_Byte6 2;
BA_ "GenSigSendType" SG_ 3221225472 ALU_GST_Byte6 2;
BA_ "UserSigValidity" SG_ 3221225472 ALU_GST_Byte6 0;
BA_ "GenSigTimeoutTime" SG_ 3221225472 ALU_GST_Byte6 0;
BA_ "NetworkRequest" SG_ 3221225472 ALU_GST_Byte6 0;
BA_ "NetworkRequestHoldingTime" SG_ 3221225472 ALU_GST_Byte6 5000;
BA_ "Version" SG_ 3221225472 ALU_GST_Byte6 "18.03.03";
BA_ "UsrSigPurpose" SG_ 3221225472 ALU_GST_Byte7 2;
BA_ "GenSigSendType" SG_ 3221225472 ALU_GST_Byte7 2;
BA_ "UserSigValidity" SG_ 3221225472 ALU_GST_Byte7 0;
BA_ "GenSigTimeoutTime" SG_ 3221225472 ALU_GST_Byte7 0;
BA_ "NetworkRequest" SG_ 3221225472 ALU_GST_Byte7 0;
BA_ "NetworkRequestHoldingTime" SG_ 3221225472 ALU_GST_Byte7 5000;
BA_ "Version" SG_ 3221225472 ALU_GST_Byte7 "18.03.03";
BA_ "UsrSigPurpose" SG_ 3221225472 PFSU_GST_Byte0 2;
BA_ "GenSigSendType" SG_ 3221225472 PFSU_GST_Byte0 2;
BA_ "UserSigValidity" SG_ 3221225472 PFSU_GST_Byte0 0;
BA_ "GenSigTimeoutTime" SG_ 3221225472 PFSU_GST_Byte0 0;
BA_ "NetworkRequest" SG_ 3221225472 PFSU_GST_Byte0 0;
BA_ "NetworkRequestHoldingTime" SG_ 3221225472 PFSU_GST_Byte0 5000;
BA_ "Version" SG_ 3221225472 PFSU_GST_Byte0 "18.03.03";
BA_ "UsrSigPurpose" SG_ 3221225472 PFSU_GST_Byte1 2;
BA_ "GenSigSendType" SG_ 3221225472 PFSU_GST_Byte1 2;
BA_ "UserSigValidity" SG_ 3221225472 PFSU_GST_Byte1 0;
BA_ "GenSigTimeoutTime" SG_ 3221225472 PFSU_GST_Byte1 0;
BA_ "NetworkRequest" SG_ 3221225472 PFSU_GST_Byte1 0;
BA_ "NetworkRequestHoldingTime" SG_ 3221225472 PFSU_GST_Byte1 5000;
BA_ "Version" SG_ 3221225472 PFSU_GST_Byte1 "18.03.03";
BA_ "UsrSigPurpose" SG_ 3221225472 PFSU_GST_Byte2 2;
BA_ "GenSigSendType" SG_ 3221225472 PFSU_GST_Byte2 2;
BA_ "UserSigValidity" SG_ 3221225472 PFSU_GST_Byte2 0;
BA_ "GenSigTimeoutTime" SG_ 3221225472 PFSU_GST_Byte2 0;
BA_ "NetworkRequest" SG_ 3221225472 PFSU_GST_Byte2 0;
BA_ "NetworkRequestHoldingTime" SG_ 3221225472 PFSU_GST_Byte2 5000;
BA_ "Version" SG_ 3221225472 PFSU_GST_Byte2 "18.03.03";
BA_ "UsrSigPurpose" SG_ 3221225472 PFSU_GST_Byte3 2;
BA_ "GenSigSendType" SG_ 3221225472 PFSU_GST_Byte3 2;
BA_ "UserSigValidity" SG_ 3221225472 PFSU_GST_Byte3 0;
BA_ "GenSigTimeoutTime" SG_ 3221225472 PFSU_GST_Byte3 0;
BA_ "NetworkRequest" SG_ 3221225472 PFSU_GST_Byte3 0;
BA_ "NetworkRequestHoldingTime" SG_ 3221225472 PFSU_GST_Byte3 5000;
BA_ "Version" SG_ 3221225472 PFSU_GST_Byte3 "18.03.03";
BA_ "UsrSigPurpose" SG_ 3221225472 PFSU_GST_Byte4 2;
BA_ "GenSigSendType" SG_ 3221225472 PFSU_GST_Byte4 2;
BA_ "UserSigValidity" SG_ 3221225472 PFSU_GST_Byte4 0;
BA_ "GenSigTimeoutTime" SG_ 3221225472 PFSU_GST_Byte4 0;
BA_ "NetworkRequest" SG_ 3221225472 PFSU_GST_Byte4 0;
BA_ "NetworkRequestHoldingTime" SG_ 3221225472 PFSU_GST_Byte4 5000;
BA_ "Version" SG_ 3221225472 PFSU_GST_Byte4 "18.03.03";
BA_ "UsrSigPurpose" SG_ 3221225472 PFSU_GST_Byte5 2;
BA_ "GenSigSendType" SG_ 3221225472 PFSU_GST_Byte5 2;
BA_ "UserSigValidity" SG_ 3221225472 PFSU_GST_Byte5 0;
BA_ "GenSigTimeoutTime" SG_ 3221225472 PFSU_GST_Byte5 0;
BA_ "NetworkRequest" SG_ 3221225472 PFSU_GST_Byte5 0;
BA_ "NetworkRequestHoldingTime" SG_ 3221225472 PFSU_GST_Byte5 5000;
BA_ "Version" SG_ 3221225472 PFSU_GST_Byte5 "18.03.03";
BA_ "UsrSigPurpose" SG_ 3221225472 PFSU_GST_Byte6 2;
BA_ "GenSigSendType" SG_ 3221225472 PFSU_GST_Byte6 2;
BA_ "UserSigValidity" SG_ 3221225472 PFSU_GST_Byte6 0;
BA_ "GenSigTimeoutTime" SG_ 3221225472 PFSU_GST_Byte6 0;
BA_ "NetworkRequest" SG_ 3221225472 PFSU_GST_Byte6 0;
BA_ "NetworkRequestHoldingTime" SG_ 3221225472 PFSU_GST_Byte6 5000;
BA_ "Version" SG_ 3221225472 PFSU_GST_Byte6 "18.03.03";
BA_ "UsrSigPurpose" SG_ 3221225472 PFSU_GST_Byte7 2;
BA_ "GenSigSendType" SG_ 3221225472 PFSU_GST_Byte7 2;
BA_ "UserSigValidity" SG_ 3221225472 PFSU_GST_Byte7 0;
BA_ "GenSigTimeoutTime" SG_ 3221225472 PFSU_GST_Byte7 0;
BA_ "NetworkRequest" SG_ 3221225472 PFSU_GST_Byte7 0;
BA_ "NetworkRequestHoldingTime" SG_ 3221225472 PFSU_GST_Byte7 5000;
BA_ "Version" SG_ 3221225472 PFSU_GST_Byte7 "18.03.03";
BA_ "GenSigSendType" SG_ 3221225472 PSM_DrvStEsyAcsUSMSta 4;
BA_ "UserSigValidity" SG_ 3221225472 PSM_DrvStEsyAcsUSMSta 0;
BA_ "GenSigTimeoutTime" SG_ 3221225472 PSM_DrvStEsyAcsUSMSta 1500;
BA_ "NetworkRequest" SG_ 3221225472 PSM_DrvStEsyAcsUSMSta 0;
BA_ "NetworkRequestHoldingTime" SG_ 3221225472 PSM_DrvStEsyAcsUSMSta 5000;
BA_ "Version" SG_ 3221225472 PSM_DrvStEsyAcsUSMSta "17.11.00";
BA_ "Description" SG_ 3221225472 PSM_AutoHtrCtrlUSMSta "-(Old)C_DrvAutoHeatRValue";
BA_ "GenSigSendType" SG_ 3221225472 PSM_AutoHtrCtrlUSMSta 4;
BA_ "UserSigValidity" SG_ 3221225472 PSM_AutoHtrCtrlUSMSta 0;
BA_ "GenSigTimeoutTime" SG_ 3221225472 PSM_AutoHtrCtrlUSMSta 1500;
BA_ "NetworkRequest" SG_ 3221225472 PSM_AutoHtrCtrlUSMSta 0;
BA_ "NetworkRequestHoldingTime" SG_ 3221225472 PSM_AutoHtrCtrlUSMSta 5000;
BA_ "Version" SG_ 3221225472 PSM_AutoHtrCtrlUSMSta "17.11.00";
BA_ "Description" SG_ 3221225472 PSM_IMSOptTyp "-(Old)C_IMSOption";
BA_ "GenSigSendType" SG_ 3221225472 PSM_IMSOptTyp 4;
BA_ "UserSigValidity" SG_ 3221225472 PSM_IMSOptTyp 0;
BA_ "GenSigTimeoutTime" SG_ 3221225472 PSM_IMSOptTyp 1500;
BA_ "NetworkRequest" SG_ 3221225472 PSM_IMSOptTyp 0;
BA_ "NetworkRequestHoldingTime" SG_ 3221225472 PSM_IMSOptTyp 5000;
BA_ "Version" SG_ 3221225472 PSM_IMSOptTyp "17.11.00";
BA_ "Description" SG_ 3221225472 Profile_IMSIDSelUSMSta "-(Old)C_Profile_IMSRValue";
BA_ "GenSigSendType" SG_ 3221225472 Profile_IMSIDSelUSMSta 4;
BA_ "UserSigValidity" SG_ 3221225472 Profile_IMSIDSelUSMSta 0;
BA_ "GenSigTimeoutTime" SG_ 3221225472 Profile_IMSIDSelUSMSta 1500;
BA_ "NetworkRequest" SG_ 3221225472 Profile_IMSIDSelUSMSta 0;
BA_ "NetworkRequestHoldingTime" SG_ 3221225472 Profile_IMSIDSelUSMSta 5000;
BA_ "Version" SG_ 3221225472 Profile_IMSIDSelUSMSta "17.11.00";
BA_ "Description" SG_ 3221225472 Profile_IMSIDSelErrSta "-(Old)C_Profile_IMSPairingErr";
BA_ "GenSigSendType" SG_ 3221225472 Profile_IMSIDSelErrSta 4;
BA_ "UserSigValidity" SG_ 3221225472 Profile_IMSIDSelErrSta 0;
BA_ "GenSigTimeoutTime" SG_ 3221225472 Profile_IMSIDSelErrSta 1500;
BA_ "NetworkRequest" SG_ 3221225472 Profile_IMSIDSelErrSta 0;
BA_ "NetworkRequestHoldingTime" SG_ 3221225472 Profile_IMSIDSelErrSta 5000;
BA_ "Version" SG_ 3221225472 Profile_IMSIDSelErrSta "17.11.00";
BA_ "Description" SG_ 3221225472 PSM_DrvStHtrVntTyp "-(Old)C_DrvSeatHeatOption";
BA_ "GenSigSendType" SG_ 3221225472 PSM_DrvStHtrVntTyp 4;
BA_ "UserSigValidity" SG_ 3221225472 PSM_DrvStHtrVntTyp 0;
BA_ "GenSigTimeoutTime" SG_ 3221225472 PSM_DrvStHtrVntTyp 1500;
BA_ "NetworkRequest" SG_ 3221225472 PSM_DrvStHtrVntTyp 0;
BA_ "NetworkRequestHoldingTime" SG_ 3221225472 PSM_DrvStHtrVntTyp 5000;
BA_ "Version" SG_ 3221225472 PSM_DrvStHtrVntTyp "17.11.00";
BA_ "Description" SG_ 3221225472 PSM_DrvStHtrVntSta "-(Old)C_DrvSeatHeatState";
BA_ "GenSigSendType" SG_ 3221225472 PSM_DrvStHtrVntSta 4;
BA_ "UserSigValidity" SG_ 3221225472 PSM_DrvStHtrVntSta 0;
BA_ "GenSigTimeoutTime" SG_ 3221225472 PSM_DrvStHtrVntSta 1500;
BA_ "NetworkRequest" SG_ 3221225472 PSM_DrvStHtrVntSta 0;
BA_ "NetworkRequestHoldingTime" SG_ 3221225472 PSM_DrvStHtrVntSta 5000;
BA_ "Version" SG_ 3221225472 PSM_DrvStHtrVntSta "17.11.00";
BA_ "Description" SG_ 3221225472 SmrtIMS_StatureRspVal "User height information response value for Health Care IMS";
BA_ "GenSigSendType" SG_ 3221225472 SmrtIMS_StatureRspVal 4;
BA_ "UserSigValidity" SG_ 3221225472 SmrtIMS_StatureRspVal 0;
BA_ "GenSigTimeoutTime" SG_ 3221225472 SmrtIMS_StatureRspVal 1500;
BA_ "NetworkRequest" SG_ 3221225472 SmrtIMS_StatureRspVal 0;
BA_ "NetworkRequestHoldingTime" SG_ 3221225472 SmrtIMS_StatureRspVal 5000;
BA_ "Version" SG_ 3221225472 SmrtIMS_StatureRspVal "17.11.00";
BA_ "Description" SG_ 3221225472 SmrtIMS_SeatedHghtRspVal "User sit height information response value for Health Care IMS";
BA_ "GenSigSendType" SG_ 3221225472 SmrtIMS_SeatedHghtRspVal 4;
BA_ "UserSigValidity" SG_ 3221225472 SmrtIMS_SeatedHghtRspVal 0;
BA_ "GenSigTimeoutTime" SG_ 3221225472 SmrtIMS_SeatedHghtRspVal 1500;
BA_ "NetworkRequest" SG_ 3221225472 SmrtIMS_SeatedHghtRspVal 0;
BA_ "NetworkRequestHoldingTime" SG_ 3221225472 SmrtIMS_SeatedHghtRspVal 5000;
BA_ "Version" SG_ 3221225472 SmrtIMS_SeatedHghtRspVal "17.11.00";
BA_ "Description" SG_ 3221225472 SmrtIMS_WghtRspVal "User weight information repsponse value for Health Care IMS";
BA_ "GenSigSendType" SG_ 3221225472 SmrtIMS_WghtRspVal 4;
BA_ "UserSigValidity" SG_ 3221225472 SmrtIMS_WghtRspVal 0;
BA_ "GenSigTimeoutTime" SG_ 3221225472 SmrtIMS_WghtRspVal 1500;
BA_ "NetworkRequest" SG_ 3221225472 SmrtIMS_WghtRspVal 0;
BA_ "NetworkRequestHoldingTime" SG_ 3221225472 SmrtIMS_WghtRspVal 5000;
BA_ "Version" SG_ 3221225472 SmrtIMS_WghtRspVal "17.11.00";
BA_ "Description" SG_ 3221225472 SmartIMS_DisReq "For displaying the state of seat moving";
BA_ "GenSigSendType" SG_ 3221225472 SmartIMS_DisReq 4;
BA_ "UserSigValidity" SG_ 3221225472 SmartIMS_DisReq 0;
BA_ "GenSigTimeoutTime" SG_ 3221225472 SmartIMS_DisReq 1500;
BA_ "NetworkRequest" SG_ 3221225472 SmartIMS_DisReq 0;
BA_ "NetworkRequestHoldingTime" SG_ 3221225472 SmartIMS_DisReq 5000;
BA_ "Version" SG_ 3221225472 SmartIMS_DisReq "17.11.00";
BA_ "Description" SG_ 3221225472 SmrtIMS_ExitSta "-(Old)C_SmartIMSExit";
BA_ "GenSigSendType" SG_ 3221225472 SmrtIMS_ExitSta 4;
BA_ "UserSigValidity" SG_ 3221225472 SmrtIMS_ExitSta 0;
BA_ "GenSigTimeoutTime" SG_ 3221225472 SmrtIMS_ExitSta 1500;
BA_ "NetworkRequest" SG_ 3221225472 SmrtIMS_ExitSta 0;
BA_ "NetworkRequestHoldingTime" SG_ 3221225472 SmrtIMS_ExitSta 5000;
BA_ "Version" SG_ 3221225472 SmrtIMS_ExitSta "17.11.00";
BA_ "Description" SG_ 3221225472 SCC_AccelReqVal "This signal represents the SCC acceleration request after jerk limit.

- Jerk limit를 거친 SCC 의 요구 가속도/감속도 값";
BA_ "UserSigValidity" SG_ 3221225472 SCC_AccelReqVal 3;
BA_ "GenSigTimeoutTime" SG_ 3221225472 SCC_AccelReqVal 1500;
BA_ "RoutingFactor" SG_ 3221225472 SCC_AccelReqVal 5;
BA_ "Version" SG_ 3221225472 SCC_AccelReqVal "17.12.00";
BA_ "Description" SG_ 3221225472 SCC_AccelReqRawVal "This signal represents the SCC acceleration request before jerk limit. 

- Jerk limit를 거치지 않은 SCC 의 요구 가속도/감속도 값";
BA_ "UserSigValidity" SG_ 3221225472 SCC_AccelReqRawVal 3;
BA_ "GenSigTimeoutTime" SG_ 3221225472 SCC_AccelReqRawVal 1500;
BA_ "RoutingFactor" SG_ 3221225472 SCC_AccelReqRawVal 5;
BA_ "Version" SG_ 3221225472 SCC_AccelReqRawVal "17.12.00";
BA_ "Description" SG_ 3221225472 SCC_JrkUppLimVal "This signal is the value of positive jerk limit request. 

- SCC 의 요구 가속도 상승변화율 제한 값";
BA_ "UserSigValidity" SG_ 3221225472 SCC_JrkUppLimVal 3;
BA_ "GenSigTimeoutTime" SG_ 3221225472 SCC_JrkUppLimVal 1500;
BA_ "RoutingFactor" SG_ 3221225472 SCC_JrkUppLimVal 5;
BA_ "Version" SG_ 3221225472 SCC_JrkUppLimVal "17.12.00";
BA_ "Description" SG_ 3221225472 SCC_JrkLwrLimVal "This signal is the value of negative jerk limit request. 

- SCC 의 요구 가속도 하강변화율 제한 값";
BA_ "UserSigValidity" SG_ 3221225472 SCC_JrkLwrLimVal 3;
BA_ "GenSigTimeoutTime" SG_ 3221225472 SCC_JrkLwrLimVal 1500;
BA_ "RoutingFactor" SG_ 3221225472 SCC_JrkLwrLimVal 5;
BA_ "Version" SG_ 3221225472 SCC_JrkLwrLimVal "17.12.00";
BA_ "Description" SG_ 3221225472 SCC_AccelLimBandUppVal "This signal is the upper value of acceleration limit band.

- SCC 의 가속도 제어 허용 범위 상한 참고값";
BA_ "UserSigValidity" SG_ 3221225472 SCC_AccelLimBandUppVal 3;
BA_ "GenSigTimeoutTime" SG_ 3221225472 SCC_AccelLimBandUppVal 1500;
BA_ "RoutingFactor" SG_ 3221225472 SCC_AccelLimBandUppVal 5;
BA_ "Version" SG_ 3221225472 SCC_AccelLimBandUppVal "17.12.03";
BA_ "Description" SG_ 3221225472 SCC_AccelLimBandLwrVal "This signal is the lower value of acceleration limit band.

- SCC 의 가속도 제어 허용 범위 하한 참고값";
BA_ "UserSigValidity" SG_ 3221225472 SCC_AccelLimBandLwrVal 3;
BA_ "GenSigTimeoutTime" SG_ 3221225472 SCC_AccelLimBandLwrVal 1500;
BA_ "RoutingFactor" SG_ 3221225472 SCC_AccelLimBandLwrVal 5;
BA_ "Version" SG_ 3221225472 SCC_AccelLimBandLwrVal "17.12.03";
BA_ "Description" SG_ 3221225472 SCC_VehStpReq "A control request flag for vehicle stop. SCC expects vehicle to be controlled to a complete stop and hold its state.

- SCC 해제 상황 발생시 차량 정차 유지를 위한 제동 요청 신호";
BA_ "UserSigValidity" SG_ 3221225472 SCC_VehStpReq 3;
BA_ "GenSigTimeoutTime" SG_ 3221225472 SCC_VehStpReq 1500;
BA_ "RoutingFactor" SG_ 3221225472 SCC_VehStpReq 5;
BA_ "Version" SG_ 3221225472 SCC_VehStpReq "17.12.00";
BA_ "Description" SG_ 3221225472 SCC_DclModReq "A control request flag for deceleration mode.

- SCC 감속 모드 요청 신호";
BA_ "UserSigValidity" SG_ 3221225472 SCC_DclModReq 3;
BA_ "GenSigTimeoutTime" SG_ 3221225472 SCC_DclModReq 1500;
BA_ "RoutingFactor" SG_ 3221225472 SCC_DclModReq 5;
BA_ "Version" SG_ 3221225472 SCC_DclModReq "17.11.00";
BA_ "UsrSigPurpose" SG_ 3221225472 PSB_GST_Byte0 2;
BA_ "GenSigSendType" SG_ 3221225472 PSB_GST_Byte0 2;
BA_ "UserSigValidity" SG_ 3221225472 PSB_GST_Byte0 0;
BA_ "GenSigTimeoutTime" SG_ 3221225472 PSB_GST_Byte0 0;
BA_ "NetworkRequest" SG_ 3221225472 PSB_GST_Byte0 0;
BA_ "NetworkRequestHoldingTime" SG_ 3221225472 PSB_GST_Byte0 5000;
BA_ "Version" SG_ 3221225472 PSB_GST_Byte0 "18.01.09";
BA_ "UsrSigPurpose" SG_ 3221225472 PSB_GST_Byte1 2;
BA_ "GenSigSendType" SG_ 3221225472 PSB_GST_Byte1 2;
BA_ "UserSigValidity" SG_ 3221225472 PSB_GST_Byte1 0;
BA_ "GenSigTimeoutTime" SG_ 3221225472 PSB_GST_Byte1 0;
BA_ "NetworkRequest" SG_ 3221225472 PSB_GST_Byte1 0;
BA_ "NetworkRequestHoldingTime" SG_ 3221225472 PSB_GST_Byte1 5000;
BA_ "Version" SG_ 3221225472 PSB_GST_Byte1 "18.01.09";
BA_ "UsrSigPurpose" SG_ 3221225472 PSB_GST_Byte2 2;
BA_ "GenSigSendType" SG_ 3221225472 PSB_GST_Byte2 2;
BA_ "UserSigValidity" SG_ 3221225472 PSB_GST_Byte2 0;
BA_ "GenSigTimeoutTime" SG_ 3221225472 PSB_GST_Byte2 0;
BA_ "NetworkRequest" SG_ 3221225472 PSB_GST_Byte2 0;
BA_ "NetworkRequestHoldingTime" SG_ 3221225472 PSB_GST_Byte2 5000;
BA_ "Version" SG_ 3221225472 PSB_GST_Byte2 "18.01.09";
BA_ "UsrSigPurpose" SG_ 3221225472 PSB_GST_Byte3 2;
BA_ "GenSigSendType" SG_ 3221225472 PSB_GST_Byte3 2;
BA_ "UserSigValidity" SG_ 3221225472 PSB_GST_Byte3 0;
BA_ "GenSigTimeoutTime" SG_ 3221225472 PSB_GST_Byte3 0;
BA_ "NetworkRequest" SG_ 3221225472 PSB_GST_Byte3 0;
BA_ "NetworkRequestHoldingTime" SG_ 3221225472 PSB_GST_Byte3 5000;
BA_ "Version" SG_ 3221225472 PSB_GST_Byte3 "18.01.09";
BA_ "UsrSigPurpose" SG_ 3221225472 PSB_GST_Byte4 2;
BA_ "GenSigSendType" SG_ 3221225472 PSB_GST_Byte4 2;
BA_ "UserSigValidity" SG_ 3221225472 PSB_GST_Byte4 0;
BA_ "GenSigTimeoutTime" SG_ 3221225472 PSB_GST_Byte4 0;
BA_ "NetworkRequest" SG_ 3221225472 PSB_GST_Byte4 0;
BA_ "NetworkRequestHoldingTime" SG_ 3221225472 PSB_GST_Byte4 5000;
BA_ "Version" SG_ 3221225472 PSB_GST_Byte4 "18.01.09";
BA_ "UsrSigPurpose" SG_ 3221225472 PSB_GST_Byte5 2;
BA_ "GenSigSendType" SG_ 3221225472 PSB_GST_Byte5 2;
BA_ "UserSigValidity" SG_ 3221225472 PSB_GST_Byte5 0;
BA_ "GenSigTimeoutTime" SG_ 3221225472 PSB_GST_Byte5 0;
BA_ "NetworkRequest" SG_ 3221225472 PSB_GST_Byte5 0;
BA_ "NetworkRequestHoldingTime" SG_ 3221225472 PSB_GST_Byte5 5000;
BA_ "Version" SG_ 3221225472 PSB_GST_Byte5 "18.01.09";
BA_ "UsrSigPurpose" SG_ 3221225472 PSB_GST_Byte6 2;
BA_ "GenSigSendType" SG_ 3221225472 PSB_GST_Byte6 2;
BA_ "UserSigValidity" SG_ 3221225472 PSB_GST_Byte6 0;
BA_ "GenSigTimeoutTime" SG_ 3221225472 PSB_GST_Byte6 0;
BA_ "NetworkRequest" SG_ 3221225472 PSB_GST_Byte6 0;
BA_ "NetworkRequestHoldingTime" SG_ 3221225472 PSB_GST_Byte6 5000;
BA_ "Version" SG_ 3221225472 PSB_GST_Byte6 "18.01.09";
BA_ "UsrSigPurpose" SG_ 3221225472 PSB_GST_Byte7 2;
BA_ "GenSigSendType" SG_ 3221225472 PSB_GST_Byte7 2;
BA_ "UserSigValidity" SG_ 3221225472 PSB_GST_Byte7 0;
BA_ "GenSigTimeoutTime" SG_ 3221225472 PSB_GST_Byte7 0;
BA_ "NetworkRequest" SG_ 3221225472 PSB_GST_Byte7 0;
BA_ "NetworkRequestHoldingTime" SG_ 3221225472 PSB_GST_Byte7 5000;
BA_ "Version" SG_ 3221225472 PSB_GST_Byte7 "18.01.09";
BA_ "Description" SG_ 3221225472 SCC_SysFlrSta "This signal is evaluated by the driver information device to release the failure information to the driver.

If this signal is set to anything other than 0, the TCS/ESC shall ignore any requests from SCC

- 시스템 고장 발생 정보용

- 해당 값이 0 이외의 �";
BA_ "UserSigValidity" SG_ 3221225472 SCC_SysFlrSta 3;
BA_ "GenSigTimeoutTime" SG_ 3221225472 SCC_SysFlrSta 1500;
BA_ "RoutingFactor" SG_ 3221225472 SCC_SysFlrSta 5;
BA_ "Version" SG_ 3221225472 SCC_SysFlrSta "17.12.00";
BA_ "Description" SG_ 3221225472 SCC_MainOnOffSta "This signal specifies the status of a Main switch of SCC system

- Main swith 에 의한 SCC ON/OFF 상태 정보";
BA_ "UserSigValidity" SG_ 3221225472 SCC_MainOnOffSta 3;
BA_ "GenSigTimeoutTime" SG_ 3221225472 SCC_MainOnOffSta 1500;
BA_ "RoutingFactor" SG_ 3221225472 SCC_MainOnOffSta 5;
BA_ "Version" SG_ 3221225472 SCC_MainOnOffSta "17.12.00";
BA_ "Description" SG_ 3221225472 SCC_OpSta "The signal ACCmode specifies the operational mode of SCC

- ACC 작동 상태 정보(off&ready / active / override / shut off)";
BA_ "UserSigValidity" SG_ 3221225472 SCC_OpSta 3;
BA_ "GenSigTimeoutTime" SG_ 3221225472 SCC_OpSta 1500;
BA_ "RoutingFactor" SG_ 3221225472 SCC_OpSta 5;
BA_ "Version" SG_ 3221225472 SCC_OpSta "17.12.00";
BA_ "Description" SG_ 3221225472 SCC_TakeoverReq "The Take-over Request supports the driver to identify the limits of the SCC control. Reasons for such a request may be:

- Deceleration capability insufficient for the current situation.

Clutch actuation by the driver is necessary to avoid stopping of t";
BA_ "UserSigValidity" SG_ 3221225472 SCC_TakeoverReq 3;
BA_ "GenSigTimeoutTime" SG_ 3221225472 SCC_TakeoverReq 1500;
BA_ "RoutingFactor" SG_ 3221225472 SCC_TakeoverReq 5;
BA_ "Version" SG_ 3221225472 SCC_TakeoverReq "17.12.00";
BA_ "Description" SG_ 3221225472 SCC_InfoDis "This signal carries information that indicates below 4 signals.

(1) SCC Mode display

(2) CC Mode display

(3) Object disapearing display

(4) Go notifying display

- SCC 제어 상세 상태를 보여주는 정보 신호

(SCC 모드 / CC 모드 / 전방차량 주의 / 정차 출";
BA_ "UserSigValidity" SG_ 3221225472 SCC_InfoDis 3;
BA_ "GenSigTimeoutTime" SG_ 3221225472 SCC_InfoDis 1500;
BA_ "RoutingFactor" SG_ 3221225472 SCC_InfoDis 5;
BA_ "Version" SG_ 3221225472 SCC_InfoDis "17.12.00";
BA_ "Description" SG_ 3221225472 SCC_DrvAlrtDis "This signal carries the information which message shall be displayed to the driver 

when the SCC must be disengaged by the system or cann’t be engaged.

A signal value unequal 00H is repeated for 5 messages cycles in order to ensure it appears for at l";
BA_ "UserSigValidity" SG_ 3221225472 SCC_DrvAlrtDis 3;
BA_ "GenSigTimeoutTime" SG_ 3221225472 SCC_DrvAlrtDis 1500;
BA_ "RoutingFactor" SG_ 3221225472 SCC_DrvAlrtDis 5;
BA_ "Version" SG_ 3221225472 SCC_DrvAlrtDis "17.12.00";
BA_ "Description" SG_ 3221225472 SCC_ObjDstLvlVal "If a in-path object is recognized by SCC, the driver should be informed.

- 자차선상의 전방 물체 인식 여부 정보";
BA_ "UserSigValidity" SG_ 3221225472 SCC_ObjDstLvlVal 3;
BA_ "GenSigTimeoutTime" SG_ 3221225472 SCC_ObjDstLvlVal 1500;
BA_ "RoutingFactor" SG_ 3221225472 SCC_ObjDstLvlVal 5;
BA_ "Version" SG_ 3221225472 SCC_ObjDstLvlVal "17.12.00";
BA_ "Description" SG_ 3221225472 SCC_HeadwayDstSetVal "The desired time gap from which a following distance is extracted has to be presented to the driver at least if the value changes. 

The representation of the information depends on the display concept.

- 전방 차량과의 거리 setting 정보

※ SCC-ML: SCC ";
BA_ "UserSigValidity" SG_ 3221225472 SCC_HeadwayDstSetVal 3;
BA_ "GenSigTimeoutTime" SG_ 3221225472 SCC_HeadwayDstSetVal 1500;
BA_ "RoutingFactor" SG_ 3221225472 SCC_HeadwayDstSetVal 5;
BA_ "Version" SG_ 3221225472 SCC_HeadwayDstSetVal "17.12.00";
BA_ "Description" SG_ 3221225472 SCC_EquipSta "This signal indicates equipment for SCC

- SCC 장착 사양 정보";
BA_ "UserSigValidity" SG_ 3221225472 SCC_EquipSta 3;
BA_ "GenSigTimeoutTime" SG_ 3221225472 SCC_EquipSta 1500;
BA_ "RoutingFactor" SG_ 3221225472 SCC_EquipSta 5;
BA_ "Version" SG_ 3221225472 SCC_EquipSta "17.12.00";
BA_ "Description" SG_ 3221225472 SCC_TrgtSpdSetVal "The desired vehicle speed for free cruising has to be displayed all the time SCC is under active control.

※This signal can be sent in km/h or MPH according to the “SPEED_UNIT” signal (See CLU1 message).

SPEED_UNIT = 0 : [km/h], SPEED_UNIT = 1 : [MPH";
BA_ "UserSigValidity" SG_ 3221225472 SCC_TrgtSpdSetVal 3;
BA_ "GenSigTimeoutTime" SG_ 3221225472 SCC_TrgtSpdSetVal 1500;
BA_ "RoutingFactor" SG_ 3221225472 SCC_TrgtSpdSetVal 5;
BA_ "Version" SG_ 3221225472 SCC_TrgtSpdSetVal "17.12.00";
BA_ "Description" SG_ 3221225472 SCC_NSCCOpSta "This signal describes the operational status of NSCC-Z/C/R function. 



NSCC-Z/C/R  작동 상태 정보(off/ready/active)";
BA_ "UserSigValidity" SG_ 3221225472 SCC_NSCCOpSta 3;
BA_ "GenSigTimeoutTime" SG_ 3221225472 SCC_NSCCOpSta 1500;
BA_ "RoutingFactor" SG_ 3221225472 SCC_NSCCOpSta 5;
BA_ "Version" SG_ 3221225472 SCC_NSCCOpSta "17.12.00";
VAL_ 3221225472 FCA_FullActvReq 0 "No Full act" 1 "Full act" 2 "Reserved" 3 "Error Indicator" ;
VAL_ 3221225472 FCA_SnstvtyModRetVal 0 "Default" 1 "Late" 2 "Normal" 3 "Early" 4 "Reserved" 5 "Reserved" 6 "Reserved" 7 "Invalid" ;
VAL_ 3221225472 FCA_RelVel 511 "Signal Invalid" ;
VAL_ 3221225472 Nmode_FCAOff_Sta 0 "Not Applied" 1 "Disable" 2 "Enable" 3 "Invalid" ;
VAL_ 3221225472 FCA_Jnctn_OnOffEquipSta 0 "Default" 1 "Off" 2 "On" 3 "Invalid" ;
VAL_ 3221225472 FCA_WrngTrgtDis 0 "No warning" 1 "FCA-Pedestrian" 2 "Reserved" 3 "FCA-Cyclist" 4 "Reserved" 5 "FCA-Car" 6 "Reserved" 7 "FCA-JC(L)" 8 "FCA-JC®" 9 "Reserved" 10 "Reserved" 11 "FCA-JT(L)" 12 "FCA-JT(R)" 13 "Reserved" 14 "Reserved" ;
VAL_ 3221225472 RSPA_Sta 1 "Init" 2 "New Start" 3 "Ready OK" 4 "Assist Req" 5 "Assist OK" 6 "Assist Fail" 7 "Abort" 8 "Ready Fail" ;
VAL_ 3221225472 RSPA_Actv 0 "RSPA Off" 1 "RSPA On" 2 "Reserved" 3 "Reserved" ;
VAL_ 3221225472 RSPA_TrgtGearSta 0 "Idle" 1 "P" 2 "R" 3 "N" 4 "D" ;
VAL_ 3221225472 RSPA_EpbReq 0 "No request" 1 "release request" 2 "normal apply" 3 "emergency apply" ;
VAL_ 3221225472 RSPA_ExtLampReq 0 "Inactive (No Request)" 1 "Hazard Lamp Active On" 2 "Hazard Lamp Active Off" 3 "Left Turn Signal On" 4 "Right Turn Signal On" 5 "reserved" 6 "reserved" 7 "reserved" ;
VAL_ 3221225472 RSPA_CrankingReq 0 "Init" 1 "to RSPA Remote Cranking" 2 "to Normal Cranking" 3 "to IG OFF" ;
VAL_ 3221225472 RSPA_IdOutWarnReq 0 "No Request" 1 "Change Request" 2 "Not Used" 3 "Error Indicator" ;
VAL_ 3221225472 RSPA_IndBlnkReq 0 "No request" 1 "Type1" 2 "Type2" 3 "Type3" 4 "Type4" 5 "Type5" 6 "Reserved" 7 "Reserved" ;
VAL_ 3221225472 RSPA_DccCmd 0 "No request" 1 "Soft Brake" 2 "Hard 1 Brake" 3 "Hard 2 Brake" ;
VAL_ 3221225472 RSPA_StopReq 0 "No request" 1 "Stop control is required" 2 "Not Used" 3 "Error Indicator" ;
VAL_ 3221225472 RSPA_AddtnlAccelActv 0 "Inactive" 1 "Active" 2 "Not Used" 3 "Error Indicator" ;
VAL_ 3221225472 RSPA_Opt 0 "RSPA not applied" 1 "RSPA applied" 2 "Not Used" 3 "Error Indicator" ;
VAL_ 3221225472 RSPA_AvnDis 0 "init" 1 "No display" 2 "RSPA 화면 출력" 3 "invalid" ;
VAL_ 3221225472 RSPA_AvnModDis 0 "init" 1 "주차모드" 2 "출차모드" 3 "invalid" ;
VAL_ 3221225472 RSPA_AvnModNumDis 0 "init" 1 "2모드" 2 "4모드" 3 "6모드" 4 "8모드" 5 "reserved" 6 "reserved" 7 "invalid" ;
VAL_ 3221225472 RSPA_AvnSubViewDis 0 "init" 1 "No display" 2 "대체이미지 출력" 3 "invalid" ;
VAL_ 3221225472 RSPA_AvnModADLDis 0 "init" 1 "제어불가능" 2 "제어가능" 3 "invalid" ;
VAL_ 3221225472 RSPA_AvnModPDFLDis 0 "init" 1 "제어불가능" 2 "제어가능" 3 "invalid" ;
VAL_ 3221225472 RSPA_AvnModPLDis 0 "init" 1 "제어불가능" 2 "제어가능" 3 "invalid" ;
VAL_ 3221225472 RSPA_AvnModPDRLDis 0 "init" 1 "제어불가능" 2 "제어가능" 3 "invalid" ;
VAL_ 3221225472 RSPA_AvnModPDRRDis 0 "init" 1 "제어불가능" 2 "제어가능" 3 "invalid" ;
VAL_ 3221225472 RSPA_AvnModPRDis 0 "init" 1 "제어불가능" 2 "제어가능" 3 "invalid" ;
VAL_ 3221225472 RSPA_AvnModPDFRDis 0 "init" 1 "제어불가능" 2 "제어가능" 3 "invalid" ;
VAL_ 3221225472 RSPA_AvnModADRDis 0 "init" 1 "제어불가능" 2 "제어가능" 3 "invalid" ;
VAL_ 3221225472 RSPA_CamDis 0 "No Display (RSPA 연동 해제)" 1 "AVM (뷰 메뉴바 미표시) 와이드뷰 블랙+탑뷰 / RVM: View OFF" 2 "AVM (뷰 메뉴바 미표시) 와이드뷰 전방+탑뷰 / RVM: Parking Assist View (Guide L. X)" 3 "AVM (뷰 메뉴바 미표시) 와이드뷰 후방+탑뷰 / RVM: Parking Assist View (Guide L. O)" 4 "reserved" 5 "reserved" 6 "reserved" 7 "Invalid" ;
VAL_ 3221225472 RSPA_AvnHmiDis 0 "none" 1 "Select operating mode (작동 모드 선택)" 2 "SMART Parking (스마트 주차 안내)" 3 "REMOTE Parking (원격 스마트 주차 안내)" 4 "Parking completed (주차 완료)" 5 "SMART Pull-out (스마트 출차 안내)" 6 "Pull-out completed (출차 완료)" 7 "RSPA cancelled ? Read Manual (시스템 해제 취급설명서 참조)" 8 "RSPA cancelled - Operate vehicle manually (시스템 해제 수동조작 안내)" 9 "Not working condition ? Exceed Limit Speed (미작동 조건)" 10 "Searching for Parking space - Reduce speed under 20km/h (주차공간 탐색 대기)" 11 "Check RSPA ? Visit Tech Center (시스템 점검 필요)" 12 "Reserved" 13 "display Front camera - moving forward (전진 제어 중)" 14 "display Rear camera - moving backward (후진 제어 중)" 15 "Reserved" 16 "RSPA paused - Check tailgate closed (일시 중지- 테일게이트 열림)" 17 "RSPA paused - Remote control range exceeded (일시 중지- 원격 조작 범위 이탈)" 18 "RSPA pasued - Hold down dedicated button on key fob (일시 중지- 스마트키 버튼 미입력)" 19 "Reserved" 20 "Reserved" 21 "Reserved" 22 "RSPA paused - Check all doors closed (일시 중지- 도어열림)" 23 "RSPA paused - Check trunk closed (일시 중지- 트렁크 열림)" 24 "Reserved" 25 "RSPA paused - Fasten seat belt on drivers side (일시 중지- 시트벨트 미체결)" 26 "Operation guide - Release brake (조작 안내- 브레이크 페달 해제)" 27 "RSPA paused - Monitor surrounding area (일시 중지- 주변 장애물)" 28 "RSPA cancelled - Trailer mode (시스템 해제- 트레일러 모드)" 29 "RSPA cancelled - PDW Off (시스템 해제- PDW 스위치 off)" 30 "RSPA cancelled - over 20km/h (시스템 해제- 속도 초과)" 31 "RSPA cancelled - not stop(시스템 해제- 정차상태 미유지)" 32 "RSPA cancelled - reverse movement (시스템 해제- 차량 밀림)" 33 "RSPA cancelled - narrow space (시스템 해제- 출차 공간 부족)" 34 "Not working condition - trailer mode (미작동 조건- 트레일러 모드)" 35 "Reserved" 36 "Reserved" 37 "Reserved" 38 "Reserved" 39 "Reserved" 40 "Reserved" 41 "Reserved" 42 "Reserved" 43 "Reserved" 44 "Reserved" 45 "Reserved" 46 "Reserved" 47 "Reserved" 48 "Reserved" 49 "Reserved" 50 "Reserved" 51 "Reserved" 52 "Reserved" 53 "Reserved" 54 "Reserved" 55 "Reserved" 56 "Reserved" 57 "Reserved" 58 "Reserved" 59 "Reserved" 60 "Reserved" 61 "Reserved" 62 "Reserved" 63 "Reserved" 64 "Reserved" 65 "Reserved" 66 "Reserved" 67 "Reserved" 68 "Reserved" 69 "Reserved" 70 "Reserved" 71 "Reserved" 72 "Reserved" 73 "Reserved" 74 "Reserved" 75 "Reserved" 76 "Reserved" 77 "Reserved" 78 "Reserved" 79 "Reserved" 80 "Reserved" 81 "Reserved" 82 "Reserved" 83 "Reserved" 84 "Reserved" 85 "Reserved" 86 "Reserved" 87 "Reserved" 88 "Reserved" 89 "Reserved" 90 "Reserved" 91 "Reserved" 92 "Reserved" 93 "Reserved" 94 "Reserved" 95 "Reserved" 96 "Reserved" 97 "Reserved" 98 "Reserved" 99 "Reserved" 100 "Reserved" 101 "Reserved" 102 "Reserved" 103 "Reserved" 104 "Reserved" 105 "Reserved" 106 "Reserved" 107 "Reserved" 108 "Reserved" 109 "Reserved" 110 "Reserved" 111 "Reserved" 112 "Reserved" 113 "Reserved" 114 "Reserved" 115 "Reserved" 116 "Reserved" 117 "Reserved" 118 "Reserved" 119 "Reserved" 120 "Reserved" 121 "Reserved" 122 "Reserved" 123 "Reserved" 124 "Reserved" 125 "Reserved" 126 "Reserved" 127 "Reserved" 128 "Searching for Parking space - Drive forwards (주차공간 탐색 중)" 129 "Searching Completed - Stop vehicle to park or Move forward (주차공간 탬색 완료)" 130 "Select parking mode (주차유형 선택)" 131 "Checking space - Stop the vehicle to check space (출차공간 탐색 중)" 132 "Checking completed - Select pull-out mode (출차방향 선택)" 133 "Remote Moving F/B (원격 전/후진 안내)" 134 "under Remote Control (원격 제어 중)" 135 "Remote Moving F/B Completed (원격 전/후진 완료)" 136 "Operation guide - Reinput Parking Button (조작안내- 작동버튼 재입력 유지)" 137 "Operation guide - Reinput SMART Key Button (조작안내- 스마트키 버튼 재입력 유지)" 138 "Not working condition ? Read Manual (미작동 조건)" 139 "8B~0xFE: Reserved" 254 "8B~0xFE: Reserved" 255 "Invalid" ;
VAL_ 3221225472 PSB_LHFlrSta 0 "No failure" 1 "Failure, Service Required" 2 "Defect, PSB warning light off" 3 "Signal not valid" ;
VAL_ 3221225472 PSB_LHActvSta 0 "No PSB motor activation" 1 "PSB retract cycle active" 2 "Reserved" 3 "Reserved" ;
VAL_ 3221225472 PSB_RHFlrSta 0 "No failure" 1 "Failure, Service Required" 2 "Defect, PSB warning light off" 3 "Signal not valid" ;
VAL_ 3221225472 PSB_RHActvSta 0 "No PSB motor activation" 1 "PSB retract cycle active" 2 "Reserved" 3 "Reserved" ;
VAL_ 3221225472 PSB_ActForAcu 0 "Inactive" 1 "Active" 2 "Reserved" 3 "Failure" ;
VAL_ 3221225472 PTGM_HazardSta 0 "Off" 1 "On" 2 "Inactive" ;
VAL_ 3221225472 PTGM_ModSta 0 "Power Mode" 1 "Manual Mode" 2 "Not Used" 3 "Error Indicator" ;
VAL_ 3221225472 PTGM_MovSta 0 "Stop" 1 "Moving" 2 "Not Used" 3 "Error Indicator" ;
VAL_ 3221225472 PTGM_OptTyp 0 "Off" 1 "On(PTG is applied)" 2 "Not Used" 3 "Error Indicator" ;
VAL_ 3221225472 PTGM_ReleaseRlySta 0 "Off" 1 "On" 2 "Not Used" 3 "Error Indicator" ;
VAL_ 3221225472 PTGM_TrnkLkSwSta 0 "Off" 1 "Close & Lock" 2 "Not Used" 3 "Error Indicator" ;
VAL_ 3221225472 PTGM_UsmSetSta 0 "Default" 1 "Power Mode" 2 "Manual Mode" 3 "Invalid" ;
VAL_ 3221225472 BCW_Sta 0 "Default" 1 "System is Off" 2 "System Passive" 3 "System Active" 4 "System Failure" 5 "System Blockage" 6 "System minor failure" 7 "Reserved" 8 "Reserved" 9 "Reserved" 10 "Reserved" 11 "Reserved" 12 "Reserved" 13 "Reserved" 14 "Reserved" ;
VAL_ 3221225472 BCW_OnOffEquipSta 0 "Default" 1 "Off" 2 "Warning" 3 "?Invalid" ;
VAL_ 3221225472 BCW_LftIndSta 0 "Indicator output off" 1 "Indicator on (information)" 2 "Indicator blinking(warning)" 3 "Indicator output check" ;
VAL_ 3221225472 BCW_RtIndSta 0 "Indicator output off" 1 "Indicator on (information)" 2 "Indicator blinking(warning)" 3 "Indicator output check" ;
VAL_ 3221225472 BCW_LftSndWrngSta 0 "Speaker is Off" 1 "Speaker On" 2 "Not used" 3 "Error Indicator" ;
VAL_ 3221225472 BCW_RtSndWrngSta 0 "Speaker is Off" 1 "Speaker On" 2 "Not used" 3 "Error Indicator" ;
VAL_ 3221225472 BCW_SnstvtyModRetVal 0 "Default" 1 "Late" 2 "Normal" 3 "Early" 4 "Reserved" 5 "Reserved" 6 "Reserved" 7 "Invalid" ;
VAL_ 3221225472 BCA_Sta 0 "Default" 1 "BCA Function is off" 2 "BCA Function is passive" 3 "BCA Function active" 4 "BCA Function failure" 5 "BCA Function Blockage" 6 ":BCA Function minor failure" 7 "Failure low priority" 8 "Reserved" 9 "Reserved" 10 "Reserved" 11 "Reserved" 12 "Reserved" 13 "Reserved" 14 "Reserved" ;
VAL_ 3221225472 BCA_OnOffEquipSta 0 "Default" 1 "Off" 2 "Warning" 3 "Assist" 4 "Reserved" 5 "Reserved" 6 "Reserved" 7 "?Invalid" ;
VAL_ 3221225472 BCA_LftWrngSta 0 "BCA Left Warning is Off" 1 "BCA Left Warning is On" 2 "Not used" 3 "Error Indicator" ;
VAL_ 3221225472 BCA_RtWrngSta 0 "BCA Right Warning is Off" 1 "BCA Right Warning is On" 2 "Not used" 3 "Error Indicator" ;
VAL_ 3221225472 BCA_Plus_BrkCmdSta 0 "BCA_Plus Brake off" 1 "BCA_Plus Brake on" 2 "Not used" 3 "Error Indicator" ;
VAL_ 3221225472 BCA_Plus_LftWrngSta 0 "BCA_Plus Left Warning is Off" 1 "BCA_Plus Left Warning is On" 2 "Not used" 3 "Error Indicator" ;
VAL_ 3221225472 BCA_Plus_RtWrngSta 0 "BCA_Plus Right Warning is Off" 1 "BCA_Plus Right Warning is On" 2 "Not used" 3 "Error Indicator" ;
VAL_ 3221225472 BCA_Plus_OnOffEquipSta 0 "Default" 1 "Off" 2 "Warning" 3 "Assist" 4 "Reserved" 5 "Reserved" 6 "Reserved" 7 "?Invalid" ;
VAL_ 3221225472 BCA_Plus_FuncStat 0 "ESC Normal" 1 "Not support (ESC failure)" 2 "Not used" 3 "Error Indicator" ;
VAL_ 3221225472 BCA_Plus_Sta 0 "Default" 1 "BCA Plus Function is off" 2 "BCA Plus Function is passive" 3 "BCA Plus Function active" 4 "BCA Plus Function failure" 5 "BCA Plus Function Blockage" 6 "BCA Plus Function minor failure" 7 "Reserved" 8 "Reserved" 9 "Reserved" 10 "Reserved" 11 "Reserved" 12 "Reserved" 13 "Reserved" 14 "Reserved" ;
VAL_ 3221225472 CLU_PdwDisTyp 0 "Display is not applied" 1 "Display is applied" 2 "Not used" 3 "Error Indicator" ;
VAL_ 3221225472 CLU_DtntOutSta 0 "Detent Off" 1 "Detent On" 2 "Not used" 3 "Error Indicator" ;
VAL_ 3221225472 CLU_SpdUnitTyp 0 "km/h" 1 "MPH" 2 "Not used" 3 "Error Indicator" ;
VAL_ 3221225472 CLU_DisSpdDcmlVal 0 "0" 1 "0.125" 2 "0.250" 3 "0.375" ;
VAL_ 3221225472 CLU_RhstaLvlSta 0 "Reserved" 1 "Step 1" 2 "Step 2" 3 "Step 3" 4 "Step 4" 5 "Step 5" 6 "Step 6" 7 "Step 7" 8 "Step 8" 9 "Step 9" 10 "Step 10" 11 "Step 11" 12 "Step 12" 13 "Step 13" 14 "Step 14" 15 "Step 15" 16 "Step 16" 17 "Step 17" 18 "Step 18" 19 "Step 19" 20 "Step 20 (Reset Value)" 21 "Step 21 (Detent)" ;
VAL_ 3221225472 CLU_DisSpdVal 1023 "Error" ;
VAL_ 3221225472 VCRM_CluSrvRmndrDaySta 0 "00 months" 1 "01 months" 2 "02 months" 3 "03 months ~ 99 months" 4 "03 months ~ 99 months" 5 "03 months ~ 99 months" 6 "03 months ~ 99 months" 7 "03 months ~ 99 months" 8 "03 months ~ 99 months" 9 "03 months ~ 99 months" 10 "03 months ~ 99 months" 11 "03 months ~ 99 months" 12 "03 months ~ 99 months" 13 "03 months ~ 99 months" 14 "03 months ~ 99 months" 15 "03 months ~ 99 months" 16 "03 months ~ 99 months" 17 "03 months ~ 99 months" 18 "03 months ~ 99 months" 19 "03 months ~ 99 months" 20 "03 months ~ 99 months" 21 "03 months ~ 99 months" 22 "03 months ~ 99 months" 23 "03 months ~ 99 months" 24 "03 months ~ 99 months" 25 "03 months ~ 99 months" 26 "03 months ~ 99 months" 27 "03 months ~ 99 months" 28 "03 months ~ 99 months" 29 "03 months ~ 99 months" 30 "03 months ~ 99 months" 31 "03 months ~ 99 months" 32 "03 months ~ 99 months" 33 "03 months ~ 99 months" 34 "03 months ~ 99 months" 35 "03 months ~ 99 months" 36 "03 months ~ 99 months" 37 "03 months ~ 99 months" 38 "03 months ~ 99 months" 39 "03 months ~ 99 months" 40 "03 months ~ 99 months" 41 "03 months ~ 99 months" 42 "03 months ~ 99 months" 43 "03 months ~ 99 months" 44 "03 months ~ 99 months" 45 "03 months ~ 99 months" 46 "03 months ~ 99 months" 47 "03 months ~ 99 months" 48 "03 months ~ 99 months" 49 "03 months ~ 99 months" 50 "03 months ~ 99 months" 51 "03 months ~ 99 months" 52 "03 months ~ 99 months" 53 "03 months ~ 99 months" 54 "03 months ~ 99 months" 55 "03 months ~ 99 months" 56 "03 months ~ 99 months" 57 "03 months ~ 99 months" 58 "03 months ~ 99 months" 59 "03 months ~ 99 months" 60 "03 months ~ 99 months" 61 "03 months ~ 99 months" 62 "03 months ~ 99 months" 63 "03 months ~ 99 months" 64 "03 months ~ 99 months" 65 "03 months ~ 99 months" 66 "03 months ~ 99 months" 67 "03 months ~ 99 months" 68 "03 months ~ 99 months" 69 "03 months ~ 99 months" 70 "03 months ~ 99 months" 71 "03 months ~ 99 months" 72 "03 months ~ 99 months" 73 "03 months ~ 99 months" 74 "03 months ~ 99 months" 75 "03 months ~ 99 months" 76 "03 months ~ 99 months" 77 "03 months ~ 99 months" 78 "03 months ~ 99 months" 79 "03 months ~ 99 months" 80 "03 months ~ 99 months" 81 "03 months ~ 99 months" 82 "03 months ~ 99 months" 83 "03 months ~ 99 months" 84 "03 months ~ 99 months" 85 "03 months ~ 99 months" 86 "03 months ~ 99 months" 87 "03 months ~ 99 months" 88 "03 months ~ 99 months" 89 "03 months ~ 99 months" 90 "03 months ~ 99 months" 91 "03 months ~ 99 months" 92 "03 months ~ 99 months" 93 "03 months ~ 99 months" 94 "03 months ~ 99 months" 95 "03 months ~ 99 months" 96 "03 months ~ 99 months" 97 "03 months ~ 99 months" 98 "03 months ~ 99 months" 99 "03 months ~ 99 months" 100 "reserved" 101 "reserved" 102 "reserved" 103 "reserved" 104 "reserved" 105 "reserved" 106 "reserved" 107 "reserved" 108 "reserved" 109 "reserved" 110 "reserved" 111 "reserved" 112 "reserved" 113 "reserved" 114 "reserved" 115 "reserved" 116 "reserved" 117 "reserved" 118 "reserved" 119 "reserved" 120 "reserved" 121 "reserved" 122 "reserved" 123 "reserved" 124 "reserved" 125 "reserved" 126 "reserved" 127 "invalid" ;
VAL_ 3221225472 VCRM_CluSrvRmndrDstSta 0 "00000km" 1 "00100km" 2 "00200km" 3 "3~0x3E7:00300km~99900km" 999 "3~0x3E7:00300km~99900km" 1000 "reserved" 1001 "reserved" 1002 "reserved" 1003 "reserved" 1004 "reserved" 1005 "reserved" 1006 "reserved" 1007 "reserved" 1008 "reserved" 1009 "reserved" 1010 "reserved" 1011 "reserved" 1012 "reserved" 1013 "reserved" 1014 "reserved" 1015 "reserved" 1016 "reserved" 1017 "reserved" 1018 "reserved" 1019 "reserved" 1020 "reserved" 1021 "reserved" 1022 "reserved" 1023 "invalid" ;
VAL_ 3221225472 VCRM_CluVcAlrmVolSta 0 "NA" 1 "mute" 2 "volume1" 3 "volume2" 4 "volume3" 5 "reserved" 6 "reserved" 7 "invalid" ;
VAL_ 3221225472 VCRM_CluDISWrngSta 0 "Off" 1 "On" 2 "Not used" 3 "Error Indicator" ;
VAL_ 3221225472 VCRM_CluFuelConsmptnUnitSta 0 "km/L" 1 "MPG(US)" 2 "L/100km" 3 "MPG(UK)" ;
VAL_ 3221225472 VCRM_CluGearPosPopupSta 0 "Off" 1 "On" 2 "Not used" 3 "Error Indicator" ;
VAL_ 3221225472 VCRM_CluMFSWPopupSta 0 "Off" 1 "On" 2 "Not used" 3 "Error Indicator" ;
VAL_ 3221225472 VCRM_CluSrvRmndrSta 0 "Off" 1 "On" 2 "Not used" 3 "Error Indicator" ;
VAL_ 3221225472 VCRM_CluSpdmtrSta 0 "km/h" 1 "mph" 2 "reserved" 3 "invalid" ;
VAL_ 3221225472 VCRM_CluStrWhlAlignSta 0 "Off" 1 "On" 2 "Not used" 3 "Error Indicator" ;
VAL_ 3221225472 VCRM_CluWlcmSndSta 0 "Off" 1 "On" 2 "Not used" 3 "Error Indicator" ;
VAL_ 3221225472 VCRM_CluDisGrpSta 0 "NA" 1 "1st tab" 2 "2nd tab" 3 "3rd tab ~ 15th tab" 4 "3rd tab ~ 15th tab" 5 "3rd tab ~ 15th tab" 6 "3rd tab ~ 15th tab" 7 "3rd tab ~ 15th tab" 8 "3rd tab ~ 15th tab" 9 "3rd tab ~ 15th tab" 10 "3rd tab ~ 15th tab" 11 "3rd tab ~ 15th tab" 12 "3rd tab ~ 15th tab" 13 "3rd tab ~ 15th tab" 14 "3rd tab ~ 15th tab" 15 "invalid" ;
VAL_ 3221225472 VCRM_CluDisModSta 0 "NA" 1 "1st page" 2 "2nd page" 3 "3rd page ~ 15th page" 4 "3rd page ~ 15th page" 5 "3rd page ~ 15th page" 6 "3rd page ~ 15th page" 7 "3rd page ~ 15th page" 8 "3rd page ~ 15th page" 9 "3rd page ~ 15th page" 10 "3rd page ~ 15th page" 11 "3rd page ~ 15th page" 12 "3rd page ~ 15th page" 13 "3rd page ~ 15th page" 14 "3rd page ~ 15th page" 15 "invalid" ;
VAL_ 3221225472 VCRM_CluAvgFuelCnsmptnAutoRstSta 0 "off" 1 "after ignition" 2 "after refueling" 3 "reserved" 4 "reserved" 5 "reserved" 6 "reserved" 7 "invalid" ;
VAL_ 3221225472 VCRM_CluTxtSizeSta 0 "medium" 1 "large" 2 "reserved" 3 "reserved" 4 "reserved" 5 "reserved" 6 "reserved" 7 "invalid" ;
VAL_ 3221225472 VCRM_CluLngSetSta 0 "NA" 1 "Korean" 2 "English(US)" 3 "French(US)" 4 "Spanish(US)" 5 "Simplified Chinese" 6 "Arabic" 7 "English(UK)" 8 "French(EU)" 9 "Portuguese (EU)" 10 "Italian" 11 "German" 12 "Russian" 13 "Spanish (EU)" 14 "Dutch" 15 "Swedish" 16 "Slovakia" 17 "Polish" 18 "Turkish" 19 "Czech" 20 "Danish" 21 "reserved" 22 "reserved" 23 "reserved" 24 "reserved" 25 "reserved" 26 "reserved" 27 "reserved" 28 "reserved" 29 "reserved" 30 "reserved" 31 "reserved" 32 "reserved" 33 "reserved" 34 "reserved" 35 "reserved" 36 "reserved" 37 "reserved" 38 "reserved" 39 "reserved" 40 "reserved" 41 "reserved" 42 "reserved" 43 "reserved" 44 "reserved" 45 "reserved" 46 "reserved" 47 "reserved" 48 "reserved" 49 "reserved" 50 "reserved" 51 "reserved" 52 "reserved" 53 "reserved" 54 "reserved" 55 "reserved" 56 "reserved" 57 "reserved" 58 "reserved" 59 "reserved" 60 "reserved" 61 "reserved" 62 "reserved" 63 "invalid" ;
VAL_ 3221225472 CLU_DisSpdVal_KPH 511 "Error" ;
VAL_ 3221225472 PSM_DrvStReclnePosVal 0 "0≤x≤33" 1 "33<x≤41" 2 "41<x≤46" 3 "46<x≤53" 4 "53<x≤66" 5 "reserved" 6 "reserved" 7 "invalid" ;
VAL_ 3221225472 PSM_DrvStSldPosVal 0 "0≤x≤130" 1 "130<x≤180" 2 "180<x≤230" 3 "230<x≤260" 4 "reserved" 5 "reserved" 6 "reserved" 7 "invalid" ;
VAL_ 3221225472 PSM_EsyAcsGetOnSta 0 "off" 1 "on" 2 "Not Used" 3 "Error Indicator" ;
VAL_ 3221225472 PSM_EsyAcsGetOffSta 0 "off" 1 "on" 2 "Not Used" 3 "Error Indicator" ;
VAL_ 3221225472 PSM_EsyAcsStpSta 0 "off" 1 "on" 2 "Not Used" 3 "Error Indicator" ;
VAL_ 3221225472 SCC_ObjDstVal 1501 "0x5DD~0x7FF:Reserved" 2047 "0x5DD~0x7FF:Reserved" 2046 "Default" 2047 "Error" ;
VAL_ 3221225472 SCC_ObjRelSpdVal 4094 "Default" 4095 "Error" ;
VAL_ 3221225472 SCC_ObjLatPosVal 510 "Default" 511 "Error" ;
VAL_ 3221225472 PSM_DrvStSldFwdDis 0 "default" 1 "off" 2 "on" 3 "invalid" ;
VAL_ 3221225472 PSM_DrvStSldBckwdDis 0 "default" 1 "off" 2 "on" 3 "invalid" ;
VAL_ 3221225472 PSM_DrvStReclneFwdDis 0 "default" 1 "off" 2 "on" 3 "invalid" ;
VAL_ 3221225472 PSM_DrvStReclneBckwdDis 0 "default" 1 "off" 2 "on" 3 "invalid" ;
VAL_ 3221225472 PSM_DrvStTiltUpDis 0 "default" 1 "off" 2 "on" 3 "invalid" ;
VAL_ 3221225472 PSM_DrvStTiltDnDis 0 "default" 1 "off" 2 "on" 3 "invalid" ;
VAL_ 3221225472 PSM_DrvStHghtUpDis 0 "default" 1 "off" 2 "on" 3 "invalid" ;
VAL_ 3221225472 PSM_DrvStHghtDnDis 0 "default" 1 "off" 2 "on" 3 "invalid" ;
VAL_ 3221225472 PSM_DrvStCushExtBckwdDis 0 "default" 1 "off" 2 "on" 3 "invalid" ;
VAL_ 3221225472 PSM_DrvStCushExtFwdDis 0 "default" 1 "off" 2 "on" 3 "invalid" ;
VAL_ 3221225472 PSM_DrvStLmbrDefDis 0 "default" 1 "off" 2 "on" 3 "invalid" ;
VAL_ 3221225472 PSM_DrvStLmbrLoDis 0 "default" 1 "off" 2 "on" 3 "invalid" ;
VAL_ 3221225472 PSM_DrvStLmbrMdlDis 0 "default" 1 "off" 2 "on" 3 "invalid" ;
VAL_ 3221225472 PSM_DrvStLmbrUpDis 0 "default" 1 "off" 2 "on" 3 "invalid" ;
VAL_ 3221225472 PSM_LmbrSigSrcTyp 0 "not PSM" 1 "PSM" 2 "reserved" 3 "invalid" ;
VAL_ 3221225472 PSM_DrvStEsyAcsUSMSta 0 "Default Value" 1 "Off (Disable)" 2 "50mmOn (Enable)" 3 "75mmOn (Enable)" 4 "Reserved" 5 "Reserved" 6 "Reserved" 7 "Invalid" ;
VAL_ 3221225472 PSM_AutoHtrCtrlUSMSta 0 "Default" 1 "Off" 2 "On" 3 "Invalid" ;
VAL_ 3221225472 PSM_IMSOptTyp 0 "Default" 1 "IMS Option" 2 "IMS&Smart IMS Option" 3 "Error Indicator" ;
VAL_ 3221225472 Profile_IMSIDSelUSMSta 0 "Default" 1 "Disable" 2 "Enable for IMS1" 3 "Enable for IMS2" 4 "Reserved" 5 "Reserved" 6 "Reserved" 7 "Invalid" ;
VAL_ 3221225472 Profile_IMSIDSelErrSta 0 "None" 1 "Error" 2 "Reserved" 3 "Invalid" ;
VAL_ 3221225472 PSM_DrvStHtrVntTyp 0 "Init" 1 "Heat Only 2 Step" 2 "Heat Only 3 Step" 3 "Vent Only 2 Step" 4 "Vent Only 3 Step" 5 "Heat and Vent 2 Step" 6 "Heat and Vent 3 Step" 7 "Invalid" ;
VAL_ 3221225472 PSM_DrvStHtrVntSta 0 "Init" 1 "Unused" 2 "Seat Heat&Vent OFF" 3 "Seat_Vent_Low" 4 "Seat_Vent_Mid" 5 "Seat_Vent_High" 6 "Seat_Heat_Low" 7 "Seat_Heat_Mid" 8 "Seat_Heat_High" 9 "Unused" 10 "Unused" 11 "Unused" 12 "Unused" 13 "Unused" 14 "Unused" 15 "Invalid" ;
VAL_ 3221225472 SmrtIMS_StatureRspVal 0 "Default" 1 "Less than 147.5cm" 2 "147.5~152.4cm" 3 "152.5~157.4cm" 4 "157.5~162.4cm" 5 "162.5~167.4cm" 6 "167.5~172.4cm" 7 "172.5~177.4cm" 8 "177.5~182.4cm" 9 "182.5~187.4cm" 10 "187.5~192.4cm" 11 "192.5~197.4cm" 12 "More than 197.5cm" 13 "Reserved" 14 "Reserved" 15 "Invalid" ;
VAL_ 3221225472 SmrtIMS_SeatedHghtRspVal 0 "Default" 1 "Tall" 2 "Middle" 3 "Short" 4 "Reserved" 5 "Reserved" 6 "Reserved" 7 "Reserved" 8 "Reserved" 9 "Reserved" 10 "Reserved" 11 "Reserved" 12 "Reserved" 13 "Reserved" 14 "Reserved" 15 "Invalid" ;
VAL_ 3221225472 SmrtIMS_WghtRspVal 0 "Default" 1 "Under 49.4kg" 2 "49.5~59.4kg" 3 "59.5~69.4kg" 4 "69.5~79.4kg" 5 "79.5~89.4kg" 6 "89.5~99.4kg" 7 "99.5~109.4kg" 8 "109.5~119.4kg" 9 "More than119.5kg" 10 "Reserved" 11 "Reserved" 12 "Reserved" 13 "Reserved" 14 "Reserved" 15 "Invalid" ;
VAL_ 3221225472 SmartIMS_DisReq 0 "Stop" 1 "Moving(recommend position)" 2 "Moving(manual switch, IMS)" 3 "Current Position Analysis" 4 "Move to setting page" 5 "Reserved" 6 "Reserved" 7 "Invalid" ;
VAL_ 3221225472 SmrtIMS_ExitSta 0 "normal" 1 "not IGN" 2 "not P or over 3km/h" 3 "cranking" 4 "seat moving" 5 "PSM is not initialized" 6 "low voltage" 7 "reserved" ;
VAL_ 3221225472 SCC_AccelReqVal 2047 "Error" ;
VAL_ 3221225472 SCC_AccelReqRawVal 2047 "Error" ;
VAL_ 3221225472 SCC_JrkUppLimVal 127 "No Limit" ;
VAL_ 3221225472 SCC_JrkLwrLimVal 127 "No Limit" ;
VAL_ 3221225472 SCC_AccelLimBandUppVal 0 "Precise Control" ;
VAL_ 3221225472 SCC_AccelLimBandLwrVal 0 "Precise Control" ;
VAL_ 3221225472 SCC_VehStpReq 0 "No request" 1 "Stop control is required" 2 "Not used" 3 "Error Indicator" ;
VAL_ 3221225472 SCC_DclModReq 0 "Deceleration with Engine Braking and Brake Control" 1 "Deceleration with Only Engine Braking" 2 "Not used" 3 "Error Indicator" ;
VAL_ 3221225472 SCC_SysFlrSta 0 "System without error" 1 "Performance degredation" 2 "System temporairy unavailable" 3 "SCC Service Required" ;
VAL_ 3221225472 SCC_MainOnOffSta 0 "OFF" 1 "ON" 2 "Not used" 3 "Error Indicator" ;
VAL_ 3221225472 SCC_OpSta 0 "Off" 1 "Engaged" 2 "Override" 3 "Shutoff" 4 "Canceled" 5 "Reserved" 6 "Reserved" 7 "Reserved" ;
VAL_ 3221225472 SCC_TakeoverReq 0 "No takeover request" 1 "Takeover request" 2 "Not used" 3 "Error Indicator" ;
VAL_ 3221225472 SCC_InfoDis 0 "-" 1 "Display “SCC Mode”" 2 "Display “Conventional Cruise Mode”" 3 "Display “Object disappeared at low speed”" 4 "Display “Available to resume acceleration control”" 5 "Display “Front vehicle departure notice”" 6 "Reserved" 7 "Invalid" ;
VAL_ 3221225472 SCC_DrvAlrtDis 0 "-" 1 "Display 'SCC Disengaged'" 2 "Display 'No SCC Engage Condition!'" 3 "Display 'SCC Disengaged When The Vehicle Stops'" ;
VAL_ 3221225472 SCC_ObjDstLvlVal 0 "No in-path object detected" 1 "Distance Warning" 2 "1st~13th Object Distance Level" 3 "1st~13th Object Distance Level" 4 "1st~13th Object Distance Level" 5 "1st~13th Object Distance Level" 6 "1st~13th Object Distance Level" 7 "1st~13th Object Distance Level" 8 "1st~13th Object Distance Level" 9 "1st~13th Object Distance Level" 10 "1st~13th Object Distance Level" 11 "1st~13th Object Distance Level" 12 "1st~13th Object Distance Level" 13 "1st~13th Object Distance Level" 14 "1st~13th Object Distance Level" 15 "F~0xFE:Reserved" 254 "F~0xFE:Reserved" 255 "Error Indicator" ;
VAL_ 3221225472 SCC_HeadwayDstSetVal 0 "No time gap set" 1 "1st level distance" 2 "2nd level distance" 3 "3rd level distance" 4 "4th level distance" 5 "Reserved" 6 "Reserved" 7 "Reserved" 8 "Reserved" 9 "Reserved" 10 "Reserved" 11 "Reserved" 12 "Reserved" 13 "Reserved" 14 "SCC-ML Active" 15 "Error Indicator" ;
VAL_ 3221225472 SCC_EquipSta 0 "Not Applied" 1 "Applied" 2 "Not used" 3 "Error Indicator" ;
VAL_ 3221225472 SCC_TrgtSpdSetVal 255 "Error" ;
VAL_ 3221225472 SCC_NSCCOpSta 0 "Off" 1 "Ready" 2 "Act" 3 "Error Indicator" ;
